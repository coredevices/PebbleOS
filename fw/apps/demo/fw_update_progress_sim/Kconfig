## fw/apps/demo/fw_update_progress_sim/Kconfig
```kconfig
# SPDX-Copyright-Text: 2026 Core Devices LLC
# SPDX-License-Identifier: Apache-2.0

config DEMO_APP_FW_UPDATE_PROGRESS_SIM
    bool "Fw Update Progress Sim"
```

## fw/apps/demo/test_args_receiver/Kconfig
```kconfig
# SPDX-Copyright-Text: 2026 Core Devices LLC
# SPDX-License-Identifier: Apache-2.0

config DEMO_APP_TEST_ARGS_RECEIVER
    bool "Test Args Receiver"
```

## fw/apps/demo/test_args_sender/Kconfig
```kconfig
# SPDX-Copyright-Text: 2026 Core Devices LLC
# SPDX-License-Identifier: Apache-2.0

config DEMO_APP_TEST_ARGS_SENDER
    bool "Test Args Sender"
```

## fw/apps/demo/vibe_score/Kconfig
```kconfig
# SPDX-Copyright-Text: 2026 Core Devices LLC
# SPDX-License-Identifier: Apache-2.0

config DEMO_APP_VIBE_SCORE
    bool "Vibe Score"
```

## fw/apps/watch/Kconfig
```kconfig
# SPDX-FileCopyrightText: 2026 Core Devices LLC
# SPDX-License-Identifier: Apache-2.0

menu "Watch faces"

choice
    prompt "TicToc watch face"
    default APPS_WATCH_TICTOC_ROUND if PLATFORM_GABBRO
    default APPS_WATCH_TICTOC_BW if SCREEN_COLOR_DEPTH_BITS_1
    default APPS_WATCH_TICTOC_DEFAULT
    help
      Which built-in TicToc watch face variant to build.

config APPS_WATCH_TICTOC_DEFAULT
    bool "Default (color, rectangular)"

config APPS_WATCH_TICTOC_BW
    bool "Black and white (1-bit)"

config APPS_WATCH_TICTOC_ROUND
    bool "Round"

endchoice

endmenu
```

## fw/drivers/otp/Kconfig
```kconfig
# SPDX-FileCopyrightText: 2026 Core Devices LLC
# SPDX-License-Identifier: Apache-2.0

menuconfig OTP
    bool "OTP Storage"
    help
      One-Time Programmable storage for serial numbers, HW revision, etc.

if OTP

config OTP_FLASH
    bool "Flash security registers"
    help
      OTP backed by SPI NOR flash security registers
      (e.g. GD25 / GD25LQ family). Driver: otp_flash.c.

endif # OTP
```

## fw/services/app_glances/Kconfig
```kconfig
# SPDX-FileCopyrightText: 2026 Core Devices LLC
# SPDX-License-Identifier: Apache-2.0

config SERVICE_APP_GLANCES
    bool "App glances"
    help
      App-glances (launcher tile) service.
```

## fw/services/firmware_update/Kconfig
```kconfig
# SPDX-FileCopyrightText: 2026 Core Devices LLC
# SPDX-License-Identifier: Apache-2.0

config SERVICE_FIRMWARE_UPDATE
    bool "Firmware update"
    help
      Firmware update endpoint/state machine.

if SERVICE_FIRMWARE_UPDATE

module = SERVICE_FIRMWARE_UPDATE
module-str = Firmware update
source "subsys/logging/Kconfig.template.log_level"

endif
```

## fw/services/phone_call/Kconfig
```kconfig
# SPDX-FileCopyrightText: 2026 Core Devices LLC
# SPDX-License-Identifier: Apache-2.0

config SERVICE_PHONE_CALL
    bool "Phone call"
    help
      Phone call (incoming/outgoing) service.

if SERVICE_PHONE_CALL

module = SERVICE_PHONE_CALL
module-str = Phone call
source "subsys/logging/Kconfig.template.log_level"

endif
```

## fw/services/send_text_service/Kconfig
```kconfig
# SPDX-FileCopyrightText: 2026 Core Devices LLC
# SPDX-License-Identifier: Apache-2.0

config SERVICE_SEND_TEXT_SERVICE
    bool "Send text"
    help
      Send-text quick-reply service.
```

## lib/c/Kconfig
```kconfig
# SPDX-FileCopyrightText: 2026 Core Devices LLC
# SPDX-License-Identifier: Apache-2.0

menu "C library"

choice
    prompt "C library"
    default LIBC_PICOLIBC
    help
      Which C library the firmware links against.

config LIBC_NEWLIB
    bool "Newlib (full)"
    help
      Full newlib from the toolchain. Largest, but complete C99
      formatted I/O out of the box.

config LIBC_NEWLIB_NANO
    bool "Newlib nano"
    help
      Size-optimized newlib (nano.specs). Smaller than full newlib,
      but its printf lacks the C99 length modifiers (%hhu, %zu, %llu)
      the firmware relies on, so a small C99-capable printf from
      lib/c/newlib is linked ahead of it.

config LIBC_PICOLIBC
    bool "Picolibc"
    help
      Picolibc: smallest footprint, C99-capable printf, TLS-based
      reentrancy. Taken pre-built from the toolchain when available (the
      PebbleOS SDK toolchain ships one), otherwise built from the
      third_party/picolibc submodule with a warning.

endchoice

config LIBC_PICOLIBC_FROM_SOURCE
    bool "Build Picolibc from source"
    depends on LIBC_PICOLIBC
    help
      Always build Picolibc from the third_party/picolibc submodule with
      meson, skipping any pre-built copy the toolchain ships. Useful when
      hacking on picolibc itself or changing its build options.

endmenu
```

## pebble/apps/demo/animated_demo/Kconfig
```kconfig
# SPDX-Copyright-Text: 2026 Core Devices LLC
# SPDX-License-Identifier: Apache-2.0

config DEMO_APP_ANIMATED_DEMO
    bool "Animated Demo"
```

## pebble/apps/demo/mpu_violation_test/Kconfig
```kconfig
# SPDX-Copyright-Text: 2026 Core Devices LLC
# SPDX-License-Identifier: Apache-2.0

config DEMO_APP_MPU_VIOLATION_TEST
    bool "Mpu Violation Test"
```

## soc/qemu/Kconfig.defconfig
```kconfig
# SPDX-FileCopyrightText: 2026 Core Devices LLC
# SPDX-License-Identifier: Apache-2.0

if SOC_QEMU

choice BT_FW
    default BT_FW_QEMU
endchoice

# 4 MiB of emulated flash, all of it available to the firmware.
config FLASH_BASE
    default 0x00000000

config FLASH_SIZE
    default 0x400000

config FLASH_OFFSET
    default 0x0

config FW_FLASH_SIZE
    default 0x400000

# QEMU mirrors the SRAM layout of the platform it emulates.
config SRAM_BASE
    default 0x20000100 if PLATFORM_FLINT
    default 0x20000000

config SRAM_SIZE
    default 0x3ff00 if PLATFORM_FLINT
    default 0x7fc00

endif # SOC_QEMU
```

## soc/sf32lb/Kconfig.defconfig
```kconfig
# SPDX-FileCopyrightText: 2026 Core Devices LLC
# SPDX-License-Identifier: Apache-2.0

if SOC_SF32LB52

config MMAP_RESOURCES
    default y

choice BT_FW
    default BT_FW_NIMBLE
endchoice

# 32 MiB of external flash, memory-mapped through MPI. Layout: 64 KiB
# partition table, 64 KiB bootloader, two 3 MiB firmware slots, two
# 2 MiB resource areas, then the 576 KiB recovery firmware (PRF).
config FLASH_BASE
    default 0x12000000

config FLASH_SIZE
    default 0x2000000

config FLASH_OFFSET
    default 0xa20000 if RECOVERY_FW && !MFG && !RECOVERY_FW_AS_FW
    default 0x320000 if FIRMWARE_SLOT = 1
    default 0x20000

config FW_FLASH_SIZE
    default 0x90000 if RECOVERY_FW && !MFG && !RECOVERY_FW_AS_FW
    default 0x300000

# 512 KiB of SRAM, last 1 KiB reserved for LCPU IPC.
config SRAM_BASE
    default 0x20000000

config SRAM_SIZE
    default 0x7fc00

config FIRMWARE_OFFSET
    default 4096

endif # SOC_SF32LB52
```

## src/Kconfig
```kconfig
# SPDX-FileCopyrightText: 2026 Core Devices LLC
# SPDX-License-Identifier: Apache-2.0

rsource "fw/Kconfig"
```

## src/fw/Kconfig.template.log_level
```kconfig
# SPDX-FileCopyrightText: 2026 Core Devices LLC
# SPDX-License-Identifier: Apache-2.0

# Per-module log level template. Include with:
#
#   module = MYMODULE
#   module-str = My module
#   source "src/fw/Kconfig.template.log_level"
#
# Defines CONFIG_<module>_LOG_LEVEL, consumed by PBL_LOG_MODULE_DEFINE /
# PBL_LOG_MODULE_DECLARE (see system/logging.h). 0 means "use the default
# log level".

choice
    prompt "$(module-str) log level"
    default $(module)_LOG_LEVEL_DEFAULT
    depends on LOG

config $(module)_LOG_LEVEL_DEFAULT
    bool "Default"
    help
      Use the global default log level.

config $(module)_LOG_LEVEL_ERROR
    bool "Error"

config $(module)_LOG_LEVEL_WARNING
    bool "Warning"

config $(module)_LOG_LEVEL_INFO
    bool "Info"

config $(module)_LOG_LEVEL_DEBUG
    bool "Debug"

config $(module)_LOG_LEVEL_DEBUG_VERBOSE
    bool "Debug verbose"

endchoice

config $(module)_LOG_LEVEL
    int
    default 1 if $(module)_LOG_LEVEL_ERROR
    default 50 if $(module)_LOG_LEVEL_WARNING
    default 100 if $(module)_LOG_LEVEL_INFO
    default 200 if $(module)_LOG_LEVEL_DEBUG
    default 255 if $(module)_LOG_LEVEL_DEBUG_VERBOSE
    default 0
```

## src/fw/apps/Kconfig
```kconfig
# SPDX-FileCopyrightText: 2026 Core Devices LLC
# SPDX-License-Identifier: Apache-2.0

menu "Applications"

rsource "demo/Kconfig"

endmenu
```

## src/fw/apps/demo/app_heap_demo/Kconfig
```kconfig
# SPDX-Copyright-Text: 2026 Core Devices LLC
# SPDX-License-Identifier: Apache-2.0

config DEMO_APP_APP_HEAP_DEMO
    bool "App Heap Demo"
```

## src/fw/apps/demo/bouncing_box_demo/Kconfig
```kconfig
# SPDX-Copyright-Text: 2026 Core Devices LLC
# SPDX-License-Identifier: Apache-2.0

config DEMO_APP_BOUNCING_BOX_DEMO
    bool "Bouncing Box Demo"
```

## src/fw/apps/demo/kino_layer/Kconfig
```kconfig
# SPDX-Copyright-Text: 2026 Core Devices LLC
# SPDX-License-Identifier: Apache-2.0

config DEMO_APP_KINO_LAYER
    bool "Kino Layer"
```

## src/fw/apps/demo/menu/Kconfig
```kconfig
# SPDX-Copyright-Text: 2026 Core Devices LLC
# SPDX-License-Identifier: Apache-2.0

config DEMO_APP_MENU
    bool "Menu"
```

## src/fw/apps/demo/spo2_test/Kconfig
```kconfig
# SPDX-Copyright-Text: 2026 Core Devices LLC
# SPDX-License-Identifier: Apache-2.0

config DEMO_APP_SPO2_TEST
    bool "SpO2 Test"
    depends on HRM
```

## src/fw/apps/demo/temperature_demo/Kconfig
```kconfig
# SPDX-Copyright-Text: 2026 Core Devices LLC
# SPDX-License-Identifier: Apache-2.0

config DEMO_APP_TEMPERATURE_DEMO
    bool "Temperature Demo"
```

## src/fw/apps/demo/test_bluetooth/Kconfig
```kconfig
# SPDX-Copyright-Text: 2026 Core Devices LLC
# SPDX-License-Identifier: Apache-2.0

config DEMO_APP_TEST_BLUETOOTH
    bool "Test Bluetooth"
```
