## fw/services/new_timer/Kconfig
```kconfig
# SPDX-FileCopyrightText: 2026 Core Devices LLC
# SPDX-License-Identifier: Apache-2.0

config SERVICE_NEW_TIMER
    bool "New timer"
    help
      Legacy "new" timer service.

if SERVICE_NEW_TIMER

config SERVICE_NEW_TIMER_THREAD_STACK_SIZE
    int "Timer thread stack size in bytes"
    default 1380

config SERVICE_NEW_TIMER_THREAD_PRIO
    int "Timer thread priority"
    default 4

config SERVICE_NEW_TIMER_POOL_SIZE
    int "Number of timers"
    range 1 254
    default 176
    help
      Number of timer slots reserved in .kernel_bss. Running out asserts.
      Size it above the system's peak, about 40, plus
      SERVICE_EVENTED_TIMER_MAX_PER_PROCESS, since each timer of an app or
      worker takes a slot.

module = SERVICE_NEW_TIMER
module-str = New timer
source "subsys/logging/Kconfig.template.log_level"

endif
```

## fw/services/notifications/Kconfig
```kconfig
# SPDX-FileCopyrightText: 2026 Core Devices LLC
# SPDX-License-Identifier: Apache-2.0

config SERVICE_NOTIFICATIONS
    bool "Notifications"
    help
      Notifications, alerts and ANCS.

if SERVICE_NOTIFICATIONS

module = SERVICE_NOTIFICATIONS
module-str = Notifications
source "subsys/logging/Kconfig.template.log_level"

config SERVICE_ALERTS_LOG_LEVEL_RUNTIME
    default y if !RECOVERY_FW

module = SERVICE_ALERTS
module-str = Alert UI
source "subsys/logging/Kconfig.template.log_level"

endif
```

## fw/services/speaker/Kconfig
```kconfig
# SPDX-FileCopyrightText: 2026 Core Devices LLC
# SPDX-License-Identifier: Apache-2.0

config SERVICE_SPEAKER
    bool "Speaker"
    help
      Speaker (PCM/note-sequence) playback service.

if SERVICE_SPEAKER

config SERVICE_SPEAKER_STANDBY_MS
    int "Speaker standby (ms)"
    default 1000 if AUDIO_DA7212
    default 0
    help
      How long the speaker keeps streaming silence after playback before
      it stops, so sounds in quick succession do not restart the audio
      path. The DA7212 path distorts when restarted too often.

module = SERVICE_SPEAKER
module-str = Speaker
source "subsys/logging/Kconfig.template.log_level"

endif
```

## fw/services/sys_work/Kconfig
```kconfig
# SPDX-FileCopyrightText: 2026 Core Devices LLC
# SPDX-License-Identifier: Apache-2.0

config SERVICE_SYS_WORK
    bool "Background work queue"
    help
      Background background work queue runner.

if SERVICE_SYS_WORK

config SERVICE_SYS_WORK_THREAD_RAISED_PRIO
    int "Background work queue thread priority while raised"
    default 3

module = SERVICE_SYS_WORK
module-str = Background work queue
source "subsys/logging/Kconfig.template.log_level"

endif
```

## fw/services/system_task/Kconfig
```kconfig
# SPDX-FileCopyrightText: 2026 Core Devices LLC
# SPDX-License-Identifier: Apache-2.0

config SERVICE_SYSTEM_TASK
    bool "System task"
    help
      Background system task runner.

if SERVICE_SYSTEM_TASK

config SERVICE_SYSTEM_TASK_THREAD_STACK_SIZE
    int "System task thread stack size in bytes"
    default 4096

config SERVICE_SYSTEM_TASK_THREAD_PRIO
    int "System task thread priority"
    default 1

config SERVICE_SYSTEM_TASK_THREAD_RAISED_PRIO
    int "System task thread priority while raised"
    default 3

module = SERVICE_SYSTEM_TASK
module-str = System task
source "subsys/logging/Kconfig.template.log_level"

endif
```

## fw/services/vibe_pattern/Kconfig
```kconfig
# SPDX-FileCopyrightText: 2026 Core Devices LLC
# SPDX-License-Identifier: Apache-2.0

config SERVICE_VIBE_PATTERN
    bool "Vibe pattern"
    help
      Vibration pattern playback service.

if SERVICE_VIBE_PATTERN

config SERVICE_VIBE_PATTERN_MAX_STEPS
    int "Maximum queued vibe pattern steps"
    default 256
    help
      Number of steps that can be queued before a pattern is started. Each
      step takes kernel heap, so this bounds what an app can allocate.

config SERVICE_VIBE_PATTERN_LOG_LEVEL_RUNTIME
    default y if !RECOVERY_FW

module = SERVICE_VIBE_PATTERN
module-str = Vibe pattern
source "subsys/logging/Kconfig.template.log_level"

endif
```

## fw/services/voice/Kconfig
```kconfig
# SPDX-FileCopyrightText: 2026 Core Devices LLC
# SPDX-License-Identifier: Apache-2.0

config SERVICE_VOICE
    bool "Voice"
    default y if MIC
    depends on SERVICE_AUDIO_ENDPOINT && SERVICE_VOICE_ENDPOINT
    select SPEEX
    help
      Voice (dictation) service. Requires a microphone driver (CONFIG_MIC).

if SERVICE_VOICE

module = SERVICE_VOICE
module-str = Voice
source "subsys/logging/Kconfig.template.log_level"

endif
```

## kernel/Kconfig
```kconfig
# SPDX-FileCopyrightText: 2026 Core Devices LLC
# SPDX-License-Identifier: Apache-2.0

menu "Kernel"

config KERNEL_IDLE_STACK_SIZE
	int "Idle thread stack size in bytes"
	default 1024

config KERNEL_MAIN_STACK_SIZE
	int "Main thread stack size in bytes"
	default 4096

config KERNEL_MAIN_THREAD_PRIO
	int "Main thread priority"
	default 3

config KERNEL_SYS_WORKQ_STACK_SIZE
	int "Background work queue stack size in bytes"
	default 4096

config KERNEL_SYS_WORKQ_PRIO
	int "Background work queue priority"
	default 1

config KERNEL_SYS_WORKQ_BOOST_PRIO
	int "Background work queue priority while running boosted work"
	default 3

config KERNEL_SYS_WORKQ_CALLS
	int "Calls with a payload pending at once on the background work queue"
	default 30

config KERNEL_SYS_WORKQ_CALL_TIMEOUT_MS
	int "Time to wait for a background work queue slot before stopping the system"
	default 3000

config KERNEL_SYS_WORKQ_HIGH_CALLS
	int "Calls with a payload pending at once on the high priority work queue"
	default 5

config KERNEL_SYS_WORKQ_HIGH_CALL_TIMEOUT_MS
	int "Time to wait for a high priority work queue slot"
	default 50

config KERNEL_SYS_WORKQ_HIGH_STACK_SIZE
	int "High priority work queue stack size in bytes"
	default 1380

config KERNEL_SYS_WORKQ_HIGH_PRIO
	int "High priority work queue priority"
	default 4

config KERNEL_ISR_STACK_SIZE
	int "ISR stack size in bytes"
	default 1024

config ARCH_HAS_COREDUMP
	bool
	help
	  The architecture can capture its state for a core dump.

config ARCH_HAS_STACK_GUARD
	bool
	help
	  The architecture can trap a thread overflowing its stack.

config KERNEL_STACK_GUARD
	bool "Trap stack overflows"
	default y
	depends on ARCH_HAS_STACK_GUARD
	help
	  Fault as soon as a thread or the ISR stack overflows, instead of
	  corrupting the memory below it. Uses the stack limit registers where
	  the core has them, and otherwise a no-access MPU region below each
	  stack.

config KERNEL_STACK_GUARD_SIZE
	int
	default 128 if KERNEL_STACK_GUARD && !CPU_CORTEX_M_HAS_SPLIM
	default 0
	help
	  Bytes reserved below a stack for its MPU guard, on top of the size the
	  stack is defined with. An exception frame with FP state takes 104 bytes
	  and lazy stacking only writes its lowest 32, so a smaller guard can be
	  skipped without a fault.

config KERNEL_USER_STACK_GUARD_SIZE
	int
	default 32 if KERNEL_STACK_GUARD && !CPU_CORTEX_M_HAS_SPLIM
	default 0
	help
	  MPU guard of a stack only used unprivileged, see
	  pbl_thread_attr::user_stack. Frames that skip it still fault, as they
	  land in memory the thread can't write.

config KERNEL_MPU_REGIONS
	int
	default 12 if SOC_SF32LB52
	default 8
	help
	  MPU slots the core implements. The last four switch with the thread, and
	  the rest take the static regions.

config KERNEL_MPU_IN_FAULTS
	bool
	help
	  Keep the MPU on in the HardFault and NMI handlers.

config KERNEL_TICK_HZ
	int "Tick rate in Hz"
	default 1000 if QEMU || SOC_SF32LB52 || SOC_POSIX
	default 1024

config KERNEL_IRQ_PRIO_KERNEL
	int "NVIC priority of the kernel's interrupts"
	default 255

config KERNEL_IRQ_PRIO_MAX_SYSCALL
	int "Highest NVIC priority allowed to call into the kernel"
	default 191

config NUM_IRQS
	int
	range 1 512
	help
	  Number of SoC interrupt lines, i.e. vector table entries past the
	  core exceptions. Defaulted per SoC in soc/*/Kconfig.defconfig.

config NUM_IRQ_PRIO_BITS
	int
	depends on CPU_CORTEX_M
	range 1 8
	help
	  Number of priority bits implemented by the interrupt controller.
	  Defaulted per SoC in soc/*/Kconfig.defconfig.

config KERNEL_NUM_PRIORITIES
	int "Number of thread priorities"
	default 5

config KERNEL_MAX_THREADS
	int "Maximum number of threads alive at once"
	default 12

config KERNEL_THREAD_TLS_SLOTS
	int "Per-thread pointer slots"
	default 2

config KERNEL_STACK_ALIGN
	int "Thread stack alignment"
	default 128 if KERNEL_STACK_GUARD && !CPU_CORTEX_M_HAS_SPLIM
	default 32
	help
	  Must be a multiple of the stack guard size, which an MPU region can
	  only cover when naturally aligned.

config KERNEL_MUTEX_LOCK_LR
	bool "Record the caller of the outermost mutex lock"
	default y

config ARCH_HAS_DEBUGGER_DETECT
	bool
	help
	  The architecture can tell whether a debugger is attached.

config ARCH_HAS_USERSPACE
	bool
	help
	  The architecture can run threads unprivileged and take syscalls
	  from them.

config USERSPACE
	bool "Unprivileged threads and syscalls"
	default y
	depends on ARCH_HAS_USERSPACE
	help
	  Let threads run unprivileged, confined by the MPU, and enter
	  privileged code only through syscalls, which check every argument
	  they are handed. Without it every thread runs privileged and
	  syscalls are plain calls.

config RAMFUNC
	bool
	help
	  Code and read-only data can be placed in RAM: the .ramfunc
	  section is loaded from flash and copied to RAM at boot. Selected
	  by SoCs that need code to run while flash is unavailable.

endmenu

rsource "arch/arm/Kconfig"
rsource "arch/posix/Kconfig"
```

## kernel/arch/arm/Kconfig
```kconfig
# SPDX-FileCopyrightText: 2026 Core Devices LLC
# SPDX-License-Identifier: Apache-2.0

config CPU_CORTEX_M
	bool
	help
	  ARM Cortex-M core. Selected through the CPU the SoC selects.

config CPU_CORTEX_M4
	bool
	select CPU_CORTEX_M
	select ARMV7_M

config CPU_CORTEX_M33
	bool
	select CPU_CORTEX_M
	select ARMV8_M_MAINLINE

config CPU_STAR_MC1
	bool
	select CPU_CORTEX_M33
	select ARMV8_M_DSP
	help
	  Arm China STAR-MC1, compatible with the Cortex-M33.

config ARMV7_M
	bool
	help
	  ARMv7-M architecture.

config ARMV8_M_MAINLINE
	bool
	select CPU_CORTEX_M_HAS_SPLIM
	help
	  ARMv8-M Mainline architecture.

config ARMV8_M_DSP
	bool
	depends on ARMV8_M_MAINLINE
	help
	  ARMv8-M DSP extension.

config CPU_CORTEX_M_HAS_SPLIM
	bool
	help
	  MSPLIM and PSPLIM stack limit registers.

config CPU_HAS_FPU
	bool
	help
	  Single-precision FPU: FPv4-SP on ARMv7-M, FPv5-SP on ARMv8-M.

config MPU_TYPE_ARMV8M
	bool
	default y if ARMV8_M_MAINLINE

config MPU_TYPE_ARMV7M
	bool
	default y if ARMV7_M
```

## kernel/arch/posix/Kconfig
```kconfig
# SPDX-FileCopyrightText: 2026 Core Devices LLC
# SPDX-License-Identifier: Apache-2.0

config ARCH_POSIX
	bool
	help
	  Kernel threads run as POSIX threads of a host process, one at a
	  time. Selected by the SoC.

config ARCH_POSIX_FIBERS
	bool
	depends on ARCH_POSIX
	help
	  Kernel threads are Emscripten fibers on a single host thread,
	  which runs the kernel until it idles. Selected by hosts without
	  threads to spare, such as a browser.
```
