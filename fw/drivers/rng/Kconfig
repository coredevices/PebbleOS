## fw/drivers/rng/Kconfig
```kconfig
# SPDX-FileCopyrightText: 2026 Core Devices LLC
# SPDX-License-Identifier: Apache-2.0

menuconfig RNG
    bool "Random Number Generator"
    help
      RNG Drivers

if RNG

config RNG_NRF5
    bool "Nordic nRF5"
    default y if SOC_NRF52
    select HAL_NORDIC
    select NIMBLE_TRNG if BT_HCI_NRF52
    help
      Support for the Nordic nRF5 RNG. The driver owns the peripheral, so
      the NimBLE nRF5 controller takes its random numbers from it.

config RNG_SF32LB
    bool "SiFli SF32LB"
    default y if SOC_SF32LB52
    select HAL_SIFLI
    select HAL_SIFLI_RNG
    help
      Support for the SiFli SF32LB RNG.

config RNG_QEMU
    bool "QEMU"
    default y if SOC_QEMU
    help
      QEMU RNG. QEMU emulates no RNG, so it returns a fixed value.

module = DRIVER_RNG
module-str = Random Number Generator
source "subsys/logging/Kconfig.template.log_level"

endif # RNG
```

## fw/drivers/speaker/Kconfig
```kconfig
# SPDX-FileCopyrightText: 2026 Core Devices LLC
# SPDX-License-Identifier: Apache-2.0

menuconfig SPEAKER
    bool "Speaker"
    help
      Speaker (audio output) Drivers

if SPEAKER

config SPEAKER_DA7212
    bool "Dialog DA7212 codec (nRF5 I2S)"
    select HAL_NORDIC
    help
      Support for the Dialog DA7212 audio codec driven over nRF5 I2S.

config SPEAKER_SF32LB
    bool "SiFli SF32LB AUDEC"
    default y if SOC_SF32LB52
    select HAL_SIFLI
    select HAL_SIFLI_AUDCODEC
    select SPEAKER_PLAYBACK_OBSERVER
    help
      Support for the SiFli SF32LB audio codec / DAC speaker output.

config SPEAKER_SF32LB_DIAGNOSTICS
    bool "SF32LB playback flow diagnostics"
    depends on SPEAKER_SF32LB
    help
      Count DMA refills, underrun bytes and dropped writes, and track the
      peak level of the PCM committed to the DAC, for audio bring-up tools.

config SPEAKER_QEMU
    bool "QEMU audio"
    default y if SOC_QEMU
    help
      QEMU audio device backing the speaker for emulated builds.

config SPEAKER_PLAYBACK_OBSERVER
    bool
    help
      The driver implements audio_set_playback_callback().

module = DRIVER_SPEAKER
module-str = Speaker
source "subsys/logging/Kconfig.template.log_level"

endif # SPEAKER
```

## fw/kernel/Kconfig
```kconfig
# SPDX-FileCopyrightText: 2026 Core Devices LLC
# SPDX-License-Identifier: Apache-2.0

config APP_THREAD_PRIO
    int "App thread priority"
    default 2

config WORKER_THREAD_PRIO
    int "Worker thread priority"
    default 1

config PROCESS_SYSCALL_STACK_SIZE
    int "App and worker syscall stack size in bytes"
    default 2048
    depends on USERSPACE
    help
      Privileged stack each process runs its syscalls on. Size it against
      the measured high-water, reported by analytics.

config TASK_TIMER_POOL_SIZE
    int "TaskTimer slab pool size"
    default 192
    help
      Number of TaskTimer slots reserved in .kernel_bss
```

## fw/services/accel_manager/Kconfig
```kconfig
# SPDX-FileCopyrightText: 2026 Core Devices LLC
# SPDX-License-Identifier: Apache-2.0

config SERVICE_ACCEL_MANAGER
    bool "Accelerometer manager"
    help
      Accelerometer data subscription manager.

if SERVICE_ACCEL_MANAGER

config SERVICE_ACCEL_MANAGER_DEFAULT_SENSITIVITY
    int "Default motion sensitivity"
    range 0 100
    default 55
    help
      Tap and shake sensitivity used until the user changes it.

config SERVICE_ACCEL_MANAGER_BATCH_SAMPLES
    int "Max accel samples batched per callback"
    default 125 if ACCEL_LSM6DSO
    default 25
    help
      Maximum number of accelerometer samples delivered to a subscriber per
      callback. Sizes the shared accel buffer. Limited by the accelerometer
      FIFO depth.

module = SERVICE_ACCEL_MANAGER
module-str = Accelerometer manager
source "subsys/logging/Kconfig.template.log_level"

endif
```

## fw/services/activity/Kconfig
```kconfig
# SPDX-FileCopyrightText: 2026 Core Devices LLC
# SPDX-License-Identifier: Apache-2.0

config SERVICE_ACTIVITY
    bool "Activity"
    help
      Activity (step/sleep/workout) tracking service.

if SERVICE_ACTIVITY

config SERVICE_ACTIVITY_BATCH_SAMPLES
    int "Accel samples batched per algorithm update"
    default SERVICE_ACCEL_MANAGER_BATCH_SAMPLES
    help
      Number of accelerometer samples delivered to the activity algorithm
      per callback. The algorithm runs in 5s epochs (125 samples at 25Hz);
      batching a full epoch minimizes wakeups. Defaults to the accel manager
      batch size, which is sized for the accelerometer FIFO depth.

config SERVICE_ACTIVITY_SLEEP_MAX_MINUTE_SCORE
    int "Sleep minute maximum score"
    default 330
    help
      A minute whose weighted VMC score is at most this is a sleep minute.
      Accelerometers with a higher noise floor need a higher value.

config SERVICE_ACTIVITY_SLEEP_MIN_VALID_VMC
    int "Sleep active minute minimum VMC"
    default 20
    help
      A minute whose VMC is above this counts as an active minute of a
      sleep session.

config SERVICE_ACTIVITY_SLEEP_MAX_AVG_VMC
    int "Sleep session maximum average VMC"
    default 180
    help
      A sleep session whose average VMC is above this is rejected.

config SERVICE_ACTIVITY_NOT_WORN_MIN_WORN_VMC
    int "Not-worn minute maximum VMC"
    default 4
    help
      A minute whose VMC is below this may be a minute the watch was not
      worn.

config SERVICE_ACTIVITY_NOT_WORN_MAX_LOW_VMC_RUN_M
    int "Not-worn minimum run length (minutes)"
    default 180
    help
      A run of possibly not-worn minutes at least this long means the watch
      was not worn. Stillness during deep sleep must not reach it.

module = SERVICE_ACTIVITY
module-str = Activity
source "subsys/logging/Kconfig.template.log_level"

endif
```

## fw/services/battery/Kconfig
```kconfig
# SPDX-FileCopyrightText: 2026 Core Devices LLC
# SPDX-License-Identifier: Apache-2.0

config SERVICE_BATTERY
    bool "Battery"
    help
      Battery monitor and state-of-charge estimation.

config NRF_FUEL_GAUGE
    bool "Nordic nRF Fuel Gauge"
    depends on PMIC_NPM1300
    default y if PMIC_NPM1300
    help
      Use the Nordic nRF Fuel Gauge library for state-of-charge
      estimation. Requires the nPM1300 PMIC; selects both the prebuilt
      nonfree fuel-gauge lib and the matching battery service impl.

if SERVICE_BATTERY

config SERVICE_BATTERY_LOW_POWER_PERCENT
    int "Low power threshold (%)"
    range 1 100
    default 2
    help
      Battery percentage below which the watch enters low power mode.

config SERVICE_BATTERY_CAPACITY_HOURS
    int "Battery life (hours)"
    range 1 65535
    default 168
    help
      Approximate hours of battery life on a full charge, used to convert
      between charge percentage and remaining time.

config BATTERY_WARNING_FIRST_PERCENT
    int "First battery warning threshold (%)"
    range 0 100
    default 0
    help
      Battery percentage for the first warning. A value of 0 uses the
      default time-based threshold of 18 hours remaining.

config BATTERY_WARNING_SECOND_PERCENT
    int "Second battery warning threshold (%)"
    range 0 100
    default 0
    help
      Battery percentage for the second warning. A value of 0 uses the
      default time-based threshold of 12 hours remaining.

module = SERVICE_BATTERY
module-str = Battery
source "subsys/logging/Kconfig.template.log_level"

endif
```

## fw/services/boot_splash/Kconfig
```kconfig
# SPDX-FileCopyrightText: 2026 Core Devices LLC
# SPDX-License-Identifier: Apache-2.0

config SERVICE_BOOT_SPLASH
    bool "Boot splash"
    help
      Boot splash screen service.

if SERVICE_BOOT_SPLASH

config SERVICE_BOOT_SPLASH_THREAD_STACK_SIZE
    int "Boot splash thread stack size in bytes"
    default 2048

config SERVICE_BOOT_SPLASH_THREAD_PRIO
    int "Boot splash thread priority"
    default 3

endif
```

## fw/services/clock/Kconfig
```kconfig
# SPDX-FileCopyrightText: 2026 Core Devices LLC
# SPDX-License-Identifier: Apache-2.0

config SERVICE_CLOCK
    bool "Clock"
    help
      Wall-clock time formatting and events.

if SERVICE_CLOCK

config SERVICE_CLOCK_RTC_SAVE_INTERVAL
    int "RTC save interval (seconds)"
    range 1 65535
    default 30 if RTC_RETAINED
    default 600
    help
      How often the wall clock is written to the RTC, besides whenever it
      is set. This bounds the time lost or gained on a reset to the drift
      of the RTC over this interval, or, with an RTC that does not count
      while the system is off, to the interval itself.

choice SERVICE_CLOCK_TZ_STORAGE
    prompt "Timezone storage"
    default SERVICE_CLOCK_TZ_STORAGE_RETAINED if SOC_NRF52
    default SERVICE_CLOCK_TZ_STORAGE_FLASH

config SERVICE_CLOCK_TZ_STORAGE_FLASH
    bool "Flash"
    help
      Keep the timezone in the TZINFO flash region.

config SERVICE_CLOCK_TZ_STORAGE_RETAINED
    bool "Retained registers"
    depends on SOC_NRF52
    help
      Keep the timezone in retained RAM, which survives resets.

endchoice

module = SERVICE_CLOCK
module-str = Clock
source "subsys/logging/Kconfig.template.log_level"

endif
```

## fw/services/compositor/Kconfig
```kconfig
# SPDX-FileCopyrightText: 2026 Core Devices LLC
# SPDX-License-Identifier: Apache-2.0

config SERVICE_COMPOSITOR
    bool "Compositor"
    help
      UI compositor and window transitions.

if SERVICE_COMPOSITOR

config SERVICE_COMPOSITOR_PARTIAL_FRAMES
    bool "Composite app frames from their dirty rectangle"
    default y
    help
      Copy only what an app frame changed into the system framebuffer and
      push only those rows to the display, while the framebuffer still
      holds the previous frame. Disable to composite every app frame in
      full.

config SERVICE_COMPOSITOR_PARTIAL_FRAMES_WHOLE_SCREEN
    bool "Compare the whole screen rather than the dirty rectangle"
    depends on SERVICE_COMPOSITOR_PARTIAL_FRAMES
    help
      Compare every row of an app frame against the previous one instead
      of only the rows within the rectangle the app's drawing marked. For
      compatibility with apps that write pixels into their framebuffer
      without marking them, which the SDK does not support but used to
      show on the next frame, at the cost of comparing the whole screen
      on every frame.

module = SERVICE_COMPOSITOR
module-str = Compositor
source "subsys/logging/Kconfig.template.log_level"

endif
```

## fw/services/event_service/Kconfig
```kconfig
# SPDX-FileCopyrightText: 2026 Core Devices LLC
# SPDX-License-Identifier: Apache-2.0

config SERVICE_EVENT_SERVICE
    bool "Event service"
    help
      Generic event subscription/delivery service.

if SERVICE_EVENT_SERVICE

config SERVICE_EVENT_SERVICE_MAX_PLUGIN_SERVICES
    int "Maximum plugin services"
    default 64
    help
      Number of distinct plugin service UUIDs that can be registered. Each
      one takes kernel heap until reboot.

module = SERVICE_EVENT_SERVICE
module-str = Event service
source "subsys/logging/Kconfig.template.log_level"

endif
```

## fw/services/imaging/Kconfig
```kconfig
# SPDX-FileCopyrightText: 2026 Core Devices LLC
# SPDX-License-Identifier: Apache-2.0

config IMAGE_CACHE
    bool "Cache received images in external RAM"
    depends on PSRAM_IMAGE_POOL
    default y
    help
      Receive album art and notification images into the PSRAM image
      pool instead of the kernel heap, and keep recent ones there
      while the watch is in use, so showing one again needs no
      transfer.

config PSRAM_IDLE_RELEASE_MS
    int "Time the image cache is kept after the last activity (ms)"
    depends on IMAGE_CACHE
    default 5000
    help
      User activity (a button press, the backlight turning on, a track
      change, a notification) holds the PSRAM retained for this long.
      Longer means more cache hits, and more time at about +30 uA.
```

## fw/services/light/Kconfig
```kconfig
# SPDX-FileCopyrightText: 2026 Core Devices LLC
# SPDX-License-Identifier: Apache-2.0

config SERVICE_LIGHT
    bool "Light"
    help
      Backlight control service.

if SERVICE_LIGHT

config SERVICE_LIGHT_BACKLIGHT_ON_PERCENT
    int "Backlight hardware ceiling (%)"
    range 1 100
    default 100
    help
      Hardware brightness that the maximum backlight intensity maps to, as a
      percentage of the driver's full scale.

config SERVICE_LIGHT_DARK_THRESHOLD
    int "Ambient light dark threshold (lux)"
    default 150
    help
      Ambient light level below which it is considered dark. Users can
      override it in the backlight settings.

config SERVICE_LIGHT_DARK_THRESHOLD_DELTA
    int "Ambient light level band (lux)"
    default 25
    help
      Width of the bands around the dark threshold that separate the very
      dark, dark, light and very light levels.

config SERVICE_LIGHT_BACKLIGHT_DEFAULT_COLOR
    hex "Default backlight color (0xRRGGBB)"
    depends on BACKLIGHT_HAS_COLOR
    range 0x0 0xFFFFFF
    default 0xFFFFFF
    help
      Backlight color used until the user picks one.

config ALS_SCREEN_COMPENSATION
    bool "Compensate ALS readings for on-screen luminance"
    depends on AMBIENT_LIGHT && SCREEN_COLOR_DEPTH_BITS_8
    help
      For boards whose ambient light sensor sits under the display, correct the
      raw ALS reading by the transmittance of the pixels in front of the sensor
      (black pixels block ambient light, white pixels pass it). The sensor
      region and black-scale clamp are configured below.

if ALS_SCREEN_COMPENSATION

config ALS_SENSOR_X
    int "ALS sensor region X offset (px)"
    default 0

config ALS_SENSOR_Y
    int "ALS sensor region Y offset (px)"
    default 0

config ALS_SENSOR_W
    int "ALS sensor region width (px)"
    default 0

config ALS_SENSOR_H
    int "ALS sensor region height (px)"
    default 0

config ALS_BLACK_SCALE_Q8
    int "ALS gain when the sensor region is fully black, Q8 (256 = 1.0x)"
    default 256
    help
      Inverse-luminance gain is clamped to this value where the region is black.

endif # ALS_SCREEN_COMPENSATION

module = SERVICE_LIGHT
module-str = Light
source "subsys/logging/Kconfig.template.log_level"

endif
```

## fw/services/log_dump_endpoint/Kconfig
```kconfig
# SPDX-FileCopyrightText: 2026 Core Devices LLC
# SPDX-License-Identifier: Apache-2.0

config SERVICE_LOG_DUMP_ENDPOINT
    bool "Log dump endpoint"
    depends on LOG_BACKEND_FLASH
    help
      Endpoint the phone uses to fetch flash log generations.

if SERVICE_LOG_DUMP_ENDPOINT

module = SERVICE_LOG_DUMP_ENDPOINT
module-str = Log dump endpoint
source "subsys/logging/Kconfig.template.log_level"

endif
```

## fw/services/mic_capture/Kconfig
```kconfig
# SPDX-FileCopyrightText: 2026 Core Devices LLC
# SPDX-License-Identifier: Apache-2.0

config SERVICE_MIC_CAPTURE
    bool "Local microphone capture for apps"
    depends on SERVICE_MIC_MANAGER && SERVICE_BLOB_DB && SERVICE_SERVICES_NORMAL
    default y
```

## fw/services/mic_stream/Kconfig
```kconfig
# SPDX-FileCopyrightText: 2026 Core Devices LLC
# SPDX-License-Identifier: Apache-2.0

config SERVICE_MIC_STREAM
    bool "Microphone streaming for apps"
    depends on SERVICE_MIC_MANAGER && SERVICE_VOICE && SERVICE_AUDIO_ENDPOINT && \
               SERVICE_VOICE_ENDPOINT && SERVICE_SERVICES_NORMAL
    default y
    help
      Streams the foreground app's microphone to the phone, backing the
      mic_stream_to_phone_*() app API.

if SERVICE_MIC_STREAM

module = SERVICE_MIC_STREAM
module-str = Mic stream
source "subsys/logging/Kconfig.template.log_level"

endif
```
