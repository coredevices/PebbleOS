## src/fw/services/put_bytes/Kconfig
```kconfig
# SPDX-FileCopyrightText: 2026 Core Devices LLC
# SPDX-License-Identifier: Apache-2.0

config SERVICE_PUT_BYTES
    bool "Put bytes"
    help
      put_bytes endpoint (incoming binary transfer).

if SERVICE_PUT_BYTES

module = SERVICE_PUT_BYTES
module-str = Put bytes
source "src/fw/Kconfig.template.log_level"

endif
```

## src/fw/services/regular_timer/Kconfig
```kconfig
# SPDX-FileCopyrightText: 2026 Core Devices LLC
# SPDX-License-Identifier: Apache-2.0

config SERVICE_REGULAR_TIMER
    bool "Regular timer"
    help
      Periodic timer service (seconds/minutes ticks).

if SERVICE_REGULAR_TIMER

module = SERVICE_REGULAR_TIMER
module-str = Regular timer
source "src/fw/Kconfig.template.log_level"

endif
```

## src/fw/services/services_common/Kconfig
```kconfig
# SPDX-FileCopyrightText: 2026 Core Devices LLC
# SPDX-License-Identifier: Apache-2.0

config SERVICE_SERVICES_COMMON
    bool "Common services glue"
    help
      Common services init/runlevel glue. Required when any other common
      service is enabled.
```

## src/fw/services/settings/Kconfig
```kconfig
# SPDX-FileCopyrightText: 2026 Core Devices LLC
# SPDX-License-Identifier: Apache-2.0

config SERVICE_SETTINGS
    bool "Settings"
    help
      Settings-file storage service.

if SERVICE_SETTINGS

module = SERVICE_SETTINGS
module-str = Settings
source "src/fw/Kconfig.template.log_level"

endif
```

## src/fw/services/shared_prf_storage/Kconfig
```kconfig
# SPDX-FileCopyrightText: 2026 Core Devices LLC
# SPDX-License-Identifier: Apache-2.0

config SERVICE_SHARED_PRF_STORAGE
    bool "Shared PRF storage"
    help
      Shared storage used by the PRF (recovery) firmware.

if SERVICE_SHARED_PRF_STORAGE

module = SERVICE_SHARED_PRF_STORAGE
module-str = Shared PRF storage
source "src/fw/Kconfig.template.log_level"

endif
```

## src/fw/services/speaker/Kconfig
```kconfig
# SPDX-FileCopyrightText: 2026 Core Devices LLC
# SPDX-License-Identifier: Apache-2.0

config SERVICE_SPEAKER
    bool "Speaker"
    help
      Speaker (PCM/note-sequence) playback service.

if SERVICE_SPEAKER

module = SERVICE_SPEAKER
module-str = Speaker
source "src/fw/Kconfig.template.log_level"

endif
```

## src/fw/services/stationary/Kconfig
```kconfig
# SPDX-FileCopyrightText: 2026 Core Devices LLC
# SPDX-License-Identifier: Apache-2.0

config SERVICE_STATIONARY
    bool "Stationary"
    help
      Stationary (idle-detection) service.
```

## src/fw/services/system_task/Kconfig
```kconfig
# SPDX-FileCopyrightText: 2026 Core Devices LLC
# SPDX-License-Identifier: Apache-2.0

config SERVICE_SYSTEM_TASK
    bool "System task"
    help
      Background system task runner.

if SERVICE_SYSTEM_TASK

module = SERVICE_SYSTEM_TASK
module-str = System task
source "src/fw/Kconfig.template.log_level"

endif
```

## src/fw/services/tick_timer/Kconfig
```kconfig
# SPDX-FileCopyrightText: 2026 Core Devices LLC
# SPDX-License-Identifier: Apache-2.0

config SERVICE_TICK_TIMER
    bool "Tick timer"
    help
      Tick-timer service (wall-clock tick events).

if SERVICE_TICK_TIMER

module = SERVICE_TICK_TIMER
module-str = Tick timer
source "src/fw/Kconfig.template.log_level"

endif
```

## src/fw/services/timeline/Kconfig
```kconfig
# SPDX-FileCopyrightText: 2026 Core Devices LLC
# SPDX-License-Identifier: Apache-2.0

config SERVICE_TIMELINE
    bool "Timeline"
    help
      Timeline service and layouts.

if SERVICE_TIMELINE

module = SERVICE_TIMELINE
module-str = Timeline
source "src/fw/Kconfig.template.log_level"

endif
```

## src/fw/services/timezone_database/Kconfig
```kconfig
# SPDX-FileCopyrightText: 2026 Core Devices LLC
# SPDX-License-Identifier: Apache-2.0

config SERVICE_TIMEZONE_DATABASE
    bool "Timezone database"
    help
      Timezone database service.

if SERVICE_TIMEZONE_DATABASE

module = SERVICE_TIMEZONE_DATABASE
module-str = Timezone database
source "src/fw/Kconfig.template.log_level"

endif
```

## src/fw/services/vibe_pattern/Kconfig
```kconfig
# SPDX-FileCopyrightText: 2026 Core Devices LLC
# SPDX-License-Identifier: Apache-2.0

config SERVICE_VIBE_PATTERN
    bool "Vibe pattern"
    help
      Vibration pattern playback service.

if SERVICE_VIBE_PATTERN

module = SERVICE_VIBE_PATTERN
module-str = Vibe pattern
source "src/fw/Kconfig.template.log_level"

endif
```

## src/fw/services/vibes/Kconfig
```kconfig
# SPDX-FileCopyrightText: 2026 Core Devices LLC
# SPDX-License-Identifier: Apache-2.0

config SERVICE_VIBES
    bool "Vibes"
    help
      Vibe scores / intensity service.

if SERVICE_VIBES

module = SERVICE_VIBES
module-str = Vibes
source "src/fw/Kconfig.template.log_level"

endif
```

## src/fw/services/wakeup/Kconfig
```kconfig
# SPDX-FileCopyrightText: 2026 Core Devices LLC
# SPDX-License-Identifier: Apache-2.0

config SERVICE_WAKEUP
    bool "Wakeup"
    help
      App wakeup scheduling service.

if SERVICE_WAKEUP

module = SERVICE_WAKEUP
module-str = Wakeup
source "src/fw/Kconfig.template.log_level"

endif
```

## src/fw/services/weather/Kconfig
```kconfig
# SPDX-FileCopyrightText: 2026 Core Devices LLC
# SPDX-License-Identifier: Apache-2.0

config SERVICE_WEATHER
    bool "Weather"
    help
      Weather service.

if SERVICE_WEATHER

module = SERVICE_WEATHER
module-str = Weather
source "subsys/logging/Kconfig.template.log_level"

endif
```

## src/fw/soc/sf32lb/Kconfig.defconfig
```kconfig
# SPDX-FileCopyrightText: 2026 Core Devices LLC
# SPDX-License-Identifier: Apache-2.0

if SOC_SF32LB52

config MMAP_RESOURCES
    default y

endif # SOC_SF32LB52
```

## third_party/memfault/Kconfig
```kconfig
# SPDX-FileCopyrightText: 2026 Core Devices LLC
# SPDX-License-Identifier: Apache-2.0

menuconfig MEMFAULT
    bool "Memfault crash reporting"
    default y if RELEASE && !QEMU
    help
      Build the Memfault firmware SDK and emit the MEMFAULT=1 define
      so the firmware compiles in coredump capture, compact logs, and
      metrics collection. Defaults to y for release builds on real
      hardware; off otherwise. Override with
      --kconfig-override CONFIG_MEMFAULT=y|n.

if MEMFAULT

config MEMFAULT_FORCE
    bool "Force Memfault data collection on non-release builds"
    help
      Emit MEMFAULT_FORCE so the firmware uploads coredumps and
      metrics even when not running a release build. Only useful when
      developing the Memfault integration itself.

endif # MEMFAULT
```
