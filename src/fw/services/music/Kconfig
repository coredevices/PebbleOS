## src/fw/services/music/Kconfig
```kconfig
# SPDX-FileCopyrightText: 2026 Core Devices LLC
# SPDX-License-Identifier: Apache-2.0

config SERVICE_MUSIC
    bool "Music"
    help
      Music control service.

if SERVICE_MUSIC

module = SERVICE_MUSIC
module-str = Music
source "subsys/logging/Kconfig.template.log_level"

endif
```

## src/fw/services/new_timer/Kconfig
```kconfig
# SPDX-FileCopyrightText: 2026 Core Devices LLC
# SPDX-License-Identifier: Apache-2.0

config SERVICE_NEW_TIMER
    bool "New timer"
    help
      Legacy "new" timer service.

if SERVICE_NEW_TIMER

module = SERVICE_NEW_TIMER
module-str = New timer
source "src/fw/Kconfig.template.log_level"

endif
```

## src/fw/services/normal/Kconfig
```kconfig
# SPDX-FileCopyrightText: 2026 Core Devices LLC
# SPDX-License-Identifier: Apache-2.0

menu "Normal"

rsource "activity/Kconfig"
rsource "alarms/Kconfig"
rsource "app_cache/Kconfig"
rsource "app_fetch_endpoint/Kconfig"
rsource "app_glances/Kconfig"
rsource "app_inbox_service/Kconfig"
rsource "app_message/Kconfig"
rsource "app_order_endpoint/Kconfig"
rsource "app_outbox_service/Kconfig"
rsource "audio_endpoint/Kconfig"
rsource "blob_db/Kconfig"
rsource "comm_session/Kconfig"
rsource "contacts/Kconfig"
rsource "data_logging/Kconfig"
rsource "filesystem/Kconfig"
rsource "health_sync_endpoint/Kconfig"
rsource "legacy/Kconfig"
rsource "music/Kconfig"
rsource "notifications/Kconfig"
rsource "orientation_manager/Kconfig"
rsource "persist/Kconfig"
rsource "phone_call/Kconfig"
rsource "powermode_service/Kconfig"
rsource "process_management/Kconfig"
rsource "protobuf_log/Kconfig"
rsource "send_text_service/Kconfig"
rsource "services_normal/Kconfig"
rsource "settings/Kconfig"
rsource "speaker/Kconfig"
rsource "stationary/Kconfig"
rsource "timeline/Kconfig"
rsource "timezone_database/Kconfig"
rsource "vibes/Kconfig"
rsource "voice/Kconfig"
rsource "voice_endpoint/Kconfig"
rsource "wakeup/Kconfig"
rsource "weather/Kconfig"

endmenu
```

## src/fw/services/normal/app_cache/Kconfig
```kconfig
# SPDX-FileCopyrightText: 2026 Core Devices LLC
# SPDX-License-Identifier: Apache-2.0

config SERVICE_APP_CACHE
    bool "App cache"
    help
      On-flash app cache.
```

## src/fw/services/normal/app_inbox_service/Kconfig
```kconfig
# SPDX-FileCopyrightText: 2026 Core Devices LLC
# SPDX-License-Identifier: Apache-2.0

config SERVICE_APP_INBOX_SERVICE
    bool "App inbox"
    help
      App inbox messaging service.
```

## src/fw/services/normal/comm_session/Kconfig
```kconfig
# SPDX-FileCopyrightText: 2026 Core Devices LLC
# SPDX-License-Identifier: Apache-2.0

config SERVICE_COMM_SESSION_NORMAL
    bool "Comm session (normal)"
    help
      Normal-firmware extensions to the comm_session service.
```

## src/fw/services/normal/data_logging/Kconfig
```kconfig
# SPDX-FileCopyrightText: 2026 Core Devices LLC
# SPDX-License-Identifier: Apache-2.0

config SERVICE_DATA_LOGGING
    bool "Data logging"
    help
      Data logging (DLS) service.
```

## src/fw/services/normal/notifications/Kconfig
```kconfig
# SPDX-FileCopyrightText: 2026 Core Devices LLC
# SPDX-License-Identifier: Apache-2.0

config SERVICE_NOTIFICATIONS
    bool "Notifications"
    help
      Notifications, alerts and ANCS.
```

## src/fw/services/normal/phone_call/Kconfig
```kconfig
# SPDX-FileCopyrightText: 2026 Core Devices LLC
# SPDX-License-Identifier: Apache-2.0

config SERVICE_PHONE_CALL
    bool "Phone call"
    help
      Phone call (incoming/outgoing) service.
```

## src/fw/services/normal/powermode_service/Kconfig
```kconfig
# SPDX-FileCopyrightText: 2026 Core Devices LLC
# SPDX-License-Identifier: Apache-2.0

config SERVICE_POWERMODE_SERVICE
    bool "Power mode"
    help
      Power-mode (low-power) service.
```

## src/fw/services/normal/process_management/Kconfig
```kconfig
# SPDX-FileCopyrightText: 2026 Core Devices LLC
# SPDX-License-Identifier: Apache-2.0

config SERVICE_PROCESS_MANAGEMENT
    bool "Process management"
    help
      App/process management and app storage.
```

## src/fw/services/normal/services_normal/Kconfig
```kconfig
# SPDX-FileCopyrightText: 2026 Core Devices LLC
# SPDX-License-Identifier: Apache-2.0

config SERVICE_SERVICES_NORMAL
    bool "Normal services glue"
    help
      Normal services init/runlevel glue. Required when any other normal
      service is enabled.
```

## src/fw/services/normal/speaker/Kconfig
```kconfig
# SPDX-FileCopyrightText: 2026 Core Devices LLC
# SPDX-License-Identifier: Apache-2.0

config SERVICE_SPEAKER
    bool "Speaker"
    help
      Speaker (PCM/note-sequence) playback service.
```

## src/fw/services/orientation_manager/Kconfig
```kconfig
# SPDX-FileCopyrightText: 2026 Core Devices LLC
# SPDX-License-Identifier: Apache-2.0

config SERVICE_ORIENTATION_MANAGER
    bool "Orientation manager"
    help
      Device orientation manager.
```

## src/fw/services/persist/Kconfig
```kconfig
# SPDX-FileCopyrightText: 2026 Core Devices LLC
# SPDX-License-Identifier: Apache-2.0

config SERVICE_PERSIST
    bool "Persist"
    help
      App-persistent storage service.

if SERVICE_PERSIST

module = SERVICE_PERSIST
module-str = Persist
source "src/fw/Kconfig.template.log_level"

endif
```

## src/fw/services/phone_call/Kconfig
```kconfig
# SPDX-FileCopyrightText: 2026 Core Devices LLC
# SPDX-License-Identifier: Apache-2.0

config SERVICE_PHONE_CALL
    bool "Phone call"
    help
      Phone call (incoming/outgoing) service.

if SERVICE_PHONE_CALL

module = SERVICE_PHONE_CALL
module-str = Phone call
source "src/fw/Kconfig.template.log_level"

endif
```

## src/fw/services/phone_pp/Kconfig
```kconfig
# SPDX-FileCopyrightText: 2026 Core Devices LLC
# SPDX-License-Identifier: Apache-2.0

config SERVICE_PHONE_PP
    bool "Phone (Pebble Protocol)"
    help
      Phone endpoint over Pebble Protocol.

if SERVICE_PHONE_PP

module = SERVICE_PHONE_PP
module-str = Phone (Pebble Protocol)
source "src/fw/Kconfig.template.log_level"

endif
```

## src/fw/services/pin_lock/Kconfig
```kconfig
# SPDX-FileCopyrightText: 2026 Core Devices LLC
# SPDX-License-Identifier: Apache-2.0

config SERVICE_PIN_LOCK
    bool "PIN Lock"
    help
      PIN lockscreen service.

if SERVICE_PIN_LOCK

module = SERVICE_PIN_LOCK
module-str = PIN Lock
source "src/fw/Kconfig.template.log_level"

endif
```

## src/fw/services/ping/Kconfig
```kconfig
# SPDX-FileCopyrightText: 2026 Core Devices LLC
# SPDX-License-Identifier: Apache-2.0

config SERVICE_PING
    bool "Ping"
    help
      Ping endpoint.

if SERVICE_PING

module = SERVICE_PING
module-str = Ping
source "src/fw/Kconfig.template.log_level"

endif
```

## src/fw/services/poll_remote/Kconfig
```kconfig
# SPDX-FileCopyrightText: 2026 Core Devices LLC
# SPDX-License-Identifier: Apache-2.0

config SERVICE_POLL_REMOTE
    bool "Poll remote"
    help
      Poll-remote service.

if SERVICE_POLL_REMOTE

module = SERVICE_POLL_REMOTE
module-str = Poll remote
source "src/fw/Kconfig.template.log_level"

endif
```

## src/fw/services/powermode_service/Kconfig
```kconfig
# SPDX-FileCopyrightText: 2026 Core Devices LLC
# SPDX-License-Identifier: Apache-2.0

config SERVICE_POWERMODE_SERVICE
    bool "Power mode"
    help
      Power-mode (low-power) service.

if SERVICE_POWERMODE_SERVICE

module = SERVICE_POWERMODE_SERVICE
module-str = Power mode
source "src/fw/Kconfig.template.log_level"

endif
```

## src/fw/services/prf/Kconfig
```kconfig
# SPDX-FileCopyrightText: 2026 Core Devices LLC
# SPDX-License-Identifier: Apache-2.0

menu "PRF"

rsource "idle_watchdog/Kconfig"

endmenu
```

## src/fw/services/prf_update/Kconfig
```kconfig
# SPDX-FileCopyrightText: 2026 Core Devices LLC
# SPDX-License-Identifier: Apache-2.0

config SERVICE_PRF_UPDATE
    bool "PRF update"
    help
      Recovery firmware update service.

if SERVICE_PRF_UPDATE

module = SERVICE_PRF_UPDATE
module-str = PRF update
source "src/fw/Kconfig.template.log_level"

endif
```

## src/fw/services/process_management/Kconfig
```kconfig
# SPDX-FileCopyrightText: 2026 Core Devices LLC
# SPDX-License-Identifier: Apache-2.0

config SERVICE_PROCESS_MANAGEMENT
    bool "Process management"
    help
      App/process management and app storage.

if SERVICE_PROCESS_MANAGEMENT

module = SERVICE_PROCESS_MANAGEMENT
module-str = Process management
source "src/fw/Kconfig.template.log_level"

endif
```

## src/fw/services/protobuf_log/Kconfig
```kconfig
# SPDX-FileCopyrightText: 2026 Core Devices LLC
# SPDX-License-Identifier: Apache-2.0

config SERVICE_PROTOBUF_LOG
    bool "Protobuf log"
    help
      Protobuf-encoded log/data upload service.

if SERVICE_PROTOBUF_LOG

module = SERVICE_PROTOBUF_LOG
module-str = Protobuf log
source "src/fw/Kconfig.template.log_level"

endif
```
