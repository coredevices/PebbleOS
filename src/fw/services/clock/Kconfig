## src/fw/services/clock/Kconfig
```kconfig
# SPDX-FileCopyrightText: 2026 Core Devices LLC
# SPDX-License-Identifier: Apache-2.0

config SERVICE_CLOCK
    bool "Clock"
    help
      Wall-clock time formatting and events.

if SERVICE_CLOCK

module = SERVICE_CLOCK
module-str = Clock
source "src/fw/Kconfig.template.log_level"

endif
```

## src/fw/services/comm_session/Kconfig
```kconfig
# SPDX-FileCopyrightText: 2026 Core Devices LLC
# SPDX-License-Identifier: Apache-2.0

config SERVICE_COMM_SESSION
    bool "Comm session"
    help
      Pebble Protocol communication session management.

if SERVICE_COMM_SESSION

module = SERVICE_COMM_SESSION
module-str = Comm session
source "src/fw/Kconfig.template.log_level"

endif
```

## src/fw/services/common/Kconfig
```kconfig
# SPDX-FileCopyrightText: 2026 Core Devices LLC
# SPDX-License-Identifier: Apache-2.0

menu "Common"

rsource "accel_manager/Kconfig"
rsource "analytics/Kconfig"
rsource "animation_service/Kconfig"
rsource "battery/Kconfig"
rsource "bluetooth/Kconfig"
rsource "boot_splash/Kconfig"
rsource "clock/Kconfig"
rsource "comm_session/Kconfig"
rsource "compositor/Kconfig"
rsource "cron/Kconfig"
rsource "debounced_connection_service/Kconfig"
rsource "ecompass/Kconfig"
rsource "event_service/Kconfig"
rsource "evented_timer/Kconfig"
rsource "firmware_update/Kconfig"
rsource "get_bytes/Kconfig"
rsource "hrm/Kconfig"
rsource "i18n/Kconfig"
rsource "light/Kconfig"
rsource "new_timer/Kconfig"
rsource "phone_pp/Kconfig"
rsource "ping/Kconfig"
rsource "poll_remote/Kconfig"
rsource "prf_update/Kconfig"
rsource "put_bytes/Kconfig"
rsource "registry_endpoint/Kconfig"
rsource "regular_timer/Kconfig"
rsource "services_common/Kconfig"
rsource "shared_prf_storage/Kconfig"
rsource "system_task/Kconfig"
rsource "tick_timer/Kconfig"
rsource "touch/Kconfig"
rsource "vibe_pattern/Kconfig"

endmenu
```

## src/fw/services/common/boot_splash/Kconfig
```kconfig
# SPDX-FileCopyrightText: 2026 Core Devices LLC
# SPDX-License-Identifier: Apache-2.0

config SERVICE_BOOT_SPLASH
    bool "Boot splash"
    help
      Boot splash screen service.
```

## src/fw/services/common/event_service/Kconfig
```kconfig
# SPDX-FileCopyrightText: 2026 Core Devices LLC
# SPDX-License-Identifier: Apache-2.0

config SERVICE_EVENT_SERVICE
    bool "Event service"
    help
      Generic event subscription/delivery service.
```

## src/fw/services/common/get_bytes/Kconfig
```kconfig
# SPDX-FileCopyrightText: 2026 Core Devices LLC
# SPDX-License-Identifier: Apache-2.0

config SERVICE_GET_BYTES
    bool "Get bytes"
    help
      get_bytes endpoint (file/flash/coredump retrieval).
```

## src/fw/services/common/new_timer/Kconfig
```kconfig
# SPDX-FileCopyrightText: 2026 Core Devices LLC
# SPDX-License-Identifier: Apache-2.0

config SERVICE_NEW_TIMER
    bool "New timer"
    help
      Legacy "new" timer service.
```

## src/fw/services/common/registry_endpoint/Kconfig
```kconfig
# SPDX-FileCopyrightText: 2026 Core Devices LLC
# SPDX-License-Identifier: Apache-2.0

config SERVICE_REGISTRY_ENDPOINT
    bool "Registry endpoint"
    help
      Registry endpoint for remote key/value access.
```

## src/fw/services/common/regular_timer/Kconfig
```kconfig
# SPDX-FileCopyrightText: 2026 Core Devices LLC
# SPDX-License-Identifier: Apache-2.0

config SERVICE_REGULAR_TIMER
    bool "Regular timer"
    help
      Periodic timer service (seconds/minutes ticks).
```

## src/fw/services/common/touch/Kconfig
```kconfig
# SPDX-FileCopyrightText: 2026 Core Devices LLC
# SPDX-License-Identifier: Apache-2.0

config SERVICE_TOUCH
    bool "Touch"
    default y if TOUCH
    help
      Touch event service. Requires a touch driver (CONFIG_TOUCH).
```

## src/fw/services/compositor/Kconfig
```kconfig
# SPDX-FileCopyrightText: 2026 Core Devices LLC
# SPDX-License-Identifier: Apache-2.0

config SERVICE_COMPOSITOR
    bool "Compositor"
    help
      UI compositor and window transitions.

if SERVICE_COMPOSITOR

module = SERVICE_COMPOSITOR
module-str = Compositor
source "src/fw/Kconfig.template.log_level"

endif
```

## src/fw/services/cron/Kconfig
```kconfig
# SPDX-FileCopyrightText: 2026 Core Devices LLC
# SPDX-License-Identifier: Apache-2.0

config SERVICE_CRON
    bool "Cron"
    help
      Cron-like scheduler for periodic jobs.

if SERVICE_CRON

module = SERVICE_CRON
module-str = Cron
source "src/fw/Kconfig.template.log_level"

endif
```

## src/fw/services/data_logging/Kconfig
```kconfig
# SPDX-FileCopyrightText: 2026 Core Devices LLC
# SPDX-License-Identifier: Apache-2.0

config SERVICE_DATA_LOGGING
    bool "Data logging"
    help
      Data logging (DLS) service.

if SERVICE_DATA_LOGGING

module = SERVICE_DATA_LOGGING
module-str = Data logging
source "src/fw/Kconfig.template.log_level"

endif
```

## src/fw/services/debounced_connection_service/Kconfig
```kconfig
# SPDX-FileCopyrightText: 2026 Core Devices LLC
# SPDX-License-Identifier: Apache-2.0

config SERVICE_DEBOUNCED_CONNECTION_SERVICE
    bool "Debounced connection service"
    help
      Debounced connection state events.
```

## src/fw/services/ecompass/Kconfig
```kconfig
# SPDX-FileCopyrightText: 2026 Core Devices LLC
# SPDX-License-Identifier: Apache-2.0

config SERVICE_ECOMPASS
    bool "E-compass"
    default y if MAG
    help
      Electronic compass service. Requires a magnetometer driver (CONFIG_MAG).

if SERVICE_ECOMPASS

module = SERVICE_ECOMPASS
module-str = E-compass
source "src/fw/Kconfig.template.log_level"

endif
```

## src/fw/services/event_service/Kconfig
```kconfig
# SPDX-FileCopyrightText: 2026 Core Devices LLC
# SPDX-License-Identifier: Apache-2.0

config SERVICE_EVENT_SERVICE
    bool "Event service"
    help
      Generic event subscription/delivery service.

if SERVICE_EVENT_SERVICE

module = SERVICE_EVENT_SERVICE
module-str = Event service
source "src/fw/Kconfig.template.log_level"

endif
```

## src/fw/services/evented_timer/Kconfig
```kconfig
# SPDX-FileCopyrightText: 2026 Core Devices LLC
# SPDX-License-Identifier: Apache-2.0

config SERVICE_EVENTED_TIMER
    bool "Evented timer"
    help
      Event-loop timer service.

if SERVICE_EVENTED_TIMER

module = SERVICE_EVENTED_TIMER
module-str = Evented timer
source "src/fw/Kconfig.template.log_level"

endif
```

## src/fw/services/filesystem/Kconfig
```kconfig
# SPDX-FileCopyrightText: 2026 Core Devices LLC
# SPDX-License-Identifier: Apache-2.0

config SERVICE_FILESYSTEM
    bool "Filesystem"
    help
      Pebble filesystem (PFS) service.

if SERVICE_FILESYSTEM

module = SERVICE_FILESYSTEM
module-str = Filesystem
source "src/fw/Kconfig.template.log_level"

endif
```

## src/fw/services/firmware_update/Kconfig
```kconfig
# SPDX-FileCopyrightText: 2026 Core Devices LLC
# SPDX-License-Identifier: Apache-2.0

config SERVICE_FIRMWARE_UPDATE
    bool "Firmware update"
    help
      Firmware update endpoint/state machine.

if SERVICE_FIRMWARE_UPDATE

module = SERVICE_FIRMWARE_UPDATE
module-str = Firmware update
source "src/fw/Kconfig.template.log_level"

endif
```

## src/fw/services/gyro_manager/Kconfig
```kconfig
# SPDX-FileCopyrightText: 2026 Dave Bortz
# SPDX-License-Identifier: Apache-2.0

config SERVICE_GYRO_MANAGER
    bool "Gyroscope manager"
    depends on GYRO
    default GYRO
    help
      Gyroscope data subscription manager.

if SERVICE_GYRO_MANAGER

module = SERVICE_GYRO_MANAGER
module-str = Gyroscope manager
source "src/fw/Kconfig.template.log_level"

endif
```

## src/fw/services/health_sync_endpoint/Kconfig
```kconfig
# SPDX-FileCopyrightText: 2026 Core Devices LLC
# SPDX-License-Identifier: Apache-2.0

config SERVICE_HEALTH_SYNC_ENDPOINT
    bool "Health sync endpoint"
    help
      Health data sync endpoint.

if SERVICE_HEALTH_SYNC_ENDPOINT

module = SERVICE_HEALTH_SYNC_ENDPOINT
module-str = Health sync endpoint
source "src/fw/Kconfig.template.log_level"

endif
```

## src/fw/services/hrm/Kconfig
```kconfig
# SPDX-FileCopyrightText: 2026 Core Devices LLC
# SPDX-License-Identifier: Apache-2.0

config SERVICE_HRM
    bool "Heart rate monitor"
    default y if HRM
    help
      Heart rate monitor manager service. Requires an HRM driver (CONFIG_HRM).

if SERVICE_HRM

module = SERVICE_HRM
module-str = Heart rate monitor
source "src/fw/Kconfig.template.log_level"

endif
```

## src/fw/services/idle_watchdog/Kconfig
```kconfig
# SPDX-FileCopyrightText: 2026 Core Devices LLC
# SPDX-License-Identifier: Apache-2.0

config SERVICE_IDLE_WATCHDOG
    bool "Idle watchdog"
    help
      PRF (recovery) idle watchdog service.
```

## src/fw/services/legacy/Kconfig
```kconfig
# SPDX-FileCopyrightText: 2026 Core Devices LLC
# SPDX-License-Identifier: Apache-2.0

config SERVICE_LEGACY
    bool "Legacy persist map"
    help
      Legacy persist-map support.

if SERVICE_LEGACY

module = SERVICE_LEGACY
module-str = Legacy persist map
source "src/fw/Kconfig.template.log_level"

endif
```

## src/fw/services/light/Kconfig
```kconfig
# SPDX-FileCopyrightText: 2026 Core Devices LLC
# SPDX-License-Identifier: Apache-2.0

config SERVICE_LIGHT
    bool "Light"
    help
      Backlight control service.

if SERVICE_LIGHT

config ALS_SCREEN_COMPENSATION
    bool "Compensate ALS readings for on-screen luminance"
    depends on AMBIENT_LIGHT && SCREEN_COLOR_DEPTH_BITS_8
    help
      For boards whose ambient light sensor sits under the display, correct the
      raw ALS reading by the transmittance of the pixels in front of the sensor
      (black pixels block ambient light, white pixels pass it). The sensor
      region and black-scale clamp are configured below.

if ALS_SCREEN_COMPENSATION

config ALS_SENSOR_X
    int "ALS sensor region X offset (px)"
    default 0

config ALS_SENSOR_Y
    int "ALS sensor region Y offset (px)"
    default 0

config ALS_SENSOR_W
    int "ALS sensor region width (px)"
    default 0

config ALS_SENSOR_H
    int "ALS sensor region height (px)"
    default 0

config ALS_BLACK_SCALE_Q8
    int "ALS gain when the sensor region is fully black, Q8 (256 = 1.0x)"
    default 256
    help
      Inverse-luminance gain is clamped to this value where the region is black.

endif # ALS_SCREEN_COMPENSATION

module = SERVICE_LIGHT
module-str = Light
source "src/fw/Kconfig.template.log_level"

endif
```
