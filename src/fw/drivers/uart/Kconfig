## src/fw/drivers/uart/Kconfig
```kconfig
# SPDX-FileCopyrightText: 2026 Core Devices LLC
# SPDX-License-Identifier: Apache-2.0

menuconfig UART
    bool "UART"
    help
      UART Drivers

if UART

config UART_NRF5
    bool "Nordic nRF5 UART Controller"
    default y if SOC_NRF52
    select HAL_NORDIC
    help
      Support for the Nordic nRF5 UART controller.

config UART_SF32LB
    bool "SiFli SF32LB UART Controller"
    default y if SOC_SF32LB52
    select HAL_SIFLI
    select HAL_SIFLI_UART
    help
      Support for the SiFli SF32LB UART controller.

config UART_QEMU
    bool "QEMU Simple UART"
    default y if SOC_QEMU
    help
      Support for the QEMU simple UART peripheral.

module = DRIVER_UART
module-str = UART
source "subsys/logging/Kconfig.template.log_level"

endif # UART
```

## src/fw/drivers/vibe/Kconfig
```kconfig
# SPDX-FileCopyrightText: 2026 Core Devices LLC
# SPDX-License-Identifier: Apache-2.0

menuconfig VIBE
    bool "Vibration Motor"
    help
      Vibration Motor Drivers

if VIBE

config VIBE_AW86225
    bool "Awinic AW86225"
    help
      Support for the Awinic AW86225 haptic driver.

config VIBE_AW86225_RATED_VOLTAGE_MV
    int "LRA rated voltage (mVrms)"
    depends on VIBE_AW86225
    default 1250
    help
      Rated AC drive voltage of the LRA in mV RMS. Full strength drives the
      motor at this voltage, compensated for the supply voltage.

config VIBE_AW86225_OVERDRIVE_VOLTAGE_MV
    int "LRA overdrive voltage (mVrms)"
    depends on VIBE_AW86225
    default VIBE_AW86225_RATED_VOLTAGE_MV
    help
      Drive voltage in mV RMS applied for the first
      VIBE_AW86225_OVERDRIVE_CYCLES cycles of each playback to shorten the
      LRA rise time. Equal to the rated voltage disables overdrive.

config VIBE_AW86225_OVERDRIVE_CYCLES
    int "LRA overdrive cycles"
    depends on VIBE_AW86225
    range 1 15
    default 4

config VIBE_AW8623X
    bool "Awinic AW8623X"
    help
      Support for the Awinic AW8623X haptic driver.

config VIBE_DRV2604
    bool "TI DRV2604"
    help
      Support for the TI DRV2604 haptic driver.

module = DRIVER_VIBE
module-str = Vibration Motor
source "src/fw/Kconfig.template.log_level"

endif # VIBE
```

## src/fw/drivers/watchdog/Kconfig
```kconfig
# SPDX-FileCopyrightText: 2026 Core Devices LLC
# SPDX-License-Identifier: Apache-2.0

menuconfig WATCHDOG
    bool "Watchdog"
    help
      Watchdog Drivers

if WATCHDOG

config WATCHDOG_NRF5
    bool "Nordic nRF5"
    default y if SOC_NRF52
    select HAL_NORDIC
    help
      Support for the Nordic nRF5 watchdog.

config WATCHDOG_SF32LB
    bool "SiFli SF32LB"
    default y if SOC_SF32LB52
    select HAL_SIFLI
    help
      Support for the SiFli SF32LB watchdog.

config WATCHDOG_QEMU
    bool "QEMU Watchdog"
    default y if SOC_QEMU
    help
      Support for the QEMU watchdog (no-op).

endif # WATCHDOG
```

## src/fw/services/app_permissions/Kconfig
```kconfig
# SPDX-FileCopyrightText: 2026 Core Devices LLC
# SPDX-License-Identifier: Apache-2.0

config SERVICE_APP_PERMISSIONS
    bool "App permissions"
    depends on SERVICE_BLOB_DB
    help
      Per-app permission grants (microphone, ...) pushed by the phone and
      enforced by the firmware.

if SERVICE_APP_PERMISSIONS

module = SERVICE_APP_PERMISSIONS
module-str = App permissions
source "subsys/logging/Kconfig.template.log_level"

endif
```

## src/fw/services/audio_encoder/Kconfig
```kconfig
# SPDX-FileCopyrightText: 2026 Core Devices LLC
# SPDX-License-Identifier: Apache-2.0

config SERVICE_AUDIO_ENCODER
    bool "Audio encoder"
    help
      Codec-agnostic speech encoder shared by dictation and the app
      Microphone API. Backends: Speex (CONFIG_SPEEX).

if SERVICE_AUDIO_ENCODER

module = SERVICE_AUDIO_ENCODER
module-str = Audio encoder
source "subsys/logging/Kconfig.template.log_level"

endif
```

## src/fw/services/battery/Kconfig
```kconfig
# SPDX-FileCopyrightText: 2026 Core Devices LLC
# SPDX-License-Identifier: Apache-2.0

config SERVICE_BATTERY
    bool "Battery"
    help
      Battery monitor and state-of-charge estimation.

choice BATTERY_SOC
    prompt "State-of-charge estimation"
    default NRF_FUEL_GAUGE if PMIC_NPM1300
    default BATTERY_SOC_VOLTAGE

config BATTERY_SOC_VOLTAGE
    bool "Voltage curve"
    help
      Look the state of charge up in a voltage curve.

config NRF_FUEL_GAUGE
    bool "Nordic nRF Fuel Gauge"
    depends on PMIC_NPM1300
    help
      Use the Nordic nRF Fuel Gauge library for state-of-charge
      estimation. Requires the nPM1300 PMIC; selects both the prebuilt
      nonfree fuel-gauge lib and the matching battery service impl.

config BATTERY_SOC_FUEL_GAUGE
    bool "Fuel gauge"
    depends on PMIC_NPM1300
    select FUEL_GAUGE
    help
      Use the open fuel gauge (subsys/fuel_gauge) with the cell model of
      the board.

endchoice

if SERVICE_BATTERY

config BATTERY_WARNING_FIRST_PERCENT
    int "First battery warning threshold (%)"
    range 0 100
    default 0
    help
      Battery percentage for the first warning. A value of 0 uses the
      default time-based threshold of 18 hours remaining.

config BATTERY_WARNING_SECOND_PERCENT
    int "Second battery warning threshold (%)"
    range 0 100
    default 0
    help
      Battery percentage for the second warning. A value of 0 uses the
      default time-based threshold of 12 hours remaining.

module = SERVICE_BATTERY
module-str = Battery
source "subsys/logging/Kconfig.template.log_level"

endif
```

## src/fw/services/i18n/Kconfig
```kconfig
# SPDX-FileCopyrightText: 2026 Core Devices LLC
# SPDX-License-Identifier: Apache-2.0

config SERVICE_I18N
    bool "Internationalization"
    help
      Internationalization (gettext) runtime support for installed
      language packs. Firmware includes only the English source strings.

if SERVICE_I18N

module = SERVICE_I18N
module-str = Internationalization
source "subsys/logging/Kconfig.template.log_level"

endif
```

## src/fw/services/mic_capture/Kconfig
```kconfig
# SPDX-FileCopyrightText: 2026 Core Devices LLC
# SPDX-License-Identifier: Apache-2.0

config SERVICE_MIC_CAPTURE
    bool "Microphone capture for apps"
    depends on SERVICE_MIC_MANAGER && SERVICE_APP_PERMISSIONS && SERVICE_AUDIO_ENCODER
    default y
    help
      Live PCM capture service backing the app microphone API.

if SERVICE_MIC_CAPTURE

module = SERVICE_MIC_CAPTURE
module-str = Mic capture
source "subsys/logging/Kconfig.template.log_level"

endif
```

## src/fw/services/mic_manager/Kconfig
```kconfig
# SPDX-FileCopyrightText: 2026 Core Devices LLC
# SPDX-License-Identifier: Apache-2.0

config SERVICE_MIC_MANAGER
    bool "Microphone manager"
    depends on MIC
    default y
    help
      Arbitrates the microphone between dictation and app capture.

if SERVICE_MIC_MANAGER

module = SERVICE_MIC_MANAGER
module-str = Mic manager
source "subsys/logging/Kconfig.template.log_level"

endif
```

## src/fw/services/notifications/Kconfig
```kconfig
# SPDX-FileCopyrightText: 2026 Core Devices LLC
# SPDX-License-Identifier: Apache-2.0

config SERVICE_NOTIFICATIONS
    bool "Notifications"
    help
      Notifications, alerts and ANCS.

if SERVICE_NOTIFICATIONS

config NOTIFICATION_SOUND_SAMPLES
    bool "Sampled notification sounds"
    depends on SPEAKER
    default y
    help
      Include the sampled (PCM) notification sounds. Costs ~55 KB of code
      flash; boards with a 1 MB code budget keep only the synthesized
      chirps.

module = SERVICE_NOTIFICATIONS
module-str = Notifications
source "subsys/logging/Kconfig.template.log_level"

endif
```

## src/fw/services/touch/Kconfig
```kconfig
# SPDX-FileCopyrightText: 2026 Core Devices LLC
# SPDX-License-Identifier: Apache-2.0

config SERVICE_TOUCH
    bool "Touch"
    depends on TOUCH
    default y
    help
      Touch event service. Requires a touch driver (CONFIG_TOUCH).

if SERVICE_TOUCH

module = SERVICE_TOUCH
module-str = Touch
source "subsys/logging/Kconfig.template.log_level"

endif
```

## src/fw/services/voice/Kconfig
```kconfig
# SPDX-FileCopyrightText: 2026 Core Devices LLC
# SPDX-License-Identifier: Apache-2.0

config SERVICE_VOICE
    bool "Voice"
    default y if MIC
    select SPEEX
    help
      Voice (dictation) service. Requires a microphone driver (CONFIG_MIC).

if SERVICE_VOICE

module = SERVICE_VOICE
module-str = Voice
source "subsys/logging/Kconfig.template.log_level"

endif
```

## src/fw/services/voice_endpoint/Kconfig
```kconfig
# SPDX-FileCopyrightText: 2026 Core Devices LLC
# SPDX-License-Identifier: Apache-2.0

config SERVICE_VOICE_ENDPOINT
    bool "Voice endpoint"
    select SPEEX
    help
      Voice endpoint (phone-side voice transport).

if SERVICE_VOICE_ENDPOINT

module = SERVICE_VOICE_ENDPOINT
module-str = Voice endpoint
source "subsys/logging/Kconfig.template.log_level"

endif
```

## subsys/Kconfig
```kconfig
# SPDX-FileCopyrightText: 2026 Core Devices LLC
# SPDX-License-Identifier: Apache-2.0

rsource "analytics/Kconfig"
rsource "bluetooth/Kconfig"
rsource "console/Kconfig"
rsource "coredump/Kconfig"
rsource "crc/Kconfig"
rsource "cron/Kconfig"
rsource "fs/Kconfig"
rsource "i18n/Kconfig"
rsource "input/Kconfig"
rsource "loader/Kconfig"
rsource "logging/Kconfig"
rsource "pp/Kconfig"
rsource "profiler/Kconfig"
rsource "samsa/Kconfig"
rsource "settings/Kconfig"
rsource "shell/Kconfig"
rsource "task_wdt/Kconfig"
```

## subsys/analytics/Kconfig
```kconfig
# SPDX-FileCopyrightText: 2026 Core Devices LLC
# SPDX-License-Identifier: Apache-2.0

config ANALYTICS
    bool "Analytics"
    depends on SERVICE_DATA_LOGGING
    help
      Firmware analytics and telemetry.

if ANALYTICS

module = ANALYTICS
module-str = Analytics
source "subsys/logging/Kconfig.template.log_level"

endif
```

## subsys/bluetooth/Kconfig
```kconfig
# SPDX-FileCopyrightText: 2026 Core Devices LLC
# SPDX-License-Identifier: Apache-2.0

menu "Bluetooth"

config BT
    bool
    default y
    select MBEDTLS
    help
      The Bluetooth subsystem: the NimBLE host and the PebbleOS glue
      around it.

if BT

choice BT_HCI
    prompt "HCI transport"
    default BT_HCI_FAKE
    help
      How the NimBLE host reaches its controller. The default is derived
      from the SoC (see each soc/<soc>/Kconfig.defconfig); the fake
      controller is the fallback where there is no radio.

config BT_HCI_NRF52
    bool "NimBLE controller on the nRF52 radio"
    depends on SOC_NRF52
    help
      Run the NimBLE link layer in the same image, on the nRF52 radio.

config BT_HCI_SF32LB52
    bool "SiFli LCPU over IPC"
    depends on SOC_SF32LB52
    select HAL_SIFLI_IPC_QUEUE
    select HAL_SIFLI_LCPU
    help
      Talk H4 HCI to the SiFli controller running on the LCPU through the
      mailbox IPC queue.

config BT_HCI_UART
    bool "H4 over UART"
    depends on QEMU
    help
      Talk H4 HCI to an external controller over the board's BT_HCI_UART.
      On QEMU this is the fourth serial port, which can be attached to a
      host controller such as an nRF52840 dongle running Zephyr's hci_uart.

config BT_HCI_FAKE
    bool "Fake controller"
    help
      Answer every HCI command locally with success and never raise an
      event. The host synchronises and the GATT server runs, but no link
      can be established. For targets without a radio, such as QEMU.

endchoice

choice BT_ID_ADDR_SOURCE
    prompt "Identity address"
    default BT_ID_ADDR_CONTROLLER
    help
      Where the watch's Bluetooth identity address comes from. The default
      is derived from the SoC (see each soc/<soc>/Kconfig.defconfig).

config BT_ID_ADDR_CONTROLLER
    bool "Controller"
    help
      Use the address the controller reports, or let NimBLE pick one.

config BT_ID_ADDR_SF32LB52_EFUSE
    bool "SF32LB52 eFUSE"
    depends on SOC_SF32LB52
    select BT_ID_ADDR
    help
      Public address derived from the unique ID in the SoC's eFUSE.

config BT_ID_ADDR_STORAGE
    bool "Stored random static address"
    depends on SERVICE_SHARED_PRF_STORAGE
    select BT_ID_ADDR
    help
      Generate a random static address once and keep it in shared PRF
      storage, for controllers without an address of their own.

endchoice

config BT_ID_ADDR
    bool
    help
      An identity address backend is selected (pbl/bluetooth/id_addr.h).

module = BT
module-str = Bluetooth
source "subsys/logging/Kconfig.template.log_level"

config BT_GH3X2X_TUNING_SERVICE
    bool "GH3X2X tuning service"
    depends on HRM_GH3X2X
    help
      Build the GH3X2X heart-rate sensor tuning GATT service, used to
      tune the sensor over BLE. Off by default.

endif

endmenu
```

## subsys/bluetooth/services/Kconfig
```kconfig
# SPDX-FileCopyrightText: 2026 Core Devices LLC
# SPDX-License-Identifier: Apache-2.0

menu "Services"

rsource "bas/Kconfig"
rsource "dis/Kconfig"
rsource "ppog_reversed/Kconfig"
rsource "pps/Kconfig"

endmenu
```

## subsys/bluetooth/services/bas/Kconfig
```kconfig
# SPDX-FileCopyrightText: 2026 Core Devices LLC
# SPDX-License-Identifier: Apache-2.0

config BT_SERVICE_BAS
    bool "Battery Service"
    default y
    select NIMBLE_BLE_SVC_BAS
    help
      Standard GATT Battery Service, reporting the battery level
      (pbl/bluetooth/bas.h).
```

## subsys/bluetooth/services/dis/Kconfig
```kconfig
# SPDX-FileCopyrightText: 2026 Core Devices LLC
# SPDX-License-Identifier: Apache-2.0

config BT_SERVICE_DIS
    bool "Device Information Service"
    default y
    select NIMBLE_BLE_SVC_DIS
    help
      Standard GATT Device Information Service, with the model, serial
      number, firmware and software revisions and manufacturer
      (pbl/bluetooth/dis.h).
```

## subsys/bluetooth/services/gh3x2x_tuning/Kconfig
```kconfig
# SPDX-FileCopyrightText: 2026 Core Devices LLC
# SPDX-License-Identifier: Apache-2.0

config BT_SERVICE_GH3X2X_TUNING
    bool "GH3X2X tuning service"
    depends on HRM_GH3X2X
    help
      GH3X2X heart-rate sensor tuning GATT service, used to tune the
      sensor over BLE. Off by default.
```

## subsys/bluetooth/services/ppog_reversed/Kconfig
```kconfig
# SPDX-FileCopyrightText: 2026 Core Devices LLC
# SPDX-License-Identifier: Apache-2.0

config BT_SERVICE_PPOG_REVERSED
    bool "Reversed PPoGATT service"
    default y
    help
      PPoGATT service hosted by the watch, for phones whose GATT server
      API is broken (pbl/bluetooth/ppog_reversed.h).
```

## subsys/bluetooth/services/pps/Kconfig
```kconfig
# SPDX-FileCopyrightText: 2026 Core Devices LLC
# SPDX-License-Identifier: Apache-2.0

config BT_SERVICE_PPS
    bool "Pebble Pairing Service"
    default y
    help
      GATT service through which the phone app checks the connection
      status and triggers pairing (pbl/bluetooth/pebble_pairing_service.h).
```

## subsys/boot/Kconfig
```kconfig
# SPDX-FileCopyrightText: 2026 Core Devices LLC
# SPDX-License-Identifier: Apache-2.0

menuconfig BOOT
    bool "Bootloader interface"
    default y
    depends on RETAINED
    help
      Boot bits and bootloader version, shared with the bootloader.

if BOOT

config BOOT_BOOTBITS_RETAINED_REG
    int "Boot bits retained register"
    default 0 if SOC_NRF52
    default 2 if SOC_SF32LB52
    default 1
    help
      Retained register holding the boot bits. It must match the one the
      bootloader uses. QEMU writes its settings to register 0.

config BOOT_VERSION_RETAINED_REG
    int "Bootloader version retained register"
    depends on !PBLBOOT
    default 2
    help
      Retained register the bootloader writes its version to.

endif # BOOT
```

## subsys/console/Kconfig
```kconfig
# SPDX-FileCopyrightText: 2026 Core Devices LLC
# SPDX-License-Identifier: Apache-2.0

config CONSOLE
    bool "Serial console"
    default y if !RELEASE || MFG
    help
      Text console on the board's console port, CONSOLE_UART: logs and
      the shell. Off on release firmware, which leaves the port unused.

config CONSOLE_BAUDRATE
    int "Console baud rate"
    depends on CONSOLE
    default 1000000
    help
      Line rate of the board's console port, CONSOLE_UART.
```
