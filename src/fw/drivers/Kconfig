## src/fw/drivers/Kconfig
```kconfig
# SPDX-FileCopyrightText: 2026 Core Devices LLC
# SPDX-License-Identifier: Apache-2.0

menu "Drivers"

rsource "ambient/Kconfig"
rsource "i2c/Kconfig"
rsource "led_controller/Kconfig"
rsource "mic/Kconfig"
rsource "pmic/Kconfig"
rsource "uart/Kconfig"
rsource "vibe/Kconfig"

endmenu
```

## src/fw/drivers/ambient/Kconfig
```kconfig
# SPDX-FileCopyrightText: 2026 Core Devices LLC
# SPDX-License-Identifier: Apache-2.0

menuconfig AMBIENT_LIGHT
    bool "Ambient Light Sensor"
    help
      Ambient Light Sensor Drivers

if AMBIENT_LIGHT

config AMBIENT_LIGHT_OPT3001
    bool "TI OPT3001"
    help
      Support for the TI OPT3001 ambient light sensor.

config AMBIENT_LIGHT_W1160
    bool "W1160"
    help
      Support for the W1160 ambient light sensor.

config AMBIENT_LIGHT_BITS
    int "Ambient light sensor resolution (bits)"
    default 12 if AMBIENT_LIGHT_OPT3001
    default 16 if AMBIENT_LIGHT_W1160
    help
      Number of bits in the ambient light sensor reading. Used to derive
      AMBIENT_LIGHT_LEVEL_MAX, which bounds the dark/backlight thresholds
      exposed to the shell and settings UI.

endif # AMBIENT_LIGHT
```

## src/fw/drivers/backlight/Kconfig
```kconfig
# SPDX-FileCopyrightText: 2026 Core Devices LLC
# SPDX-License-Identifier: Apache-2.0

menuconfig BACKLIGHT
    bool "Backlight"
    help
      Backlight Drivers

if BACKLIGHT

config BACKLIGHT_HAS_COLOR
    bool
    help
      Backlight drivers that support color should select this Kconfig symbol.

config BACKLIGHT_AW2016
    bool "AW2016"
    depends on I2C
    select BACKLIGHT_HAS_COLOR
    help
      Support for the AW2016 LED controller.

config BACKLIGHT_AW9364E
    bool "AW9364E"
    help
      Support for the AW9364E LED controller.

config BACKLIGHT_PWM
    bool "PWM"
    help
      Support for a backlight driven by a PWM peripheral.

config BACKLIGHT_QEMU
    bool "QEMU"
    help
      Emulated backlight controller that writes to the QEMU
      pebble-display MMIO registers.

config BACKLIGHT_QEMU_COLOR
    bool "QEMU Color"
    depends on BACKLIGHT_QEMU
    select BACKLIGHT_HAS_COLOR
    help
      Enable support for RGB backlight colors in the QEMU backlight driver.
  
endif # BACKLIGHT
```

## src/fw/drivers/battery/Kconfig
```kconfig
# SPDX-FileCopyrightText: 2026 Core Devices LLC
# SPDX-License-Identifier: Apache-2.0

menuconfig BATTERY
    bool "Battery"
    help
      Battery Drivers

if BATTERY

config BATTERY_PMIC
    bool "PMIC-based"
    help
      Battery management via external PMIC. Used on platforms where the
      PMIC handles battery monitoring (asterix, obelix, getafix).

config BATTERY_STM32F4
    bool "STM32F4 ADC-based"
    help
      Battery monitoring via STM32F4 ADC and PMIC.

endif # BATTERY
```

## src/fw/drivers/cpumode/Kconfig
```kconfig
# SPDX-FileCopyrightText: 2026 Core Devices LLC
# SPDX-License-Identifier: Apache-2.0

menuconfig CPUMODE
    bool "CPU Mode"
    help
      CPU performance mode

if CPUMODE

config CPUMODE_SF32LB
    bool "SF32LB"
    help
      CPU performance mode for SF32LB platforms.

config CPUMODE_STUB
    bool "Stub"
    help
      Stub CPU performance mode.

endif # CPUMODE
```

## src/fw/drivers/dma/Kconfig
```kconfig
# SPDX-FileCopyrightText: 2026 Core Devices LLC
# SPDX-License-Identifier: Apache-2.0

menuconfig DMA
    bool "DMA"
    help
      DMA Drivers

if DMA

config DMA_NRF5
    bool "Nordic nRF5 DMA Controller"
    help
      Support for the Nordic nRF5 DMA controller.

config DMA_SF32LB
    bool "SiFli SF32LB DMA Controller"
    help
      Support for the SiFli SF32LB DMA controller.

endif # DMA
```

## src/fw/drivers/hrm/Kconfig
```kconfig
# SPDX-FileCopyrightText: 2026 Core Devices LLC
# SPDX-License-Identifier: Apache-2.0

menuconfig HRM
    bool "Heart Rate Monitor"
    help
      Heart Rate Monitor Drivers

if HRM

config HRM_GH3X2X
    bool "Goodix GH3X2X"
    help
      Support for the Goodix GH3X2X heart rate sensor.
config HRM_HRV
    bool "HRV (RR interval) support"
    depends on HRM_GH3X2X
    default n
    help
      Expose heart-rate-variability (RR/inter-beat interval) data from the
      HRM sensor. Enables the Goodix HRV algorithm and links the nonfree
      HRV library. Off by default; HRV is only sampled while an app holds
      an HRV subscription.
config HRM_STUB
    bool "Stub"
    help
      Stub heart rate monitor implementation.

module = DRIVER_HRM
module-str = Heart Rate Monitor
source "subsys/logging/Kconfig.template.log_level"

endif # HRM
```

## src/fw/drivers/imu/Kconfig
```kconfig
# SPDX-FileCopyrightText: 2026 Core Devices LLC
# SPDX-License-Identifier: Apache-2.0

menu "IMU"

choice ACCEL
    prompt "Accelerometer"
    optional

config ACCEL_BMA255
    bool "Bosch BMA255"
    help
      Support for the Bosch BMA255 accelerometer.

config ACCEL_BMI160
    bool "Bosch BMI160"
    help
      Support for the Bosch BMI160 accelerometer/gyroscope.

config ACCEL_LIS2DW12
    bool "ST LIS2DW12"
    help
      Support for the ST LIS2DW12 accelerometer.

config ACCEL_LSM6DSO
    bool "ST LSM6DSO"
    help
      Support for the ST LSM6DSO accelerometer/gyroscope.

endchoice

if ACCEL_LIS2DW12

config ACCEL_LIS2DW12_DISABLE_ADDR_PULLUP
    bool "Disable ADDR pin pull-up"
    help
      Disable the internal pull-up resistor on the ADDR pin.

config ACCEL_LIS2DW12_WK_DUR_DEFAULT
    int "Default wake duration"
    range 0 3
    default 0
    help
      Default wake duration applied at init.

config ACCEL_LIS2DW12_WK_THS_MIN
    int "Minimum wake threshold"
    range 0 63
    default 0
    help
      Minimum (highest sensitivity) wake-up threshold.

config ACCEL_LIS2DW12_WK_THS_MAX
    int "Maximum wake threshold"
    range 0 63
    default 63
    help
      Maximum (lowest sensitivity) wake-up threshold.

config ACCEL_LIS2DW12_WK_THS_DEFAULT
    int "Default wake threshold"
    range 0 63
    default 0
    help
      Default wake-up threshold applied at init.

config ACCEL_LIS2DW12_SCALE_MG
    int "Full-scale range (mg)"
    default 2000
    help
      Acceleration full-scale range in mg (2000, 4000, 8000 or 16000).

endif # ACCEL_LIS2DW12

if ACCEL_LSM6DSO

config ACCEL_LSM6DSO_WK_DUR_DEFAULT
    int "Default wake duration"
    range 0 3
    default 0
    help
      Default wake duration applied at init.

config ACCEL_LSM6DSO_WK_THS_MIN
    int "Minimum wake threshold"
    range 0 63
    default 0
    help
      Minimum (highest sensitivity) wake-up threshold.

config ACCEL_LSM6DSO_WK_THS_MAX
    int "Maximum wake threshold"
    range 0 63
    default 63
    help
      Maximum (lowest sensitivity) wake-up threshold.

config ACCEL_LSM6DSO_WK_THS_DEFAULT
    int "Default wake threshold"
    range 0 63
    default 0
    help
      Default wake-up threshold applied at init.

config ACCEL_LSM6DSO_SCALE_MG
    int "Full-scale range (mg)"
    default 2000
    help
      Acceleration full-scale range in mg (2000, 4000, 8000 or 16000).

endif # ACCEL_LSM6DSO

menuconfig MAG
    bool "Magnetometer"
    help
      Magnetometer Drivers

if MAG

choice MAG_DRIVER
    prompt "Magnetometer Driver"

config MAG_MAG3110
    bool "Freescale MAG3110"
    help
      Support for the Freescale MAG3110 magnetometer.

config MAG_MMC5603NJ
    bool "MEMSIC MMC5603NJ"
    help
      Support for the MEMSIC MMC5603NJ magnetometer.

endchoice

endif # MAG

module = DRIVER_IMU
module-str = IMU
source "src/fw/Kconfig.template.log_level"

endmenu
```

## src/fw/drivers/led_controller/Kconfig
```kconfig
# SPDX-FileCopyrightText: 2026 Core Devices LLC
# SPDX-License-Identifier: Apache-2.0

menuconfig LED_CONTROLLER
    bool "LED Controller"
    help
      LED Controller Drivers

if LED_CONTROLLER

config LED_CONTROLLER_AW2016
    bool "AW2016"
    depends on I2C
    help
      Support for the AW2016 LED controller.

config LED_CONTROLLER_AW9364E
    bool "AW9364E"
    help
      Support for the AW9364E LED controller.

config LED_CONTROLLER_QEMU
    bool "QEMU"
    help
      Emulated RGB backlight controller that writes to the QEMU
      pebble-display MMIO registers.

endif # LED_CONTROLLER
```

## src/fw/drivers/pmic/Kconfig
```kconfig
# SPDX-FileCopyrightText: 2026 Core Devices LLC
# SPDX-License-Identifier: Apache-2.0

menuconfig PMIC
    bool "PMIC"
    help
      PMIC Drivers

if PMIC

config PMIC_NPM1300
    bool "Nordic nPM1300"
    help
      Support for the Nordic nPM1300 PMIC.

endif # PMIC
```

## src/fw/drivers/pressure/Kconfig
```kconfig
# SPDX-FileCopyrightText: 2026 Core Devices LLC
# SPDX-License-Identifier: Apache-2.0

menuconfig PRESSURE
    bool "Pressure Sensor"
    help
      Pressure Sensor Drivers

if PRESSURE

config PRESSURE_BMP390
    bool "Bosch BMP390"
    help
      Support for the Bosch BMP390 barometric pressure sensor.

endif # PRESSURE
```

## src/fw/pm/Kconfig
```kconfig
# SPDX-FileCopyrightText: 2026 Core Devices LLC
# SPDX-License-Identifier: Apache-2.0

menuconfig PM
    bool "Power Management Subsystem"
    default y
    help
      Enable power management subsystem. This provides Zephyr-style power
      management features including device power management, suspend/resume,
      and shutdown notifications.

if PM

config PM_DEBUG
    bool "PM Debug Logging"
    default n
    help
      Enable debug logging for power management subsystem.

config PM_NOTIFIER
    bool "PM Notifier"
    default y
    help
      Enable the PM notifier subsystem which allows modules to register
      callbacks for power management events (suspend, resume, shutdown).

config PM_SHUTDOWN
    bool "PM Shutdown Integration"
    default y
    help
      Enable integration with the shutdown subsystem.

module = PM
module-str = pm
source "src/fw/Kconfig.template.log_level"

endif # PM
```

## src/fw/services/Kconfig
```kconfig
# SPDX-FileCopyrightText: 2026 Core Devices LLC
# SPDX-License-Identifier: Apache-2.0

menu "Services"

rsource "common/Kconfig"
rsource "normal/Kconfig"
rsource "prf/Kconfig"

endmenu
```

## src/fw/services/accel_manager/Kconfig
```kconfig
# SPDX-FileCopyrightText: 2026 Core Devices LLC
# SPDX-License-Identifier: Apache-2.0

config SERVICE_ACCEL_MANAGER
    bool "Accelerometer manager"
    help
      Accelerometer data subscription manager.

if SERVICE_ACCEL_MANAGER

module = SERVICE_ACCEL_MANAGER
module-str = Accelerometer manager
source "src/fw/Kconfig.template.log_level"

endif
```

## src/fw/services/activity/Kconfig
```kconfig
# SPDX-FileCopyrightText: 2026 Core Devices LLC
# SPDX-License-Identifier: Apache-2.0

config SERVICE_ACTIVITY
    bool "Activity"
    help
      Activity (step/sleep/workout) tracking service.

if SERVICE_ACTIVITY

config SERVICE_ACTIVITY_BATCH_SAMPLES
    int "Accel samples batched per algorithm update"
    default SERVICE_ACCEL_MANAGER_BATCH_SAMPLES
    help
      Number of accelerometer samples delivered to the activity algorithm
      per callback. The algorithm runs in 5s epochs (125 samples at 25Hz);
      batching a full epoch minimizes wakeups. Defaults to the accel manager
      batch size, which is sized for the accelerometer FIFO depth.

module = SERVICE_ACTIVITY
module-str = Activity
source "subsys/logging/Kconfig.template.log_level"

endif
```

## src/fw/services/alarms/Kconfig
```kconfig
# SPDX-FileCopyrightText: 2026 Core Devices LLC
# SPDX-License-Identifier: Apache-2.0

config SERVICE_ALARMS
    bool "Alarms"
    help
      Alarms service.
```

## src/fw/services/analytics/Kconfig
```kconfig
# SPDX-FileCopyrightText: 2026 Core Devices LLC
# SPDX-License-Identifier: Apache-2.0

config SERVICE_ANALYTICS
    bool "Analytics"
    help
      Firmware analytics and telemetry.

if SERVICE_ANALYTICS

module = SERVICE_ANALYTICS
module-str = Analytics
source "src/fw/Kconfig.template.log_level"

endif
```

## src/fw/services/animation_service/Kconfig
```kconfig
# SPDX-FileCopyrightText: 2026 Core Devices LLC
# SPDX-License-Identifier: Apache-2.0

config SERVICE_ANIMATION_SERVICE
    bool "Animation"
    help
      Animation scheduling service.
```

## src/fw/services/app_fetch_endpoint/Kconfig
```kconfig
# SPDX-FileCopyrightText: 2026 Core Devices LLC
# SPDX-License-Identifier: Apache-2.0

config SERVICE_APP_FETCH_ENDPOINT
    bool "App fetch endpoint"
    help
      Endpoint used by the phone to fetch apps on demand.

if SERVICE_APP_FETCH_ENDPOINT

module = SERVICE_APP_FETCH_ENDPOINT
module-str = App fetch endpoint
source "src/fw/Kconfig.template.log_level"

endif
```

## src/fw/services/app_message/Kconfig
```kconfig
# SPDX-FileCopyrightText: 2026 Core Devices LLC
# SPDX-License-Identifier: Apache-2.0

config SERVICE_APP_MESSAGE
    bool "App message"
    help
      AppMessage (app <-> phone) transport.

if SERVICE_APP_MESSAGE

module = SERVICE_APP_MESSAGE
module-str = App message
source "src/fw/Kconfig.template.log_level"

endif
```

## src/fw/services/app_order_endpoint/Kconfig
```kconfig
# SPDX-FileCopyrightText: 2026 Core Devices LLC
# SPDX-License-Identifier: Apache-2.0

config SERVICE_APP_ORDER_ENDPOINT
    bool "App order endpoint"
    help
      Endpoint used to order installed apps in the launcher.

if SERVICE_APP_ORDER_ENDPOINT

module = SERVICE_APP_ORDER_ENDPOINT
module-str = App order endpoint
source "src/fw/Kconfig.template.log_level"

endif
```

## src/fw/services/app_outbox_service/Kconfig
```kconfig
# SPDX-FileCopyrightText: 2026 Core Devices LLC
# SPDX-License-Identifier: Apache-2.0

config SERVICE_APP_OUTBOX_SERVICE
    bool "App outbox"
    help
      App outbox messaging service.

if SERVICE_APP_OUTBOX_SERVICE

module = SERVICE_APP_OUTBOX_SERVICE
module-str = App outbox
source "src/fw/Kconfig.template.log_level"

endif
```

## src/fw/services/audio_endpoint/Kconfig
```kconfig
# SPDX-FileCopyrightText: 2026 Core Devices LLC
# SPDX-License-Identifier: Apache-2.0

config SERVICE_AUDIO_ENDPOINT
    bool "Audio endpoint"
    help
      Audio streaming endpoint.

if SERVICE_AUDIO_ENDPOINT

module = SERVICE_AUDIO_ENDPOINT
module-str = Audio endpoint
source "src/fw/Kconfig.template.log_level"

endif
```

## src/fw/services/blob_db/Kconfig
```kconfig
# SPDX-FileCopyrightText: 2026 Core Devices LLC
# SPDX-License-Identifier: Apache-2.0

config SERVICE_BLOB_DB
    bool "Blob DB"
    help
      BlobDB (persistent key/value stores used for timeline, notifications,
      apps, contacts, ...).

if SERVICE_BLOB_DB

module = SERVICE_BLOB_DB
module-str = Blob DB
source "src/fw/Kconfig.template.log_level"

endif
```

## src/fw/services/bluetooth/Kconfig
```kconfig
# SPDX-FileCopyrightText: 2026 Core Devices LLC
# SPDX-License-Identifier: Apache-2.0

config SERVICE_BLUETOOTH
    bool "Bluetooth"
    help
      Core Bluetooth service (pairing, bonding, local id, ...).

config BLE_GATT_NOTIF_WRITE_TIMEOUT_MS
    int "GATT notification handoff timeout (ms)"
    default 5 if SOC_SF32LB52
    default 100
    help
      Max time the BT host task blocks for the client to drain the per-client
      GATT subscription buffer before dropping a notification. Must stay below
      the HCI transport's tolerance for a stalled host.

config BLE_GATT_SUBSCRIPTION_DEPTH
    int "GATT subscription buffer depth (notifications)"
    default 8 if SOC_SF32LB52
    default 4
    help
      Per-client GATT subscription buffer depth, in max-size notifications.
      Deeper absorbs notification bursts (fewer drops) at the cost of RAM.

if SERVICE_BLUETOOTH

module = SERVICE_BLUETOOTH
module-str = Bluetooth
source "src/fw/Kconfig.template.log_level"

endif
```
