## third_party/nimble/port/Kconfig
```kconfig
# SPDX-FileCopyrightText: 2026 Core Devices LLC
# SPDX-License-Identifier: Apache-2.0

config NIMBLE_HOST_THREAD_STACK_SIZE
    int "Host thread stack size in bytes"
    default 5000

config NIMBLE_HOST_THREAD_PRIO
    int "Host thread priority"
    default 3

config NIMBLE_LL_THREAD_STACK_SIZE
    int "Link layer thread stack size in bytes"
    depends on NIMBLE_CONTROLLER
    default 1384

config NIMBLE_LL_THREAD_PRIO
    int "Link layer thread priority"
    depends on NIMBLE_CONTROLLER
    default 4
```

## third_party/nimble/store/Kconfig
```kconfig
# SPDX-FileCopyrightText: 2026 Core Devices LLC
# SPDX-License-Identifier: Apache-2.0

choice NIMBLE_STORE_BACKEND
    prompt "Store backend"
    depends on NIMBLE_STORE_CONFIG
    default NIMBLE_STORE_BACKEND_SETTINGS if SETTINGS
    default NIMBLE_STORE_BACKEND_RAM
    help
      Where the store keeps the keys of bonded peers and their CCCDs.

config NIMBLE_STORE_BACKEND_RAM
    bool "RAM"
    help
      Keep them in RAM only: they are lost on reset.

config NIMBLE_STORE_BACKEND_SETTINGS
    bool "Settings file"
    depends on SETTINGS
    help
      Keep them in a settings file, along with a local IRK generated once.

config NIMBLE_STORE_BACKEND_PRF
    bool "PRF store"
    select BT_PRF_STORE
    help
      Keep one bonding, the last one written, in the PRF store, the
      flash partition the recovery firmware and the normal firmware
      share. The others, and the CCCDs, stay in RAM. The local IRK is
      left to whoever uses the store.

endchoice

config NIMBLE_STORE_SETTINGS_PRF_MIRROR
    bool "Mirror the last bonding to the PRF store"
    depends on NIMBLE_STORE_BACKEND_SETTINGS
    select BT_PRF_STORE
    help
      Keep the bonding written last in the PRF store too, and take the
      one found there when the store loads: firmware that uses the PRF
      store backend then shares the bonding of this one.

config NIMBLE_STORE_SETTINGS_FILE_SIZE
    int "Store file size in bytes"
    depends on NIMBLE_STORE_BACKEND_SETTINGS
    default 4096
    help
      Space the settings file of the store may use. The store keeps the
      keys of up to BLE_STORE_MAX_BONDS peers and BLE_STORE_MAX_CCCDS
      subscriptions; the file needs room to rewrite them as they change.
```

## third_party/nimble/transport/Kconfig
```kconfig
# SPDX-FileCopyrightText: 2026 Core Devices LLC
# SPDX-License-Identifier: Apache-2.0

choice NIMBLE_HCI
    prompt "HCI transport"
    default NIMBLE_HCI_FAKE
    help
      How the NimBLE host reaches its controller. The default is derived
      from the SoC (see each soc/<soc>/Kconfig.defconfig); the fake
      controller is the fallback where there is no radio.

config NIMBLE_HCI_NRF52
    bool "NimBLE controller on the nRF52 radio"
    depends on SOC_NRF52
    select NIMBLE_CONTROLLER
    select NIMBLE_DRIVER_NRF5X
    select NIMBLE_TRNG if RNG
    help
      Run the NimBLE link layer in the same image, on the nRF52 radio.
      It takes its random numbers from the RNG driver when there is one,
      as that driver owns the peripheral, and drives the peripheral
      itself otherwise.

config NIMBLE_HCI_NRF_SDC
    bool "Nordic SoftDevice Controller"
    depends on SOC_NRF54L
    select MPSL
    select RNG
    help
      Run the Nordic SoftDevice Controller, from the nonfree libraries,
      in the same image, on the multiprotocol service layer. The host
      reaches it through its C API, with no HCI framing.

config NIMBLE_HCI_SF32LB
    bool "SiFli LCPU over IPC"
    depends on DT_HAS_SIFLI_SF32LB52_LCPU_ENABLED || DT_HAS_SIFLI_SF32LB57_LCPU_ENABLED
    select REMOTEPROC
    select NIMBLE_HCI_HAS_BREDR
    help
      Talk H4 HCI to the SiFli controller running on the LCPU, over the
      byte rings its ROM shares with the HCPU.

config NIMBLE_HCI_UART
    bool "H4 over UART"
    depends on QEMU || UART_POSIX_BT_HCI
    help
      Talk H4 HCI to an external controller over the board's BT_HCI_UART.
      On QEMU this is the fourth serial port, on native boards the -b
      option; either can be attached to a host controller such as an
      nRF52840 dongle running an H4 HCI firmware.

config NIMBLE_HCI_FAKE
    bool "Fake controller"
    help
      Answer every HCI command locally with success and never raise an
      event. The host synchronises and the GATT server runs, but no link
      can be established. For targets without a radio, such as QEMU.

endchoice

if NIMBLE_HCI_NRF_SDC

config NIMBLE_HCI_NRF_SDC_MULTIROLE
    bool "Central and observer roles"
    help
      Link the multirole controller, which can also scan and initiate
      connections, instead of the peripheral-only one.

config NIMBLE_HCI_NRF_SDC_TX_PACKETS
    int "Link layer TX packets per link"
    default 3

config NIMBLE_HCI_NRF_SDC_RX_PACKETS
    int "Link layer RX packets per link"
    default 2

config NIMBLE_HCI_NRF_SDC_MEM_SIZE
    int "Controller memory in bytes"
    default 8192
    help
      Memory handed to the controller for its links and buffers. Boot
      fails if the configuration needs more; the debug log shows how
      much it takes.

endif # NIMBLE_HCI_NRF_SDC

config NIMBLE_HCI_HAS_BREDR
    bool
    help
      The controller behind the transport may be a dual-mode one.

config NIMBLE_HCI_HAS_SCO
    bool
    help
      The transport carries synchronous data.

config NIMBLE_HCI_THREAD_STACK_SIZE
    int "HCI transport thread stack size in bytes"
    depends on NIMBLE_HCI_SF32LB || NIMBLE_HCI_UART || NIMBLE_HCI_NRF_SDC
    default 2560 if NIMBLE_HCI_SF32LB
    default 1024

config NIMBLE_HCI_THREAD_PRIO
    int "HCI transport thread priority"
    depends on NIMBLE_HCI_SF32LB || NIMBLE_HCI_UART || NIMBLE_HCI_NRF_SDC
    default 3

config NIMBLE_DRIVER_NRF5X
    bool
    select HAL_NORDIC

choice NIMBLE_ID_ADDR_SOURCE
    prompt "Identity address"
    default NIMBLE_ID_ADDR_CONTROLLER
    help
      Where the watch's Bluetooth identity address comes from. The default
      is derived from the SoC (see each soc/<soc>/Kconfig.defconfig).

config NIMBLE_ID_ADDR_CONTROLLER
    bool "Controller"
    help
      Use the address the controller reports, or let NimBLE pick one.

config NIMBLE_ID_ADDR_SF32LB_EFUSE
    bool "SF32LB eFUSE"
    depends on SOC_FAMILY_SF32LB && NVMEM_SF32LB
    select NIMBLE_ID_ADDR
    help
      Public address derived from the unique ID in the SoC's eFUSE.

config NIMBLE_ID_ADDR_QEMU
    bool "QEMU machine"
    depends on SOC_QEMU_PEBBLE
    select NIMBLE_ID_ADDR
    help
      Random static address given to the machine at launch, with
      -global pebble-sysctrl.bt-addr=ADDRESS. The controller's address
      is used if none is given.

config NIMBLE_ID_ADDR_POSIX
    bool "Host option"
    depends on SOC_POSIX
    select NIMBLE_ID_ADDR
    help
      Random static address given on the command line, with -a ADDRESS.
      The controller's address is used if none is given.

endchoice

config NIMBLE_ID_ADDR
    bool
    help
      An identity address backend is selected (pbl/bluetooth/id_addr.h).
      The HCI transport programs a public one into its controller.
```

## third_party/nonfree/Kconfig
```kconfig
# SPDX-FileCopyrightText: 2026 Core Devices LLC
# SPDX-License-Identifier: Apache-2.0

config MPSL
    bool
    depends on SOC_NRF54L
    select HAL_NORDIC
    select KERNEL_ZERO_LATENCY_IRQS
    help
      The Nordic multiprotocol service layer, from the nonfree libraries,
      and its glue (mpsl_pebble.h). Selected by the radio protocol stacks
      that run on it. The clock driver starts it, and then takes the
      crystals through it.

config MPSL_LOW_PRIO
    int "MPSL low-priority interrupt priority"
    depends on MPSL
    default 4
    help
      Priority of the SWI00 interrupt through which the MPSL asks for its
      low-priority processing.

config MPSL_WORKQ_STACK_SIZE
    int "MPSL work queue stack size in bytes"
    depends on MPSL
    default 1024
    help
      Stack of the thread that runs the low-priority processing of the
      MPSL.

config MPSL_WORKQ_PRIO
    int "MPSL work queue priority"
    depends on MPSL
    default 4
    help
      Priority of the thread that runs the low-priority processing of the
      MPSL.
```
