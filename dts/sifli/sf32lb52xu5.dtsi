// SPDX-FileCopyrightText: 2026 Core Devices LLC
// SPDX-License-Identifier: (GPL-2.0-only OR BSD-2-Clause)

&mpi1 {
	sip_flash: flash@0 {
		compatible = "jedec,spi-nor";
		reg = <0>;
		spi-rx-bus-width = <4>;
		spi-tx-bus-width = <4>;
	};
};
