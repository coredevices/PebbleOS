## dts/bindings/sram/sifli,sf32lb52-psram.yaml
```yaml
# SPDX-License-Identifier: (GPL-2.0-only OR BSD-2-Clause)
%YAML 1.2
---
$id: http://devicetree.org/schemas/sram/sifli,sf32lb52-psram.yaml#
$schema: http://devicetree.org/meta-schemas/core.yaml#

title: SiFli SF32LB52 in-package PSRAM

maintainers:
  - Gerard Marull-Paretas <gerard@teslabs.com>

description: |
  PSRAM stacked in the SF32LB52 package, on an MPI controller that maps it
  in its memory window. The die, and so its protocol (OPI, legacy or
  HyperBus), varies between lots of the same part: it is read at runtime
  from the factory-set PID field of the HPSYS_CFG IDR register.

allOf:
  - $ref: /schemas/spi/spi-peripheral-props.yaml#

properties:
  compatible:
    const: sifli,sf32lb52-psram

  reg:
    maxItems: 1

  size:
    $ref: /schemas/types.yaml#/definitions/uint32
    description:
      Size in bytes.

required:
  - compatible
  - reg
  - size

unevaluatedProperties: false

examples:
  - |
    spi {
        #address-cells = <1>;
        #size-cells = <0>;

        psram@0 {
            compatible = "sifli,sf32lb52-psram";
            reg = <0>;
            size = <0x1000000>;
            spi-rx-bus-width = <8>;
            spi-tx-bus-width = <8>;
        };
    };
```

## dts/bindings/thermal/sifli,sf32lb52-tsen.yaml
```yaml
# SPDX-License-Identifier: (GPL-2.0-only OR BSD-2-Clause)
%YAML 1.2
---
$id: http://devicetree.org/schemas/thermal/sifli,sf32lb52-tsen.yaml#
$schema: http://devicetree.org/meta-schemas/core.yaml#

title: SiFli SF32LB52 die temperature sensor

maintainers:
  - Gerard Marull-Paretas <gerard@teslabs.com>

allOf:
  - $ref: thermal-sensor.yaml#

properties:
  compatible:
    const: sifli,sf32lb52-tsen

  reg:
    maxItems: 1

  clocks:
    maxItems: 1

  sifli,hpsys-cfg:
    $ref: /schemas/types.yaml#/definitions/phandle
    description: HPSYS configuration block, holding the analog bandgap enable.

  '#thermal-sensor-cells':
    const: 0

required:
  - compatible
  - reg
  - clocks
  - sifli,hpsys-cfg

unevaluatedProperties: false

examples:
  - |
    thermal-sensor@50089000 {
        compatible = "sifli,sf32lb52-tsen";
        reg = <0x50089000 0x1000>;
        clocks = <&hpsys_rcc 36>;
        sifli,hpsys-cfg = <&hpsys_cfg>;
        #thermal-sensor-cells = <0>;
    };
```

## dts/bindings/timer/nordic,nrf52832-timer.yaml
```yaml
# SPDX-License-Identifier: (GPL-2.0-only OR BSD-2-Clause)
%YAML 1.2
---
$id: http://devicetree.org/schemas/timer/nordic,nrf52832-timer.yaml#
$schema: http://devicetree.org/meta-schemas/core.yaml#

title: Nordic nRF52 timer/counter

maintainers:
  - Gerard Marull-Paretas <gerard@teslabs.com>

description:
  Timer on HFCLK, or counter of its COUNT task, with capture/compare
  registers. TIMER3 and TIMER4 have six of them, the others four.

properties:
  compatible:
    oneOf:
      - const: nordic,nrf52832-timer
      - items:
          - enum:
              - nordic,nrf52833-timer
              - nordic,nrf52840-timer
          - const: nordic,nrf52832-timer

  reg:
    maxItems: 1

  interrupts:
    maxItems: 1

required:
  - compatible
  - reg
  - interrupts

additionalProperties: false

examples:
  - |
    timer@4000a000 {
        compatible = "nordic,nrf52840-timer", "nordic,nrf52832-timer";
        reg = <0x4000a000 0x1000>;
        interrupts = <10>;
    };
```

## dts/bindings/watchdog/sifli,sf32lb52-wdt.yaml
```yaml
# SPDX-License-Identifier: (GPL-2.0-only OR BSD-2-Clause)
%YAML 1.2
---
$id: http://devicetree.org/schemas/watchdog/sifli,sf32lb52-wdt.yaml#
$schema: http://devicetree.org/meta-schemas/core.yaml#

title: SiFli SF32LB52 watchdog

maintainers:
  - Gerard Marull-Paretas <gerard@teslabs.com>

description:
  WDT1 of the SF32LB52 and SF32LB57, which resets the system through the
  PMUC. It counts clk_wdt of the PMUC.

allOf:
  - $ref: watchdog.yaml#
  - if:
      properties:
        compatible:
          const: sifli,sf32lb52-wdt
    then:
      required:
        - sifli,hpsys-cfg

properties:
  compatible:
    enum:
      - sifli,sf32lb52-wdt
      - sifli,sf32lb57-wdt

  reg:
    maxItems: 1

  clocks:
    maxItems: 1

  sifli,hpsys-cfg:
    $ref: /schemas/types.yaml#/definitions/phandle
    description: HPSYS configuration block, routing the watchdog to the reboot.

required:
  - compatible
  - reg
  - clocks

unevaluatedProperties: false

examples:
  - |
    watchdog@50094000 {
        compatible = "sifli,sf32lb52-wdt";
        reg = <0x50094000 0x1000>;
        clocks = <&pmuc 5>;
        sifli,hpsys-cfg = <&hpsys_cfg>;
    };
```

## fw/apps/demo/bt_classic_probe/Kconfig
```kconfig
# SPDX-FileCopyrightText: 2026 Core Devices LLC
# SPDX-License-Identifier: Apache-2.0

config DEMO_APP_BT_CLASSIC_PROBE
    bool "BT Classic probe"
    depends on BT_HCI_SF32LB52 && !RECOVERY_FW && !MFG
    # The call view reads the LCPU's voice path.
    depends on BT_CALL_AUDIO || !BT_ZEPHYR_CLASSIC
    select KERNEL_HEAP_BOOT_MIN_HEADROOM
    select REBOOT_REASON_KEEP_LAST
    help
      Reads the SF32LB52 controller's BR/EDR and LE feature bits over HCI
      and, on Select, makes the controller discoverable over BR/EDR. Nothing
      is persisted and boot is unchanged; discoverability is cleared on exit.
```

## fw/apps/demo/dialer/Kconfig
```kconfig
# SPDX-FileCopyrightText: 2026 Core Devices LLC
# SPDX-License-Identifier: Apache-2.0

config DEMO_APP_DIALER
    bool "Dialer"
    depends on BT_ZEPHYR_CLASSIC && BT_CALL_AUDIO
    default y
    help
      Calls from the watch over the Zephyr hands-free link: a number pad,
      the calls the watch saw, favorites kept on the watch, and redial.
      The host must already be running and connected to the phone.
```

## fw/boards/getafix.conf
```kconfig
# Firmware settings for the getafix board.

CONFIG_ALS_SCREEN_COMPENSATION=y
# Upper-right edge; black_scale ~25x from `als curve`.
CONFIG_ALS_SENSOR_X=200
CONFIG_ALS_SENSOR_Y=70
CONFIG_ALS_SENSOR_W=40
CONFIG_ALS_SENSOR_H=40
CONFIG_ALS_BLACK_SCALE_Q8=6400

CONFIG_BATTERY_WARNING_FIRST_PERCENT=12
CONFIG_BATTERY_WARNING_SECOND_PERCENT=8

CONFIG_DYNAMIC_BACKLIGHT=y
CONFIG_BACKLIGHT_STANDARD_INTENSITY=25
CONFIG_ACCEL_SENSITIVITY=y
CONFIG_APP_SCALING=y
CONFIG_ORIENTATION_MANAGER=y
CONFIG_MODDABLE_XS=y

CONFIG_SERVICE_LIGHT_BACKLIGHT_ON_PERCENT=25
CONFIG_SERVICE_LIGHT_DARK_THRESHOLD=800
CONFIG_SERVICE_LIGHT_DARK_THRESHOLD_DELTA=100
CONFIG_SERVICE_BATTERY_LOW_POWER_PERCENT=5
CONFIG_SERVICE_BATTERY_CAPACITY_HOURS=150
```

## fw/drivers/button/Kconfig
```kconfig
# SPDX-FileCopyrightText: 2026 Core Devices LLC
# SPDX-License-Identifier: Apache-2.0

menu "Button"

config BUTTON_NRF5
    bool "Nordic nRF5"
    default y if SOC_NRF52
    select HAL_NORDIC
    help
      Support for buttons on Nordic nRF5 GPIOs.

config BUTTON_SF32LB
    bool "SiFli SF32LB"
    default y if SOC_SF32LB52
    select HAL_SIFLI
    help
      Support for buttons on SiFli SF32LB GPIOs.

config BUTTON_QEMU
    bool "QEMU"
    default y if SOC_QEMU
    help
      Support for the QEMU buttons.

endmenu
```

## fw/drivers/hrm/Kconfig
```kconfig
# SPDX-FileCopyrightText: 2026 Core Devices LLC
# SPDX-License-Identifier: Apache-2.0

menuconfig HRM
    bool "Heart Rate Monitor"
    help
      Heart Rate Monitor Drivers

if HRM

config HRM_GH3X2X
    bool "Goodix GH3X2X"
    help
      Support for the Goodix GH3X2X heart rate sensor.

config HRM_HRV
    bool "HRV (RR interval) support"
    depends on HRM_GH3X2X
    default n
    help
      Expose heart-rate-variability (RR/inter-beat interval) data from the
      HRM sensor. Enables the Goodix HRV algorithm and links the nonfree
      HRV library. Off by default; HRV is only sampled while an app holds
      an HRV subscription.

config HRM_QEMU
    bool "QEMU"
    default y if SOC_QEMU
    help
      QEMU heart rate monitor. QEMU emulates none, so it can be enabled
      but never delivers samples.

module = DRIVER_HRM
module-str = Heart Rate Monitor
source "subsys/logging/Kconfig.template.log_level"

endif # HRM
```
