## dts/bindings/soc/sifli/sifli,sf32lb52-bt-phy.yaml
```yaml
# SPDX-License-Identifier: (GPL-2.0-only OR BSD-2-Clause)
%YAML 1.2
---
$id: http://devicetree.org/schemas/soc/sifli/sifli,sf32lb52-bt-phy.yaml#
$schema: http://devicetree.org/meta-schemas/core.yaml#

title: SiFli SF32LB52 and SF32LB57 Bluetooth PHY

maintainers:
  - Gerard Marull-Paretas <gerard@teslabs.com>

description:
  Bluetooth modem in LPSYS, and the window its samples are captured through,
  which the radio calibration reads by DMA.

properties:
  compatible:
    items:
      - enum:
          - sifli,sf32lb52-bt-phy
          - sifli,sf32lb57-bt-phy
      - const: syscon

  reg:
    items:
      - description: Registers
      - description: Sample capture window

  reg-names:
    items:
      - const: regs
      - const: capture

required:
  - compatible
  - reg

additionalProperties: false

examples:
  - |
    syscon@40084000 {
        compatible = "sifli,sf32lb52-bt-phy", "syscon";
        reg = <0x40084000 0x1000>, <0x400c0000 0x1000>;
        reg-names = "regs", "capture";
    };
```

## dts/bindings/soc/sifli/sifli,sf32lb52-bt-rfc.yaml
```yaml
# SPDX-License-Identifier: (GPL-2.0-only OR BSD-2-Clause)
%YAML 1.2
---
$id: http://devicetree.org/schemas/soc/sifli/sifli,sf32lb52-bt-rfc.yaml#
$schema: http://devicetree.org/meta-schemas/core.yaml#

title: SiFli SF32LB52 Bluetooth RF controller

maintainers:
  - Gerard Marull-Paretas <gerard@teslabs.com>

description:
  Bluetooth RF controller in LPSYS. Its sequencer command and calibration
  memory comes first, its registers follow at offset 0x800. The HCPU
  calibrates the radio through it before the LCPU boots.

properties:
  compatible:
    items:
      - const: sifli,sf32lb52-bt-rfc
      - const: syscon

  reg:
    maxItems: 1

required:
  - compatible
  - reg

additionalProperties: false

examples:
  - |
    syscon@40082000 {
        compatible = "sifli,sf32lb52-bt-rfc", "syscon";
        reg = <0x40082000 0x1000>;
    };
```

## dts/bindings/soc/sifli/sifli,sf32lb52-hpsys-cfg.yaml
```yaml
# SPDX-License-Identifier: (GPL-2.0-only OR BSD-2-Clause)
%YAML 1.2
---
$id: http://devicetree.org/schemas/soc/sifli/sifli,sf32lb52-hpsys-cfg.yaml#
$schema: http://devicetree.org/meta-schemas/core.yaml#

title: SiFli SF32LB52 HPSYS configuration

maintainers:
  - Gerard Marull-Paretas <gerard@teslabs.com>

description:
  System configuration registers of the SF32LB52 HPSYS, which other blocks
  use, as the voltage mode and memory timings of the HPSYS, the HPSYS bandgap
  of the DLLs, peripheral pin routing and the chip identification.

properties:
  compatible:
    items:
      - const: sifli,sf32lb52-hpsys-cfg
      - const: syscon

  reg:
    maxItems: 1

required:
  - compatible
  - reg

additionalProperties: false

examples:
  - |
    syscon@5000b000 {
        compatible = "sifli,sf32lb52-hpsys-cfg", "syscon";
        reg = <0x5000b000 0x1000>;
    };
```

## dts/bindings/sound/awinic,aw8155.yaml
```yaml
# SPDX-License-Identifier: (GPL-2.0-only OR BSD-2-Clause)
%YAML 1.2
---
$id: http://devicetree.org/schemas/sound/awinic,aw8155.yaml#
$schema: http://devicetree.org/meta-schemas/core.yaml#

title: Awinic AW8155 Audio Amplifier

maintainers:
  - Gerard Marull-Paretas <gerard@teslabs.com>

description:
  The Awinic AW8155 is a mono audio amplifier with different operation modes
  (set using one-wire pulse control). The mode selects the amplifier class,
  its gain and its output power limit.

allOf:
  - $ref: dai-common.yaml#

properties:
  compatible:
    const: awinic,aw8155

  mode-gpios:
    description: GPIO used for one-wire pulse control, the CTRL pin.
    maxItems: 1

  awinic,mode:
    description:
      Operation mode (number of rising edges for one-wire pulse control).
      Mode 3 is a test mode.
    $ref: /schemas/types.yaml#/definitions/uint32
    enum: [1, 2, 4]

  vdd-supply: true

  sound-name-prefix: true

required:
  - compatible
  - mode-gpios
  - awinic,mode

additionalProperties: false

examples:
  - |
    #include <dt-bindings/gpio/gpio.h>
    audio-amplifier {
        compatible = "awinic,aw8155";
        mode-gpios = <&gpio1 0 GPIO_ACTIVE_HIGH>;
        awinic,mode = <1>;
    };
```

## dts/bindings/sound/nordic,nrf52832-i2s.yaml
```yaml
# SPDX-License-Identifier: (GPL-2.0-only OR BSD-2-Clause)
%YAML 1.2
---
$id: http://devicetree.org/schemas/sound/nordic,nrf52832-i2s.yaml#
$schema: http://devicetree.org/meta-schemas/core.yaml#

title: Nordic nRF52 I2S interface

maintainers:
  - Gerard Marull-Paretas <gerard@teslabs.com>

description:
  Plays through I2S, as a master or a slave to the codec. It selects its own pins, given as GPIO properties named after the signals.

allOf:
  - $ref: dai-common.yaml#

properties:
  compatible:
    oneOf:
      - const: nordic,nrf52832-i2s
      - items:
          - enum:
              - nordic,nrf52833-i2s
              - nordic,nrf52840-i2s
          - const: nordic,nrf52832-i2s

  reg:
    maxItems: 1

  interrupts:
    maxItems: 1

  clocks:
    items:
      - description: HFCLK, run from the crystal while streaming

  "#sound-dai-cells":
    const: 0

  sck-gpios:
    maxItems: 1

  lrck-gpios:
    maxItems: 1

  mck-gpios:
    maxItems: 1

  sdout-gpios:
    maxItems: 1

  sdin-gpios:
    maxItems: 1

required:
  - compatible
  - reg
  - interrupts
  - clocks
  - "#sound-dai-cells"
  - sck-gpios
  - lrck-gpios

unevaluatedProperties: false

examples:
  - |
    i2s@40025000 {
        compatible = "nordic,nrf52840-i2s", "nordic,nrf52832-i2s";
        reg = <0x40025000 0x1000>;
        interrupts = <37>;
        clocks = <&clock 0>;
        #sound-dai-cells = <0>;
        sck-gpios = <&gpio0 12 0>;
        lrck-gpios = <&gpio0 7 0>;
        mck-gpios = <&gpio1 9 0>;
        sdout-gpios = <&gpio0 13 0>;
    };
```

## dts/bindings/sound/nordic,nrf52832-pdm.yaml
```yaml
# SPDX-License-Identifier: (GPL-2.0-only OR BSD-2-Clause)
%YAML 1.2
---
$id: http://devicetree.org/schemas/sound/nordic,nrf52832-pdm.yaml#
$schema: http://devicetree.org/meta-schemas/core.yaml#

title: Nordic nRF52 PDM interface

maintainers:
  - Gerard Marull-Paretas <gerard@teslabs.com>

description:
  Records one or two digital microphones. It selects its own pins, given as GPIO properties named after the signals.

allOf:
  - $ref: dai-common.yaml#

properties:
  compatible:
    oneOf:
      - const: nordic,nrf52832-pdm
      - items:
          - enum:
              - nordic,nrf52833-pdm
              - nordic,nrf52840-pdm
          - const: nordic,nrf52832-pdm

  reg:
    maxItems: 1

  interrupts:
    maxItems: 1

  clocks:
    items:
      - description: HFCLK, run from the crystal while streaming

  "#sound-dai-cells":
    const: 0

  clk-gpios:
    maxItems: 1

  din-gpios:
    maxItems: 1

required:
  - compatible
  - reg
  - interrupts
  - clocks
  - "#sound-dai-cells"
  - clk-gpios
  - din-gpios

unevaluatedProperties: false

examples:
  - |
    audio-controller@4001d000 {
        compatible = "nordic,nrf52840-pdm", "nordic,nrf52832-pdm";
        reg = <0x4001d000 0x1000>;
        interrupts = <29>;
        clocks = <&clock 0>;
        #sound-dai-cells = <0>;
        clk-gpios = <&gpio1 0 0>;
        din-gpios = <&gpio0 24 0>;
    };
```

## dts/bindings/sound/qemu,pebble-audio.yaml
```yaml
# SPDX-License-Identifier: (GPL-2.0-only OR BSD-2-Clause)
%YAML 1.2
---
$id: http://devicetree.org/schemas/sound/qemu,pebble-audio.yaml#
$schema: http://devicetree.org/meta-schemas/core.yaml#

title: QEMU Pebble audio output

maintainers:
  - Gerard Marull-Paretas <gerard@teslabs.com>

description:
  Playback device of the QEMU Pebble machines, fed through a FIFO and played
  on the host.

properties:
  compatible:
    const: qemu,pebble-audio

  reg:
    maxItems: 1

  interrupts:
    maxItems: 1

  "#sound-dai-cells":
    const: 0

required:
  - compatible
  - reg
  - interrupts
  - "#sound-dai-cells"

additionalProperties: false

examples:
  - |
    audio-controller@40012000 {
        compatible = "qemu,pebble-audio";
        reg = <0x40012000 0x1000>;
        interrupts = <10>;
        #sound-dai-cells = <0>;
    };
```

## dts/bindings/sound/sifli,sf32lb52-audcodec.yaml
```yaml
# SPDX-License-Identifier: (GPL-2.0-only OR BSD-2-Clause)
%YAML 1.2
---
$id: http://devicetree.org/schemas/sound/sifli,sf32lb52-audcodec.yaml#
$schema: http://devicetree.org/meta-schemas/core.yaml#

title: SiFli SF32LB52 audio codec

maintainers:
  - Gerard Marull-Paretas <gerard@teslabs.com>

description:
  The audio codec of the SF32LB52, here its DAC, with its analog bias, PLL and
  output stage, fed through a DMA channel.

allOf:
  - $ref: dai-common.yaml#

properties:
  compatible:
    const: sifli,sf32lb52-audcodec

  reg:
    maxItems: 1

  clocks:
    maxItems: 1

  dmas:
    maxItems: 1

  dma-names:
    const: tx

  "#sound-dai-cells":
    const: 0

required:
  - compatible
  - reg
  - clocks
  - "#sound-dai-cells"

unevaluatedProperties: false

examples:
  - |
    audio-codec@50088000 {
        compatible = "sifli,sf32lb52-audcodec";
        reg = <0x50088000 0x1000>;
        clocks = <&hpsys_rcc 33>;
        dmas = <&dmac1 3 41 2>;
        dma-names = "tx";
        #sound-dai-cells = <0>;
    };
```

## dts/bindings/sound/sifli,sf32lb52-pdm.yaml
```yaml
# SPDX-License-Identifier: (GPL-2.0-only OR BSD-2-Clause)
%YAML 1.2
---
$id: http://devicetree.org/schemas/sound/sifli,sf32lb52-pdm.yaml#
$schema: http://devicetree.org/meta-schemas/core.yaml#

title: SiFli SF32LB52 PDM interface

maintainers:
  - Gerard Marull-Paretas <gerard@teslabs.com>

description:
  Records one or two digital microphones, with a programmable gain, through
  a DMA channel.

allOf:
  - $ref: dai-common.yaml#

properties:
  compatible:
    const: sifli,sf32lb52-pdm

  reg:
    maxItems: 1

  interrupts:
    maxItems: 1

  clocks:
    maxItems: 1

  resets:
    maxItems: 1

  dmas:
    maxItems: 1

  dma-names:
    const: rx

  "#sound-dai-cells":
    const: 0

required:
  - compatible
  - reg
  - interrupts
  - clocks
  - resets
  - "#sound-dai-cells"

unevaluatedProperties: false

examples:
  - |
    audio-controller@5009a000 {
        compatible = "sifli,sf32lb52-pdm";
        reg = <0x5009a000 0x1000>;
        interrupts = <82>;
        clocks = <&hpsys_rcc 21>;
        resets = <&hpsys_rcc 21>;
        dmas = <&dmac1 4 36 0>;
        dma-names = "rx";
        #sound-dai-cells = <0>;
    };
```

## dts/bindings/spi/nordic,nrf52832-spim.yaml
```yaml
# SPDX-License-Identifier: (GPL-2.0-only OR BSD-2-Clause)
%YAML 1.2
---
$id: http://devicetree.org/schemas/spi/nordic,nrf52832-spim.yaml#
$schema: http://devicetree.org/meta-schemas/core.yaml#

title: Nordic nRF52 SPIM

maintainers:
  - Gerard Marull-Paretas <gerard@teslabs.com>

description:
  SPI controller with EasyDMA of the nRF52 series, first in the nRF52832. Its
  pins are selected in its own registers, from sck-gpios, mosi-gpios,
  miso-gpios and cs-gpios. SPIM0 and SPIM1 share their registers, interrupt
  and address with the TWIM and other serial functions of the same instance,
  each a sibling node of its own, and only one of them may be enabled.

allOf:
  - $ref: /schemas/spi/spi-controller.yaml#

properties:
  compatible:
    oneOf:
      - const: nordic,nrf52832-spim
      - items:
          - enum:
              - nordic,nrf52833-spim
              - nordic,nrf52840-spim
          - const: nordic,nrf52832-spim

  reg:
    maxItems: 1

  interrupts:
    maxItems: 1

  sck-gpios:
    maxItems: 1

  mosi-gpios:
    maxItems: 1

  miso-gpios:
    maxItems: 1

required:
  - compatible
  - reg
  - interrupts
  - sck-gpios

unevaluatedProperties: false

examples:
  - |
    spi@4002f000 {
        compatible = "nordic,nrf52840-spim", "nordic,nrf52832-spim";
        reg = <0x4002f000 0x1000>;
        interrupts = <47>;
        sck-gpios = <&gpio0 6 0>;
        mosi-gpios = <&gpio0 8 0>;
        cs-gpios = <&gpio1 3 0>;
        #address-cells = <1>;
        #size-cells = <0>;
    };
```

## dts/bindings/spi/nordic,nrf52840-qspi.yaml
```yaml
# SPDX-License-Identifier: (GPL-2.0-only OR BSD-2-Clause)
%YAML 1.2
---
$id: http://devicetree.org/schemas/spi/nordic,nrf52840-qspi.yaml#
$schema: http://devicetree.org/meta-schemas/core.yaml#

title: Nordic nRF52840 QSPI controller

maintainers:
  - Gerard Marull-Paretas <gerard@teslabs.com>

description:
  Quad SPI controller for an external flash, with a window that maps it for
  reads and execution. Its pins are selected in its own registers, from
  sck-gpios, cs-gpios and io-gpios.

allOf:
  - $ref: /schemas/spi/spi-controller.yaml#

properties:
  compatible:
    const: nordic,nrf52840-qspi

  reg:
    items:
      - description: registers
      - description: memory-mapped window

  reg-names:
    items:
      - const: qspi
      - const: qspi_mm

  interrupts:
    maxItems: 1

  sck-gpios:
    description: Clock pin.
    maxItems: 1

  cs-gpios:
    maxItems: 1

  io-gpios:
    description: Data pins, IO0 to IO3.
    maxItems: 4

required:
  - compatible
  - reg
  - reg-names
  - interrupts
  - sck-gpios
  - cs-gpios
  - io-gpios

unevaluatedProperties: false

examples:
  - |
    spi@40029000 {
        compatible = "nordic,nrf52840-qspi";
        reg = <0x40029000 0x1000>, <0x12000000 0x8000000>;
        reg-names = "qspi", "qspi_mm";
        interrupts = <41>;
        sck-gpios = <&gpio0 19 0>;
        cs-gpios = <&gpio0 17 0>;
        io-gpios = <&gpio0 20 0>, <&gpio0 21 0>, <&gpio0 22 0>, <&gpio0 23 0>;
        #address-cells = <1>;
        #size-cells = <0>;

        flash@0 {
            compatible = "jedec,spi-nor";
            reg = <0>;
            spi-max-frequency = <8000000>;
            spi-rx-bus-width = <4>;
            spi-tx-bus-width = <4>;
        };
    };
```

## dts/bindings/spi/sifli,sf32lb52-mpi.yaml
```yaml
# SPDX-License-Identifier: (GPL-2.0-only OR BSD-2-Clause)
%YAML 1.2
---
$id: http://devicetree.org/schemas/spi/sifli,sf32lb52-mpi.yaml#
$schema: http://devicetree.org/meta-schemas/core.yaml#

title: SiFli SF32LB52 MPI memory controller

maintainers:
  - Gerard Marull-Paretas <gerard@teslabs.com>

description:
  Controller for a SPI flash or PSRAM, up to quad or octal, with a window
  that maps the memory for reads and execution.

allOf:
  - $ref: /schemas/spi/spi-controller.yaml#

properties:
  compatible:
    enum:
      - sifli,sf32lb52-mpi
      - sifli,sf32lb57-mpi

  reg:
    items:
      - description: registers
      - description: memory-mapped window

  reg-names:
    items:
      - const: mpi
      - const: mpi_mm

  interrupts:
    maxItems: 1

  clocks:
    maxItems: 1

required:
  - compatible
  - reg
  - reg-names
  - interrupts
  - clocks

unevaluatedProperties: false

examples:
  - |
    spi@50042000 {
        compatible = "sifli,sf32lb52-mpi";
        reg = <0x50042000 0x1000>, <0x12000000 0xe000000>;
        reg-names = "mpi", "mpi_mm";
        interrupts = <86>;
        clocks = <&hpsys_rcc 27>;
        #address-cells = <1>;
        #size-cells = <0>;

        flash@0 {
            compatible = "jedec,spi-nor";
            reg = <0>;
            spi-rx-bus-width = <4>;
            spi-tx-bus-width = <4>;
        };
    };
```
