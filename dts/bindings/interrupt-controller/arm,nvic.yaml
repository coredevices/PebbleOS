## dts/bindings/interrupt-controller/arm,nvic.yaml
```yaml
# SPDX-License-Identifier: (GPL-2.0-only OR BSD-2-Clause)
%YAML 1.2
---
$id: http://devicetree.org/schemas/interrupt-controller/arm,nvic.yaml#
$schema: http://devicetree.org/meta-schemas/core.yaml#

title: ARM Nested Vectored Interrupt Controller

maintainers:
  - Gerard Marull-Paretas <gerard@teslabs.com>

description:
  One interrupt cell, the line, as the upstream Cortex-M devicetrees use it.
  Priorities are not part of the hardware description.

properties:
  compatible:
    enum:
      - arm,v7m-nvic
      - arm,v8m-nvic

  reg:
    maxItems: 1

  interrupt-controller: true

  '#interrupt-cells':
    const: 1

  '#address-cells':
    const: 0

required:
  - compatible
  - reg
  - interrupt-controller
  - '#interrupt-cells'

additionalProperties: false
```

## dts/bindings/leds/awinic,aw2016.yaml
```yaml
# SPDX-License-Identifier: (GPL-2.0-only OR BSD-2-Clause)
%YAML 1.2
---
$id: http://devicetree.org/schemas/leds/awinic,aw2016.yaml#
$schema: http://devicetree.org/meta-schemas/core.yaml#

title: Awinic AW2016 3-channel LED driver

maintainers:
  - Gerard Marull-Paretas <gerard@teslabs.com>

description:
  RGB LED driver over I2C, as the AW2013. Its three channels drive an RGB LED,
  described as a multicolor LED.

properties:
  compatible:
    const: awinic,aw2016

  reg:
    maxItems: 1

  vcc-supply:
    description: Regulator providing power to the "VCC" pin.

  multi-led:
    type: object
    $ref: leds-class-multicolor.yaml#
    unevaluatedProperties: false

    properties:
      "#address-cells":
        const: 1

      "#size-cells":
        const: 0

    patternProperties:
      "^led@[0-2]$":
        type: object
        $ref: common.yaml#
        unevaluatedProperties: false

        properties:
          reg:
            description: Channel of the LED.
            maximum: 2

        required:
          - reg
          - color

    required:
      - "#address-cells"
      - "#size-cells"

required:
  - compatible
  - reg

additionalProperties: false

examples:
  - |
    #include <dt-bindings/leds/common.h>

    i2c {
        #address-cells = <1>;
        #size-cells = <0>;

        led-controller@64 {
            compatible = "awinic,aw2016";
            reg = <0x64>;

            multi-led {
                color = <LED_COLOR_ID_RGB>;
                function = LED_FUNCTION_BACKLIGHT;
                #address-cells = <1>;
                #size-cells = <0>;

                led@0 {
                    reg = <0>;
                    color = <LED_COLOR_ID_RED>;
                };

                led@1 {
                    reg = <1>;
                    color = <LED_COLOR_ID_GREEN>;
                };

                led@2 {
                    reg = <2>;
                    color = <LED_COLOR_ID_BLUE>;
                };
            };
        };
    };
```

## dts/bindings/leds/backlight/awinic,aw9364e.yaml
```yaml
# SPDX-License-Identifier: (GPL-2.0-only OR BSD-2-Clause)
%YAML 1.2
---
$id: http://devicetree.org/schemas/leds/backlight/awinic,aw9364e.yaml#
$schema: http://devicetree.org/meta-schemas/core.yaml#

title: Awinic AW9364E one-wire backlight

maintainers:
  - Gerard Marull-Paretas <gerard@teslabs.com>

description:
  White LED backlight driver controlled by a single GPIO line, as the Kinetic
  KTD253; enabling it gives full brightness, and pulses on the line dim it in
  16 steps.

allOf:
  - $ref: common.yaml#

properties:
  compatible:
    const: awinic,aw9364e

  enable-gpios:
    description: GPIO to use to enable/disable and dim the backlight.
    maxItems: 1

  default-brightness: true
  max-brightness: true

required:
  - compatible
  - enable-gpios

additionalProperties: false

examples:
  - |
    #include <dt-bindings/gpio/gpio.h>
    backlight {
        compatible = "awinic,aw9364e";
        enable-gpios = <&gpio1 1 GPIO_ACTIVE_HIGH>;
    };
```

## dts/bindings/mailbox/sifli,sf32lb52-mailbox.yaml
```yaml
# SPDX-License-Identifier: (GPL-2.0-only OR BSD-2-Clause)
%YAML 1.2
---
$id: http://devicetree.org/schemas/mailbox/sifli,sf32lb52-mailbox.yaml#
$schema: http://devicetree.org/meta-schemas/core.yaml#

title: SiFli SF32LB52 mailbox

maintainers:
  - Gerard Marull-Paretas <gerard@teslabs.com>

description:
  Mailbox block with 16 doorbells, each interrupting the CPU of the other
  subsystem. MAILBOX1, in HPSYS, rings the LCPU; MAILBOX2, in LPSYS, rings
  the HCPU, whose interrupt it has. Specifiers take one cell, the doorbell.

properties:
  compatible:
    oneOf:
      - const: sifli,sf32lb52-mailbox
      - items:
          - const: sifli,sf32lb57-mailbox
          - const: sifli,sf32lb52-mailbox

  reg:
    maxItems: 1

  interrupts:
    description: Present when the block's interrupt reaches this CPU.
    maxItems: 1

  clocks:
    description: Present when the block's clock is controlled by this CPU.
    maxItems: 1

  "#mbox-cells":
    const: 1

  "#hwlock-cells":
    description: Its mutex channels, as hardware locks.
    const: 1

required:
  - compatible
  - reg
  - "#mbox-cells"

additionalProperties: false

examples:
  - |
    mailbox@40002000 {
        compatible = "sifli,sf32lb52-mailbox";
        reg = <0x40002000 0x1000>;
        interrupts = <58>;
        #mbox-cells = <1>;
    };
```

## dts/bindings/memory-controllers/cypress,hyperram.yaml
```yaml
# SPDX-License-Identifier: (GPL-2.0-only OR BSD-2-Clause)
%YAML 1.2
---
$id: http://devicetree.org/schemas/memory-controllers/cypress,hyperram.yaml#
$schema: http://devicetree.org/meta-schemas/core.yaml#

title: HyperRAM

maintainers:
  - Gerard Marull-Paretas <gerard@teslabs.com>

description:
  PSRAM with a HyperBus interface, on a controller that maps it in its memory
  window. Its size and manufacturer are read from its identification
  registers.

properties:
  compatible:
    const: cypress,hyperram

  reg:
    maxItems: 1

  vcc-supply:
    description: Supply of the memory.

required:
  - compatible
  - reg

additionalProperties: false

examples:
  - |
    spi {
        #address-cells = <1>;
        #size-cells = <0>;

        psram@0 {
            compatible = "cypress,hyperram";
            reg = <0>;
            vcc-supply = <&buck1>;
        };
    };
```

## dts/bindings/mfd/nordic,npm1300.yaml
```yaml
# SPDX-License-Identifier: (GPL-2.0-only OR BSD-2-Clause)
%YAML 1.2
---
$id: http://devicetree.org/schemas/mfd/nordic,npm1300.yaml#
$schema: http://devicetree.org/meta-schemas/core.yaml#

title: Nordic nPM1300 power management IC

maintainers:
  - Gerard Marull-Paretas <gerard@teslabs.com>

description:
  Battery charger with fuel gauge support, two BUCK regulators, two load
  switches that can also run as LDOs, and GPIOs. The battery being charged is
  described by a simple-battery node.

properties:
  compatible:
    const: nordic,npm1300

  reg:
    maxItems: 1

  interrupts:
    maxItems: 1
    description: Event line, from the PMIC's GPIO1.

  gpio-controller: true

  '#gpio-cells':
    const: 2

  monitored-battery:
    $ref: /schemas/types.yaml#/definitions/phandle
    description: The battery being charged, a simple-battery node.

  nordic,reduced-charge-voltage-microvolt:
    description: Charge termination voltage in the warm and cool regions.
    minimum: 3500000
    maximum: 4450000

  nordic,thermistor-ohms:
    description: Nominal resistance of the battery NTC thermistor.
    enum: [10000, 47000, 100000]

  nordic,thermistor-beta:
    $ref: /schemas/types.yaml#/definitions/uint32
    description: Beta value of the battery NTC thermistor.

  nordic,thermistor-hot-celsius:
    description: Charging stops above this battery temperature.
    minimum: 0
    maximum: 80

  nordic,discharge-current-limit-microamp:
    description: Battery discharge current limit.
    enum: [200000, 1000000]

  input-current-limit-microamp:
    description: VBUS current limit while USB is connected.
    minimum: 100000
    maximum: 1500000

  nordic,startup-input-current-limit-microamp:
    description: VBUS current limit at startup.
    minimum: 100000
    maximum: 1500000

  regulators:
    type: object
    additionalProperties: false

    patternProperties:
      "^BUCK[12]$":
        type: object
        $ref: /schemas/regulator/regulator.yaml#
        unevaluatedProperties: false

      "^LDSW[12]$":
        type: object
        $ref: /schemas/regulator/regulator.yaml#
        unevaluatedProperties: false

        properties:
          nordic,ldo-mode:
            type: boolean
            description: Run as an LDO rather than as a load switch.

required:
  - compatible
  - reg
  - monitored-battery
  - nordic,reduced-charge-voltage-microvolt
  - nordic,thermistor-ohms
  - nordic,thermistor-beta
  - nordic,thermistor-hot-celsius
  - nordic,discharge-current-limit-microamp

additionalProperties: false

examples:
  - |
    #include <dt-bindings/interrupt-controller/irq.h>

    i2c {
        #address-cells = <1>;
        #size-cells = <0>;

        pmic@6b {
            compatible = "nordic,npm1300";
            reg = <0x6b>;
            interrupts = <26 IRQ_TYPE_EDGE_RISING>;
            gpio-controller;
            #gpio-cells = <2>;
            monitored-battery = <&battery>;
            nordic,reduced-charge-voltage-microvolt = <4000000>;
            nordic,thermistor-ohms = <10000>;
            nordic,thermistor-beta = <3380>;
            nordic,thermistor-hot-celsius = <45>;
            nordic,discharge-current-limit-microamp = <200000>;

            regulators {
                BUCK1 {
                    regulator-name = "npm1300_buck1";
                    regulator-min-microvolt = <1800000>;
                    regulator-max-microvolt = <1800000>;
                };

                LDSW1 {
                    regulator-name = "npm1300_ldsw1";
                    regulator-min-microvolt = <1800000>;
                    regulator-max-microvolt = <1800000>;
                    regulator-always-on;
                    nordic,ldo-mode;
                };
            };
        };
    };
```

## dts/bindings/mfd/sifli,sf32lb52-lptim.yaml
```yaml
# SPDX-License-Identifier: (GPL-2.0-only OR BSD-2-Clause)
%YAML 1.2
---
$id: http://devicetree.org/schemas/mfd/sifli,sf32lb52-lptim.yaml#
$schema: http://devicetree.org/meta-schemas/core.yaml#

title: SiFli SF32LB52 low-power timer

maintainers:
  - Gerard Marull-Paretas <gerard@teslabs.com>

description:
  Timer counting the low-power clock, so it keeps running in deep sleep. Its
  functions are child nodes, as the PWM output.

properties:
  compatible:
    const: sifli,sf32lb52-lptim

  reg:
    maxItems: 1

  interrupts:
    maxItems: 1

  clocks:
    maxItems: 1
    description: Counter clock, the low-power oscillator.

  pwm:
    type: object
    additionalProperties: false

    properties:
      compatible:
        const: sifli,sf32lb52-lptim-pwm

      "#pwm-cells":
        const: 3

      pinctrl-0: true

      pinctrl-names:
        const: default

      status: true

    required:
      - compatible
      - "#pwm-cells"

required:
  - compatible
  - reg
  - interrupts
  - clocks

additionalProperties: false

examples:
  - |
    timer@500c2000 {
        compatible = "sifli,sf32lb52-lptim";
        reg = <0x500c2000 0x1000>;
        interrupts = <47>;
        clocks = <&rtc>;

        pwm {
            compatible = "sifli,sf32lb52-lptim-pwm";
            #pwm-cells = <3>;
        };
    };
```

## dts/bindings/mfd/sifli,sf32lb52-pmuc.yaml
```yaml
# SPDX-License-Identifier: (GPL-2.0-only OR BSD-2-Clause)
%YAML 1.2
---
$id: http://devicetree.org/schemas/mfd/sifli,sf32lb52-pmuc.yaml#
$schema: http://devicetree.org/meta-schemas/core.yaml#

title: SiFli SF32LB52 power management unit controller

maintainers:
  - Gerard Marull-Paretas <gerard@teslabs.com>

description: |
  The always-on power management unit of the SF32LB52. It runs the
  oscillators of the SoC and provides their clocks, whose specifiers take one
  cell, an ID from <dt-bindings/clock/sifli,sf32lb52-pmuc.h>:

  - LRC10, the RC oscillator of about 10 kHz that runs in deep sleep;
  - LRC32, the RC oscillator of about 32 kHz;
  - LXT32, the oscillator of the 32.768 kHz crystal, on boards that fit one;
  - HRC48, the 48 MHz RC oscillator, which the unit trims against HXT48 with
    the calibration counter of the HPSYS RCC;
  - HXT48, the oscillator of the 48 MHz crystal, and HXT48_DLL, the same
    through the buffer that feeds the DLLs;
  - WDT, clk_wdt, LRC10 or LRC32, which clocks the watchdogs and the unit
    itself.

  It also powers the HPSYS, a power domain whose specifiers take one cell, an
  ID from <dt-bindings/power/sifli,sf32lb52-pmuc.h>. Its performance states
  are the voltage modes of the HPSYS, D0, D1, S0 and S1, the opp-level values
  of its OPP table, from the same header: each sets the buck and HPSYS LDO
  voltages, trimmed at the factory, and the voltage mode and memory timings of
  the HPSYS configuration.

  The load capacitance of the 48 MHz crystal is trimmed from the factory
  configuration of the SoC, kept in nvmem cells.

properties:
  compatible:
    const: sifli,sf32lb52-pmuc

  reg:
    maxItems: 1

  interrupts:
    maxItems: 1

  "#clock-cells":
    const: 1

  "#power-domain-cells":
    const: 1

  operating-points-v2:
    maxItems: 1

  sifli,hpsys-cfg:
    $ref: /schemas/types.yaml#/definitions/phandle
    description: HPSYS configuration, for the voltage mode and memory timings.

  sifli,hpsys-rcc:
    $ref: /schemas/types.yaml#/definitions/phandle
    description: HPSYS RCC, for its HRC48 calibration counter.

  sifli,bt-mac:
    $ref: /schemas/types.yaml#/definitions/phandle
    description: Bluetooth controller, for its LRC10 calibration counter.

  sifli,lpsys-aon:
    $ref: /schemas/types.yaml#/definitions/phandle
    description: LPSYS always-on block, requesting the crystal LRC10 is counted against.

  sifli,lpsys-rcc:
    $ref: /schemas/types.yaml#/definitions/phandle
    description: LPSYS RCC, running LPSYS from the crystal while LRC10 is counted.

  hwlocks:
    description: Lock of the LRC10 calibration counter, shared with the LCPU.
    maxItems: 1

  clocks:
    minItems: 1
    items:
      - description: 48 MHz crystal
      - description: 32.768 kHz crystal

  clock-names:
    minItems: 1
    items:
      - const: hxt48
      - const: lxt32

  nvmem-cells:
    description: Cells holding the factory configuration, in search order.
    minItems: 1
    maxItems: 2

  nvmem-cell-names:
    minItems: 1
    items:
      - const: soc-config-user
      - const: soc-config-cust

required:
  - compatible
  - reg
  - "#clock-cells"
  - "#power-domain-cells"
  - operating-points-v2
  - sifli,hpsys-cfg
  - sifli,hpsys-rcc
  - sifli,bt-mac
  - sifli,lpsys-aon
  - sifli,lpsys-rcc
  - hwlocks
  - clocks
  - clock-names

additionalProperties: false

examples:
  - |
    power-management@500ca000 {
        compatible = "sifli,sf32lb52-pmuc";
        reg = <0x500ca000 0x1000>;
        interrupts = <48>;
        #clock-cells = <1>;
        #power-domain-cells = <1>;
        clocks = <&xtal48m>;
        clock-names = "hxt48";
        operating-points-v2 = <&hpsys_opp_table>;
        sifli,hpsys-cfg = <&hpsys_cfg>;
        sifli,hpsys-rcc = <&hpsys_rcc>;
        sifli,bt-mac = <&bt_mac>;
        sifli,lpsys-aon = <&lpsys_aon>;
        sifli,lpsys-rcc = <&lpsys_rcc>;
        hwlocks = <&mailbox2 0>;
        nvmem-cells = <&soc_config_user>, <&soc_config_cust>;
        nvmem-cell-names = "soc-config-user", "soc-config-cust";
    };
```
