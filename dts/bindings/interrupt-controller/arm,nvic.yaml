## dts/bindings/mfd/sifli,sf32lb57-pmuc.yaml
```yaml
# SPDX-License-Identifier: (GPL-2.0-only OR BSD-2-Clause)
%YAML 1.2
---
$id: http://devicetree.org/schemas/mfd/sifli,sf32lb57-pmuc.yaml#
$schema: http://devicetree.org/meta-schemas/core.yaml#

title: SiFli SF32LB57 power management unit controller

maintainers:
  - Gerard Marull-Paretas <gerard@teslabs.com>

description: |
  The always-on power management unit of the SF32LB57. It runs the
  oscillators of the SoC and provides their clocks, whose specifiers take one
  cell, an ID from <dt-bindings/clock/sifli,sf32lb57-pmuc.h>:

  - LRC10, the RC oscillator of about 10 kHz that runs in deep sleep;
  - LRC32, the RC oscillator of about 32 kHz;
  - LXT32, the oscillator of the 32.768 kHz crystal, on boards that fit one;
  - HRC48, the 48 MHz RC oscillator;
  - HXT48, the oscillator of the 48 MHz crystal, and HXT48_DLL, the same
    through the buffer that feeds the DLLs;
  - WDT, clk_wdt, LRC10 or LRC32, which clocks the watchdogs and the unit
    itself;
  - RTC, clk_rtc, LRC10 or LXT32, which the RTC and the low-power timers
    count.

properties:
  compatible:
    const: sifli,sf32lb57-pmuc

  reg:
    maxItems: 1

  interrupts:
    maxItems: 1

  "#clock-cells":
    const: 1

  clocks:
    minItems: 1
    items:
      - description: 48 MHz crystal
      - description: 32.768 kHz crystal

  clock-names:
    minItems: 1
    items:
      - const: hxt48
      - const: lxt32

  "#power-domain-cells":
    const: 1

  operating-points-v2:
    maxItems: 1

  sifli,hpsys-cfg:
    $ref: /schemas/types.yaml#/definitions/phandle
    description: HPSYS configuration, for the voltage mode and memory timings.

  sifli,hpsys-rcc:
    $ref: /schemas/types.yaml#/definitions/phandle
    description: HPSYS RCC, whose RC10CAL counter measures LRC10 against the 48 MHz crystal.

required:
  - compatible
  - reg
  - "#clock-cells"
  - clocks
  - clock-names
  - "#power-domain-cells"
  - operating-points-v2
  - sifli,hpsys-cfg
  - sifli,hpsys-rcc

additionalProperties: false

examples:
  - |
    power-management@500ca000 {
        compatible = "sifli,sf32lb57-pmuc";
        reg = <0x500ca000 0x1000>;
        interrupts = <48>;
        #clock-cells = <1>;
        clocks = <&xtal48m>;
        clock-names = "hxt48";
        #power-domain-cells = <1>;
        operating-points-v2 = <&hpsys_opp_table>;
        sifli,hpsys-cfg = <&hpsys_cfg>;
        sifli,hpsys-rcc = <&hpsys_rcc>;
    };
```

## dts/bindings/mtd/qemu,pebble-extflash.yaml
```yaml
# SPDX-License-Identifier: (GPL-2.0-only OR BSD-2-Clause)
%YAML 1.2
---
$id: http://devicetree.org/schemas/mtd/qemu,pebble-extflash.yaml#
$schema: http://devicetree.org/meta-schemas/core.yaml#

title: QEMU Pebble external flash

maintainers:
  - Gerard Marull-Paretas <gerard@teslabs.com>

description:
  NOR flash of the QEMU Pebble machines, read through a memory window and
  programmed and erased through its registers.

allOf:
  - $ref: /schemas/mtd/mtd.yaml#

properties:
  compatible:
    const: qemu,pebble-extflash

  reg:
    items:
      - description: Registers
      - description: Memory window, the size of the flash

  reg-names:
    items:
      - const: regs
      - const: mem

required:
  - compatible
  - reg
  - reg-names

unevaluatedProperties: false

examples:
  - |
    flash@40010000 {
        compatible = "qemu,pebble-extflash";
        reg = <0x40010000 0x1000>, <0x10000000 0x2000000>;
        reg-names = "regs", "mem";
    };
```

## dts/bindings/nvmem/sifli,sf32lb52-efuse.yaml
```yaml
# SPDX-License-Identifier: (GPL-2.0-only OR BSD-2-Clause)
%YAML 1.2
---
$id: http://devicetree.org/schemas/nvmem/sifli,sf32lb52-efuse.yaml#
$schema: http://devicetree.org/meta-schemas/core.yaml#

title: SiFli SF32LB52 and SF32LB57 eFuse controller

maintainers:
  - Gerard Marull-Paretas <gerard@teslabs.com>

description:
  The eFuse of the SF32LB52, 128 bytes in four banks, or of the SF32LB57, 96
  bytes in three, holding the unique ID and the factory calibration. SF32LB52
  reads need the HPSYS LDO raised, in the PMUC.

allOf:
  - $ref: nvmem.yaml#
  - if:
      properties:
        compatible:
          const: sifli,sf32lb52-efuse
    then:
      required:
        - sifli,pmuc

properties:
  compatible:
    enum:
      - sifli,sf32lb52-efuse
      - sifli,sf32lb57-efuse

  reg:
    maxItems: 1

  clocks:
    maxItems: 1

  sifli,pmuc:
    $ref: /schemas/types.yaml#/definitions/phandle
    description: PMUC, holding the HPSYS LDO that SF32LB52 reads raise.

required:
  - compatible
  - reg
  - clocks

unevaluatedProperties: false

examples:
  - |
    efuse@5000c000 {
        compatible = "sifli,sf32lb52-efuse";
        reg = <0x5000c000 0x1000>;
        clocks = <&hpsys_rcc 9>;
        sifli,pmuc = <&pmuc>;
        read-only;
    };
```

## dts/bindings/pinctrl/sifli,sf32lb52-pinctrl.yaml
```yaml
# SPDX-License-Identifier: (GPL-2.0-only OR BSD-2-Clause)
%YAML 1.2
---
$id: http://devicetree.org/schemas/pinctrl/sifli,sf32lb52-pinctrl.yaml#
$schema: http://devicetree.org/meta-schemas/core.yaml#

title: SiFli SF32LB52 pin controller (HPSYS PINMUX)

maintainers:
  - Gerard Marull-Paretas <gerard@teslabs.com>

description: |
  Selects the function of each SA and PA pad and configures the pad. Functions
  are named after the signal, e.g. i2c1_scl. Pin configuration states are
  children of the controller, holding groups of pins that share a function and
  a pad configuration.

properties:
  compatible:
    const: sifli,sf32lb52-pinctrl

  reg:
    maxItems: 1

  sifli,hpsys-cfg:
    $ref: /schemas/types.yaml#/definitions/phandle
    description: HPSYS configuration block, holding the pin routing crossbar.

  sifli,rtc:
    $ref: /schemas/types.yaml#/definitions/phandle
    description: RTC, holding the always-on pad pulls and backup outputs.

  sifli,hpsys-aon:
    $ref: /schemas/types.yaml#/definitions/phandle
    description: HPSYS always-on block, selecting the backup timer outputs.

patternProperties:
  '-state$':
    type: object
    description: A pin configuration state, referenced from pinctrl-N.

    patternProperties:
      '^(.+-)?pins$':
        type: object
        description: A group of pins sharing their pad configuration.
        allOf:
          - $ref: /schemas/pinctrl/pincfg-node.yaml#
          - $ref: /schemas/pinctrl/pinmux-node.yaml#

        properties:
          pins:
            items:
              pattern: '^(PA|SA)[0-9][0-9]$'

          function:
            pattern: '^[a-z0-9_]+$'

          bias-pull-up: true
          bias-pull-down: true
          input-enable: true

          output-low:
            description: Driven low by GPIO1, with the gpio function.
            type: boolean

          drive-strength:
            enum: [2, 4, 8, 12, 20]

        required:
          - pins
          - function

        additionalProperties: false

    additionalProperties: false

required:
  - compatible
  - reg
  - sifli,hpsys-cfg
  - sifli,rtc
  - sifli,hpsys-aon

additionalProperties: false

examples:
  - |
    pinctrl@50003000 {
        compatible = "sifli,sf32lb52-pinctrl";
        reg = <0x50003000 0x100>;
        sifli,hpsys-cfg = <&hpsys_cfg>;
        sifli,rtc = <&rtc>;
        sifli,hpsys-aon = <&hpsys_aon>;

        i2c1-default-state {
            scl-pins {
                pins = "PA31";
                function = "i2c1_scl";
                input-enable;
                drive-strength = <8>;
            };
        };
    };
```

## dts/bindings/pinctrl/sifli,sf32lb57-pinctrl.yaml
```yaml
# SPDX-License-Identifier: (GPL-2.0-only OR BSD-2-Clause)
%YAML 1.2
---
$id: http://devicetree.org/schemas/pinctrl/sifli,sf32lb57-pinctrl.yaml#
$schema: http://devicetree.org/meta-schemas/core.yaml#

title: SiFli SF32LB57 pin controller (HPSYS PINMUX)

maintainers:
  - Gerard Marull-Paretas <gerard@teslabs.com>

description: |
  Selects the function of each SA, SB and PA pad and configures the pad. Any
  PA pad takes any signal of the FreeIO matrix. Functions are named after the
  signal, e.g. usart1_txd. Pin configuration states are children of the
  controller, holding groups of pins that share a function and a pad
  configuration.

properties:
  compatible:
    const: sifli,sf32lb57-pinctrl

  reg:
    maxItems: 1

patternProperties:
  '-state$':
    type: object
    description: A pin configuration state, referenced from pinctrl-N.

    patternProperties:
      '^(.+-)?pins$':
        type: object
        description: A group of pins sharing their pad configuration.
        allOf:
          - $ref: /schemas/pinctrl/pincfg-node.yaml#
          - $ref: /schemas/pinctrl/pinmux-node.yaml#

        properties:
          pins:
            items:
              pattern: '^(PA|SA|SB)[0-9][0-9]$'

          function:
            pattern: '^[a-z0-9_]+$'

          bias-pull-up: true
          bias-pull-down: true
          input-enable: true

          drive-strength:
            enum: [2, 4, 8, 12]

        required:
          - pins
          - function

        additionalProperties: false

    additionalProperties: false

required:
  - compatible
  - reg

additionalProperties: false

examples:
  - |
    pinctrl@50003000 {
        compatible = "sifli,sf32lb57-pinctrl";
        reg = <0x50003000 0x150>;

        usart1-default-state {
            tx-pins {
                pins = "PA19";
                function = "usart1_txd";
                drive-strength = <4>;
            };
        };
    };
```

## dts/bindings/pwm/nordic,nrf52832-pwm.yaml
```yaml
# SPDX-License-Identifier: (GPL-2.0-only OR BSD-2-Clause)
%YAML 1.2
---
$id: http://devicetree.org/schemas/pwm/nordic,nrf52832-pwm.yaml#
$schema: http://devicetree.org/meta-schemas/core.yaml#

title: Nordic nRF52 PWM

maintainers:
  - Gerard Marull-Paretas <gerard@teslabs.com>

description:
  Four-channel PWM controller of the nRF52 series, first in the nRF52832. Its
  pins are selected in its own registers, from out-gpios, one per channel in
  order.

allOf:
  - $ref: pwm.yaml#

properties:
  compatible:
    oneOf:
      - const: nordic,nrf52832-pwm
      - items:
          - enum:
              - nordic,nrf52833-pwm
              - nordic,nrf52840-pwm
          - const: nordic,nrf52832-pwm

  reg:
    maxItems: 1

  interrupts:
    maxItems: 1

  "#pwm-cells":
    const: 3

  out-gpios:
    minItems: 1
    maxItems: 4
    description: Outputs of channels 0 to 3.

required:
  - compatible
  - reg
  - interrupts

unevaluatedProperties: false

examples:
  - |
    pwm@4001c000 {
        compatible = "nordic,nrf52840-pwm", "nordic,nrf52832-pwm";
        reg = <0x4001c000 0x1000>;
        interrupts = <28>;
        #pwm-cells = <3>;
        out-gpios = <&gpio0 26 0>;
    };
```

## dts/bindings/remoteproc/sifli,sf32lb52-lcpu.yaml
```yaml
# SPDX-License-Identifier: (GPL-2.0-only OR BSD-2-Clause)
%YAML 1.2
---
$id: http://devicetree.org/schemas/remoteproc/sifli,sf32lb52-lcpu.yaml#
$schema: http://devicetree.org/meta-schemas/core.yaml#

title: SiFli SF32LB52 and SF32LB57 low-power CPU

maintainers:
  - Gerard Marull-Paretas <gerard@teslabs.com>

description:
  The LCPU of the SF32LB52 and SF32LB57, running the Bluetooth controller
  from ROM. It exchanges messages with the HCPU over rings signalled with a
  doorbell in each direction; the HCPU to LCPU ring is in HCPU memory
  reserved for it.

properties:
  compatible:
    enum:
      - sifli,sf32lb52-lcpu
      - sifli,sf32lb57-lcpu

  reg:
    description: ROM patch controller
    maxItems: 1

  "#address-cells":
    const: 1

  "#size-cells":
    const: 1

  dma-ranges:
    description:
      Memory as the LCPU sees it, LPSYS SRAM through its code bus first, then
      HPSYS SRAM.
    items:
      - description: LPSYS SRAM through the code bus
      - description: HPSYS SRAM

  mboxes:
    items:
      - description: Doorbell to the LCPU
      - description: Doorbell from the LCPU

  mbox-names:
    items:
      - const: tx
      - const: rx

  memory-region:
    description: HCPU memory holding the HCPU to LCPU ring.
    maxItems: 1

  sram:
    description: LPSYS SRAM region the LCPU works in.
    maxItems: 1

  clocks:
    items:
      - description: LCPU clock
      - description: LPSYS APB clock
      - description: LPSYS second APB clock
      - description: Low-power clock, from the RTC

  clock-names:
    items:
      - const: hclk
      - const: pclk
      - const: pclk2
      - const: lpclk

  sifli,bt-rfc:
    $ref: /schemas/types.yaml#/definitions/phandle
    description: Bluetooth RF controller, calibrated before the LCPU boots.

  sifli,bt-phy:
    $ref: /schemas/types.yaml#/definitions/phandle
    description: Bluetooth PHY, set up by the radio calibration.

  sifli,bt-mac:
    $ref: /schemas/types.yaml#/definitions/phandle
    description: Bluetooth controller, forced to transmit during calibration.

  sifli,gpadc:
    $ref: /schemas/types.yaml#/definitions/phandle
    description: ADC measuring the transmitter output during calibration.

  sifli,dmac:
    $ref: /schemas/types.yaml#/definitions/phandle
    description: DMA controller capturing samples during calibration.

  sifli,lpsys-rcc:
    $ref: /schemas/types.yaml#/definitions/phandle
    description: LPSYS clock and reset controller.

  sifli,hpsys-cfg:
    $ref: /schemas/types.yaml#/definitions/phandle
    description: HPSYS configuration registers, for the bandgap.

  sifli,pmuc:
    $ref: /schemas/types.yaml#/definitions/phandle
    description: Power management unit, for the buck during calibration.

required:
  - compatible
  - reg
  - "#address-cells"
  - "#size-cells"
  - dma-ranges
  - mboxes
  - mbox-names
  - memory-region
  - sram
  - clocks
  - clock-names
  - sifli,bt-rfc
  - sifli,bt-phy
  - sifli,bt-mac
  - sifli,gpadc
  - sifli,dmac
  - sifli,lpsys-rcc
  - sifli,hpsys-cfg
  - sifli,pmuc

additionalProperties: false

examples:
  - |
    remoteproc@40004000 {
        compatible = "sifli,sf32lb52-lcpu";
        reg = <0x40004000 0x1000>;
        #address-cells = <1>;
        #size-cells = <1>;
        dma-ranges = <0x00400000 0x20400000 0x10000>,
                     <0x2a000000 0x20000000 0x80000>;
        mboxes = <&mailbox1 0>, <&mailbox2 0>;
        mbox-names = "tx", "rx";
        memory-region = <&lcpu_ipc>;
        sram = <&lcpu_sram>;
        clocks = <&lpsys_rcc 1>, <&lpsys_rcc 2>, <&lpsys_rcc 3>, <&rtc>;
        clock-names = "hclk", "pclk", "pclk2", "lpclk";
        sifli,bt-rfc = <&bt_rfc>;
        sifli,bt-phy = <&bt_phy>;
        sifli,bt-mac = <&bt_mac>;
        sifli,gpadc = <&gpadc>;
        sifli,dmac = <&dmac2>;
        sifli,lpsys-rcc = <&lpsys_rcc>;
        sifli,hpsys-cfg = <&hpsys_cfg>;
        sifli,pmuc = <&pmuc>;
    };
```

## dts/bindings/rng/sifli,sf32lb52-trng.yaml
```yaml
# SPDX-License-Identifier: (GPL-2.0-only OR BSD-2-Clause)
%YAML 1.2
---
$id: http://devicetree.org/schemas/rng/sifli,sf32lb52-trng.yaml#
$schema: http://devicetree.org/meta-schemas/core.yaml#

title: SiFli SF32LB52 true random number generator

maintainers:
  - Gerard Marull-Paretas <gerard@teslabs.com>

properties:
  compatible:
    const: sifli,sf32lb52-trng

  reg:
    maxItems: 1

  clocks:
    maxItems: 1

required:
  - compatible
  - reg
  - clocks

additionalProperties: false

examples:
  - |
    rng@5000f000 {
        compatible = "sifli,sf32lb52-trng";
        reg = <0x5000f000 0x1000>;
        clocks = <&hpsys_rcc 12>;
    };
```
