## dts/bindings/rtc/nordic,nrf52832-rtc.yaml
```yaml
# SPDX-License-Identifier: (GPL-2.0-only OR BSD-2-Clause)
%YAML 1.2
---
$id: http://devicetree.org/schemas/rtc/nordic,nrf52832-rtc.yaml#
$schema: http://devicetree.org/meta-schemas/core.yaml#

title: Nordic nRF52 RTC

maintainers:
  - Gerard Marull-Paretas <gerard@teslabs.com>

description:
  Counter of the 32768 Hz low-frequency clock with compare events. Its
  functions are child nodes, as a PWM output driven through PPI and GPIOTE.

properties:
  compatible:
    oneOf:
      - const: nordic,nrf52832-rtc
      - items:
          - enum:
              - nordic,nrf52833-rtc
              - nordic,nrf52840-rtc
          - const: nordic,nrf52832-rtc

  reg:
    maxItems: 1

  interrupts:
    maxItems: 1

  clocks:
    items:
      - description: LFCLK

  pwm:
    type: object
    additionalProperties: false
    description: PWM output on a GPIO, toggled by GPIOTE tasks on compare events.

    properties:
      compatible:
        const: nordic,nrf52832-rtc-pwm

      "#pwm-cells":
        const: 3

      gpios:
        maxItems: 1
        description: Output.

      nordic,gpiote:
        $ref: /schemas/types.yaml#/definitions/phandle
        description: GPIOTE whose tasks drive the output, on one of its channels.

      nordic,ppi:
        $ref: /schemas/types.yaml#/definitions/phandle
        description:
          PPI connecting the compare events to the GPIOTE tasks, on two of its
          channels.

      status: true

    required:
      - compatible
      - "#pwm-cells"
      - gpios
      - nordic,gpiote
      - nordic,ppi

required:
  - compatible
  - reg
  - interrupts
  - clocks

additionalProperties: false

examples:
  - |
    rtc@40024000 {
        compatible = "nordic,nrf52840-rtc", "nordic,nrf52832-rtc";
        reg = <0x40024000 0x1000>;
        interrupts = <36>;
        clocks = <&clock 1>;

        pwm {
            compatible = "nordic,nrf52832-rtc-pwm";
            #pwm-cells = <3>;
            gpios = <&gpio1 15 0>;
            nordic,gpiote = <&gpiote>;
            nordic,ppi = <&ppi>;
        };
    };
```

## dts/bindings/rtc/sifli,sf32lb52-rtc.yaml
```yaml
# SPDX-License-Identifier: (GPL-2.0-only OR BSD-2-Clause)
%YAML 1.2
---
$id: http://devicetree.org/schemas/rtc/sifli,sf32lb52-rtc.yaml#
$schema: http://devicetree.org/meta-schemas/core.yaml#

title: SiFli SF32LB52 real-time clock

maintainers:
  - Gerard Marull-Paretas <gerard@teslabs.com>

description:
  Calendar RTC of the SF32LB52. It selects clk_rtc, LRC10 or LXT32, which it
  counts and provides to the low-power timers and the Bluetooth sleep timer.

allOf:
  - $ref: rtc.yaml#

properties:
  compatible:
    const: sifli,sf32lb52-rtc

  reg:
    maxItems: 1

  interrupts:
    maxItems: 1

  "#clock-cells":
    const: 0

  clocks:
    items:
      - description: LRC10 oscillator
      - description: LXT32 oscillator

  clock-names:
    items:
      - const: lrc10
      - const: lxt32

required:
  - compatible
  - reg
  - interrupts
  - "#clock-cells"
  - clocks
  - clock-names

unevaluatedProperties: false

examples:
  - |
    rtc@500cb000 {
        compatible = "sifli,sf32lb52-rtc";
        reg = <0x500cb000 0x1000>;
        interrupts = <49>;
        #clock-cells = <0>;
        clocks = <&pmuc 0>, <&pmuc 2>;
        clock-names = "lrc10", "lxt32";
    };
```

## dts/bindings/serial/nordic,nrf52832-uarte.yaml
```yaml
# SPDX-License-Identifier: (GPL-2.0-only OR BSD-2-Clause)
%YAML 1.2
---
$id: http://devicetree.org/schemas/serial/nordic,nrf52832-uarte.yaml#
$schema: http://devicetree.org/meta-schemas/core.yaml#

title: Nordic nRF52 UARTE

maintainers:
  - Gerard Marull-Paretas <gerard@teslabs.com>

description:
  UART with EasyDMA of the nRF52 series, first in the nRF52832. Its pins are
  selected in its own registers, from tx-gpios and rx-gpios.

allOf:
  - $ref: /schemas/serial/serial.yaml#

properties:
  compatible:
    oneOf:
      - const: nordic,nrf52832-uarte
      - items:
          - enum:
              - nordic,nrf52833-uarte
              - nordic,nrf52840-uarte
          - const: nordic,nrf52832-uarte

  reg:
    maxItems: 1

  interrupts:
    maxItems: 1

  current-speed:
    $ref: /schemas/types.yaml#/definitions/uint32
    description: Initial baud rate, in bits per second.

  tx-gpios:
    maxItems: 1

  rx-gpios:
    maxItems: 1

  nordic,timer:
    $ref: /schemas/types.yaml#/definitions/phandle
    description:
      TIMER counting the received bytes, through PPI, in counter mode. Each
      port needs its own.

required:
  - compatible
  - reg
  - interrupts
  - tx-gpios
  - rx-gpios
  - nordic,timer

unevaluatedProperties: false

examples:
  - |
    serial@40002000 {
        compatible = "nordic,nrf52840-uarte", "nordic,nrf52832-uarte";
        reg = <0x40002000 0x1000>;
        interrupts = <2>;
        current-speed = <1000000>;
        tx-gpios = <&gpio0 27 0>;
        rx-gpios = <&gpio0 5 0>;
        nordic,timer = <&timer2>;
    };
```

## dts/bindings/serial/qemu,pebble-simple-uart.yaml
```yaml
# SPDX-License-Identifier: (GPL-2.0-only OR BSD-2-Clause)
%YAML 1.2
---
$id: http://devicetree.org/schemas/serial/qemu,pebble-simple-uart.yaml#
$schema: http://devicetree.org/meta-schemas/core.yaml#

title: QEMU Pebble simple UART

maintainers:
  - Gerard Marull-Paretas <gerard@teslabs.com>

description:
  Serial port of the QEMU Pebble machines, connected to a host character
  device. It has no line settings and accepts any baud rate.

allOf:
  - $ref: /schemas/serial/serial.yaml#

properties:
  compatible:
    const: qemu,pebble-simple-uart

  reg:
    maxItems: 1

  interrupts:
    maxItems: 1

  current-speed:
    $ref: /schemas/types.yaml#/definitions/uint32
    description: Initial baud rate, in bits per second.

required:
  - compatible
  - reg
  - interrupts

unevaluatedProperties: false

examples:
  - |
    serial@40002000 {
        compatible = "qemu,pebble-simple-uart";
        reg = <0x40002000 0x1000>;
        interrupts = <2>;
    };
```

## dts/bindings/serial/sifli,sf32lb52-usart.yaml
```yaml
# SPDX-License-Identifier: (GPL-2.0-only OR BSD-2-Clause)
%YAML 1.2
---
$id: http://devicetree.org/schemas/serial/sifli,sf32lb52-usart.yaml#
$schema: http://devicetree.org/meta-schemas/core.yaml#

title: SiFli SF32LB52 USART

maintainers:
  - Gerard Marull-Paretas <gerard@teslabs.com>

allOf:
  - $ref: /schemas/serial/serial.yaml#

properties:
  compatible:
    const: sifli,sf32lb52-usart

  reg:
    maxItems: 1

  interrupts:
    maxItems: 1

  current-speed:
    $ref: /schemas/types.yaml#/definitions/uint32
    description: Initial baud rate, in bits per second.

  clocks:
    description: Absent on USART1, which the RCC cannot gate.
    maxItems: 1

  resets:
    maxItems: 1

  dmas:
    minItems: 1
    maxItems: 2

  dma-names:
    minItems: 1
    items:
      - enum: [rx, tx]
      - const: tx

required:
  - compatible
  - reg
  - interrupts
  - resets

unevaluatedProperties: false

examples:
  - |
    serial@50084000 {
        compatible = "sifli,sf32lb52-usart";
        reg = <0x50084000 0x1000>;
        interrupts = <59>;
        resets = <&hpsys_rcc 3>;
        current-speed = <1000000>;
        dmas = <&dmac1 0 5 1>;
        dma-names = "rx";
    };
```

## dts/bindings/soc/nordic/nordic,nrf52832-gpiote.yaml
```yaml
# SPDX-License-Identifier: (GPL-2.0-only OR BSD-2-Clause)
%YAML 1.2
---
$id: http://devicetree.org/schemas/soc/nordic/nordic,nrf52832-gpiote.yaml#
$schema: http://devicetree.org/meta-schemas/core.yaml#

title: Nordic nRF52 GPIO tasks and events (GPIOTE)

maintainers:
  - Gerard Marull-Paretas <gerard@teslabs.com>

description:
  Turns the state changes of pins into events, and drives pins from tasks, on
  a number of channels each bound to a pin. Its interrupt is the one the pins
  of the GPIO ports raise.

properties:
  compatible:
    oneOf:
      - const: nordic,nrf52832-gpiote
      - items:
          - enum:
              - nordic,nrf52833-gpiote
              - nordic,nrf52840-gpiote
          - const: nordic,nrf52832-gpiote

  reg:
    maxItems: 1

  interrupts:
    maxItems: 1

required:
  - compatible
  - reg
  - interrupts

additionalProperties: false

examples:
  - |
    gpiote@40006000 {
        compatible = "nordic,nrf52840-gpiote", "nordic,nrf52832-gpiote";
        reg = <0x40006000 0x1000>;
        interrupts = <6>;
    };
```

## dts/bindings/soc/nordic/nordic,nrf52832-ppi.yaml
```yaml
# SPDX-License-Identifier: (GPL-2.0-only OR BSD-2-Clause)
%YAML 1.2
---
$id: http://devicetree.org/schemas/soc/nordic/nordic,nrf52832-ppi.yaml#
$schema: http://devicetree.org/meta-schemas/core.yaml#

title: Nordic nRF52 programmable peripheral interconnect (PPI)

maintainers:
  - Gerard Marull-Paretas <gerard@teslabs.com>

description:
  Connects an event of a peripheral to tasks of others, without the CPU, on a
  number of channels.

properties:
  compatible:
    oneOf:
      - const: nordic,nrf52832-ppi
      - items:
          - enum:
              - nordic,nrf52833-ppi
              - nordic,nrf52840-ppi
          - const: nordic,nrf52832-ppi

  reg:
    maxItems: 1

required:
  - compatible
  - reg

additionalProperties: false

examples:
  - |
    ppi@4001f000 {
        compatible = "nordic,nrf52840-ppi", "nordic,nrf52832-ppi";
        reg = <0x4001f000 0x1000>;
    };
```

## dts/bindings/soc/sifli/sifli,sf32lb52-aon.yaml
```yaml
# SPDX-License-Identifier: (GPL-2.0-only OR BSD-2-Clause)
%YAML 1.2
---
$id: http://devicetree.org/schemas/soc/sifli/sifli,sf32lb52-aon.yaml#
$schema: http://devicetree.org/meta-schemas/core.yaml#

title: SiFli SF32LB52 always-on power and wakeup control

maintainers:
  - Gerard Marull-Paretas <gerard@teslabs.com>

description:
  Always-on registers of the SF32LB52 HPSYS and LPSYS, which other blocks
  use, as the power mode and wakeup sources of each subsystem, the requests
  between them and the oscillators they ask for.

properties:
  compatible:
    items:
      - enum:
          - sifli,sf32lb52-hpsys-aon
          - sifli,sf32lb52-lpsys-aon
          - sifli,sf32lb57-hpsys-aon
          - sifli,sf32lb57-lpsys-aon
      - const: syscon

  reg:
    maxItems: 1

required:
  - compatible
  - reg

additionalProperties: false

examples:
  - |
    syscon@500c0000 {
        compatible = "sifli,sf32lb52-hpsys-aon", "syscon";
        reg = <0x500c0000 0x1000>;
    };
```

## dts/bindings/soc/sifli/sifli,sf32lb52-bt-mac.yaml
```yaml
# SPDX-License-Identifier: (GPL-2.0-only OR BSD-2-Clause)
%YAML 1.2
---
$id: http://devicetree.org/schemas/soc/sifli/sifli,sf32lb52-bt-mac.yaml#
$schema: http://devicetree.org/meta-schemas/core.yaml#

title: SiFli SF32LB52 Bluetooth controller registers

maintainers:
  - Gerard Marull-Paretas <gerard@teslabs.com>

description:
  Registers of the Bluetooth controller in LPSYS, which the LCPU runs. Other
  blocks use its RC oscillator calibration counter, which counts LPSYS clock
  cycles over a number of LRC10 cycles.

properties:
  compatible:
    items:
      - enum:
          - sifli,sf32lb52-bt-mac
          - sifli,sf32lb57-bt-mac
      - const: syscon

  reg:
    maxItems: 1

required:
  - compatible
  - reg

additionalProperties: false

examples:
  - |
    syscon@40090000 {
        compatible = "sifli,sf32lb52-bt-mac", "syscon";
        reg = <0x40090000 0x1000>;
    };
```
