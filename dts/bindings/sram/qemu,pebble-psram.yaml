## pebble/services/bluetooth/Kconfig
```kconfig
# SPDX-FileCopyrightText: 2026 Core Devices LLC
# SPDX-License-Identifier: Apache-2.0

config SERVICE_BLUETOOTH
    bool "Bluetooth"
    help
      Core Bluetooth service (pairing, bonding, local id, ...).

# iOS notifications. Off in the recovery firmware, which has no notification UI.
config BT_ANCS_CLIENT
    default y if !RECOVERY_FW

# iOS music control. Off in the recovery firmware, which has no music UI.
config BT_AMS_CLIENT
    default y if !RECOVERY_FW

# What the phone app talks to.
config BT_SERVICE_PPS
    default y

config PP_TRANSPORT_GATT_REVERSED
    default y

if SERVICE_BLUETOOTH

config SERVICE_BLUETOOTH_VENDOR_ID
    hex "Vendor ID"
    default 0x0EEA
    help
      Company identifier in the manufacturer data of advertisements.

config SERVICE_BLUETOOTH_VENDOR_NAME
    string "Vendor name"
    default "Core Devices LLC"
    help
      Manufacturer name in the Device Information Service.

config SERVICE_BLUETOOTH_ADV_RECONNECT
    bool "Advertise for the bonded phone to reconnect"
    help
      Advertise an empty payload while there is a bond and nothing asks for
      discovery. Without it, only discovery is advertised, so that a phone
      can always find and pair the device, bonded or not.

module = SERVICE_BLUETOOTH
module-str = Bluetooth
source "subsys/logging/Kconfig.template.log_level"

endif
```

## pebble/services/ecompass/Kconfig
```kconfig
# SPDX-FileCopyrightText: 2026 Core Devices LLC
# SPDX-License-Identifier: Apache-2.0

config SERVICE_ECOMPASS
    bool "E-compass"
    default y
    depends on MAG && SETTINGS
    select SENSING
    help
      Electronic compass service, on the board's magnetometer. The
      magnetometer calibration is kept in a settings file.

if SERVICE_ECOMPASS

module = SERVICE_ECOMPASS
module-str = E-compass
source "subsys/logging/Kconfig.template.log_level"

endif
```

## pebble/services/mic_manager/Kconfig
```kconfig
# SPDX-FileCopyrightText: 2026 Core Devices LLC
# SPDX-License-Identifier: Apache-2.0

config SERVICE_MIC_MANAGER
    bool "Microphone manager"
    depends on MIC
    default y
    help
      Arbitrates the microphone between dictation and app streaming.

if SERVICE_MIC_MANAGER

config SERVICE_MIC_MANAGER_QUEUE_MAX_MS
    int "Longest microphone queue, in milliseconds"
    range 32 320
    default 320
    help
      The queue between the microphone and its clients takes this much of
      samples when the heap has room for it beside what the Bluetooth
      packets carrying the audio need. A board with a small kernel heap
      keeps it shorter, leaving the packets more.

config SERVICE_MIC_MANAGER_QUEUE_MIN_MS
    int "Shortest microphone queue, in milliseconds"
    range 32 320
    default 128
    help
      The queue between the microphone and its clients takes less than its
      longest, in 32 ms steps, down to this when the heap is short.
      Below it, the microphone does not start. A short queue drops samples
      while Bluetooth stalls, which degrades transcription, but lets a board
      with a small kernel heap record at all.

module = SERVICE_MIC_MANAGER
module-str = Mic manager
source "subsys/logging/Kconfig.template.log_level"

endif
```
