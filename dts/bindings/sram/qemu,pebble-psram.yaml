## dts/bindings/sram/qemu,pebble-psram.yaml
```yaml
# SPDX-License-Identifier: (GPL-2.0-only OR BSD-2-Clause)
%YAML 1.2
---
$id: http://devicetree.org/schemas/sram/qemu,pebble-psram.yaml#
$schema: http://devicetree.org/meta-schemas/core.yaml#

title: QEMU Pebble PSRAM

maintainers:
  - Gerard Marull-Paretas <gerard@teslabs.com>

description:
  External RAM of the QEMU Pebble machines that stand for a watch with PSRAM.
  It is always mapped and powered.

properties:
  compatible:
    const: qemu,pebble-psram

  reg:
    maxItems: 1

required:
  - compatible
  - reg

additionalProperties: false

examples:
  - |
    psram@60000000 {
        compatible = "qemu,pebble-psram";
        reg = <0x60000000 0x1000000>;
    };
```

## dts/bindings/thermal/nordic,nrf52832-temp.yaml
```yaml
# SPDX-License-Identifier: (GPL-2.0-only OR BSD-2-Clause)
%YAML 1.2
---
$id: http://devicetree.org/schemas/thermal/nordic,nrf52832-temp.yaml#
$schema: http://devicetree.org/meta-schemas/core.yaml#

title: Nordic nRF52 die temperature sensor

maintainers:
  - Gerard Marull-Paretas <gerard@teslabs.com>

description:
  Die temperature sensor, in steps of 0.25 Celsius.

properties:
  compatible:
    oneOf:
      - const: nordic,nrf52832-temp
      - items:
          - enum:
              - nordic,nrf52833-temp
              - nordic,nrf52840-temp
          - const: nordic,nrf52832-temp

  reg:
    maxItems: 1

  interrupts:
    maxItems: 1

required:
  - compatible
  - reg
  - interrupts

additionalProperties: false

examples:
  - |
    thermal-sensor@4000c000 {
        compatible = "nordic,nrf52840-temp", "nordic,nrf52832-temp";
        reg = <0x4000c000 0x1000>;
        interrupts = <12>;
    };
```

## dts/bindings/timer/nordic,nrf54l15-grtc.yaml
```yaml
# SPDX-License-Identifier: (GPL-2.0-only OR BSD-2-Clause)
%YAML 1.2
---
$id: http://devicetree.org/schemas/timer/nordic,nrf54l15-grtc.yaml#
$schema: http://devicetree.org/meta-schemas/core.yaml#

title: Nordic nRF54L global real-time counter

maintainers:
  - Gerard Marull-Paretas <gerard@teslabs.com>

description:
  Counter of microseconds since it started, 52 bits wide, kept from the low-frequency clock in sleep, with compare channels. Each core has an interrupt and a counter of its own, and takes a compare channel no other core does.

properties:
  compatible:
    oneOf:
      - const: nordic,nrf54l15-grtc
      - items:
          - const: nordic,nrf54lm20a-grtc
          - const: nordic,nrf54l15-grtc

  reg:
    maxItems: 1

  interrupts:
    maxItems: 1

  clocks:
    maxItems: 1
    description:
      Low-frequency clock, which the core starts the counter from. A core
      without it leaves the counter to another one.

  nordic,compare-channel:
    $ref: /schemas/types.yaml#/definitions/uint32
    maximum: 11
    description: Compare channel of the core.

required:
  - compatible
  - reg
  - interrupts
  - nordic,compare-channel

additionalProperties: false

examples:
  - |
    node@500e2000 {
        compatible = "nordic,nrf54l15-grtc";
        reg = <0x500e2000 0x1000>;
        interrupts = <228>;
        clocks = <&clock 1>;
        nordic,compare-channel = <0>;
    };
```

## dts/bindings/timer/nordic,nrf54l15-timer.yaml
```yaml
# SPDX-License-Identifier: (GPL-2.0-only OR BSD-2-Clause)
%YAML 1.2
---
$id: http://devicetree.org/schemas/timer/nordic,nrf54l15-timer.yaml#
$schema: http://devicetree.org/meta-schemas/core.yaml#

title: Nordic nRF54L timer/counter

maintainers:
  - Gerard Marull-Paretas <gerard@teslabs.com>

description:
  Timer on the clock of its power domain, or counter of its COUNT task, with capture/compare registers.

properties:
  compatible:
    const: nordic,nrf54l15-timer

  reg:
    maxItems: 1

  interrupts:
    maxItems: 1

required:
  - compatible
  - reg
  - interrupts

additionalProperties: false

examples:
  - |
    node@500ca000 {
        compatible = "nordic,nrf54l15-timer";
        reg = <0x500ca000 0x1000>;
        interrupts = <202>;
    };
```

## dts/bindings/usb/nordic,nrf52840-usbd.yaml
```yaml
# SPDX-License-Identifier: (GPL-2.0-only OR BSD-2-Clause)
%YAML 1.2
---
$id: http://devicetree.org/schemas/usb/nordic,nrf52840-usbd.yaml#
$schema: http://devicetree.org/meta-schemas/core.yaml#

title: Nordic nRF52840 USB device controller

maintainers:
  - Gerard Marull-Paretas <gerard@teslabs.com>

description:
  Full-speed USB device controller with its PHY, on the dedicated D+ and D-
  pins, which moves packets through EasyDMA. It runs from the HFXO, and from
  the USB regulator that VBUS powers, whose events come from the POWER block.

properties:
  compatible:
    const: nordic,nrf52840-usbd

  reg:
    maxItems: 1

  interrupts:
    maxItems: 1

  clocks:
    maxItems: 1

  nordic,power:
    $ref: /schemas/types.yaml#/definitions/phandle
    description: POWER block, which reports VBUS and the USB regulator.

  dr_mode:
    enum: [peripheral]

required:
  - compatible
  - reg
  - interrupts
  - clocks
  - nordic,power

additionalProperties: false

examples:
  - |
    #include <dt-bindings/clock/nordic,nrf52832-clock.h>
    usb@40027000 {
        compatible = "nordic,nrf52840-usbd";
        reg = <0x40027000 0x1000>;
        interrupts = <39>;
        clocks = <&clock NRF52_CLOCK_HFCLK>;
        nordic,power = <&clock>;
    };
```

## dts/bindings/usb/sifli,sf32lb57-usb.yaml
```yaml
# SPDX-License-Identifier: (GPL-2.0-only OR BSD-2-Clause)
%YAML 1.2
---
$id: http://devicetree.org/schemas/usb/sifli,sf32lb57-usb.yaml#
$schema: http://devicetree.org/meta-schemas/core.yaml#

title: SiFli SF32LB57 USB controller

maintainers:
  - Gerard Marull-Paretas <gerard@teslabs.com>

description:
  Mentor Graphics MUSB full-speed controller with its PHY, which the HPSYS
  configuration enables, on PA35 (D+) and PA36 (D-).

properties:
  compatible:
    const: sifli,sf32lb57-usb

  reg:
    maxItems: 1

  interrupts:
    maxItems: 1

  clocks:
    maxItems: 1

  sifli,hpsys-cfg:
    $ref: /schemas/types.yaml#/definitions/phandle
    description: HPSYS configuration, which enables the PHY and the bandgap it runs from.

  dr_mode:
    enum: [peripheral]

  pinctrl-0: true

  pinctrl-names: true

required:
  - compatible
  - reg
  - interrupts
  - clocks
  - sifli,hpsys-cfg

additionalProperties: false

examples:
  - |
    usb@50047000 {
        compatible = "sifli,sf32lb57-usb";
        reg = <0x50047000 0x1000>;
        interrupts = <92>;
        clocks = <&hpsys_rcc 33>;
        sifli,hpsys-cfg = <&hpsys_cfg>;
    };
```

## dts/bindings/watchdog/nordic,nrf52832-wdt.yaml
```yaml
# SPDX-License-Identifier: (GPL-2.0-only OR BSD-2-Clause)
%YAML 1.2
---
$id: http://devicetree.org/schemas/watchdog/nordic,nrf52832-wdt.yaml#
$schema: http://devicetree.org/meta-schemas/core.yaml#

title: Nordic nRF52 watchdog

maintainers:
  - Gerard Marull-Paretas <gerard@teslabs.com>

description:
  Watchdog timer on LFCLK, with eight reload request registers.

properties:
  compatible:
    oneOf:
      - const: nordic,nrf52832-wdt
      - items:
          - enum:
              - nordic,nrf52833-wdt
              - nordic,nrf52840-wdt
          - const: nordic,nrf52832-wdt

  reg:
    maxItems: 1

  interrupts:
    maxItems: 1

required:
  - compatible
  - reg
  - interrupts

additionalProperties: false

examples:
  - |
    watchdog@40010000 {
        compatible = "nordic,nrf52840-wdt", "nordic,nrf52832-wdt";
        reg = <0x40010000 0x1000>;
        interrupts = <16>;
    };
```

## dts/bindings/watchdog/qemu,pebble-wdog.yaml
```yaml
# SPDX-License-Identifier: (GPL-2.0-only OR BSD-2-Clause)
%YAML 1.2
---
$id: http://devicetree.org/schemas/watchdog/qemu,pebble-wdog.yaml#
$schema: http://devicetree.org/meta-schemas/core.yaml#

title: QEMU Pebble watchdog

maintainers:
  - Gerard Marull-Paretas <gerard@teslabs.com>

description:
  Watchdog timer of the QEMU Pebble machines, an ARM CMSDK APB watchdog on the 1 MHz reference
  clock.

properties:
  compatible:
    const: qemu,pebble-wdog

  reg:
    maxItems: 1

required:
  - compatible
  - reg

additionalProperties: false

examples:
  - |
    watchdog@40013000 {
        compatible = "qemu,pebble-wdog";
        reg = <0x40013000 0x1000>;
    };
```

## dts/bindings/watchdog/st,stm32h743-wwdg.yaml
```yaml
# SPDX-License-Identifier: (GPL-2.0-only OR BSD-2-Clause)
%YAML 1.2
---
$id: http://devicetree.org/schemas/watchdog/st,stm32h743-wwdg.yaml#
$schema: http://devicetree.org/meta-schemas/core.yaml#

title: STMicroelectronics STM32H7 window watchdog

maintainers:
  - Gerard Marull-Paretas <gerard@teslabs.com>

description:
  The window watchdog (WWDG) of an STM32H7, counting down its APB clock. On a
  dual-core STM32H7 each core has one, which resets that core alone unless the
  RCC widens its reset to the system.

allOf:
  - $ref: watchdog.yaml#

properties:
  compatible:
    const: st,stm32h743-wwdg

  reg:
    maxItems: 1

  clocks:
    maxItems: 1

  interrupts:
    maxItems: 1

required:
  - compatible
  - reg
  - clocks

unevaluatedProperties: false

examples:
  - |
    watchdog@40002c00 {
        compatible = "st,stm32h743-wwdg";
        reg = <0x40002c00 0x400>;
        clocks = <&rcc 89>;
    };
```

## kernel/arch/riscv/Kconfig
```kconfig
# SPDX-FileCopyrightText: 2026 Core Devices LLC
# SPDX-License-Identifier: Apache-2.0

config RISCV
    bool
    help
      32-bit RISC-V core, in machine mode. Selected through the CPU the
      SoC selects. The SoC provides the interrupt that switches threads,
      in soc_riscv.h.

config RISCV_ISA_RV32E
    bool
    help
      RV32E base: 16 integer registers.

config RISCV_ISA_EXT_M
    bool
    help
      Integer multiplication and division.

config RISCV_ISA_EXT_A
    bool
    help
      Atomic instructions. Without them, the kernel provides the atomic
      operations the compiler calls out for.

config RISCV_ISA_EXT_C
    bool
    help
      Compressed instructions.

config RISCV_HW_STACKING
    bool
    help
      On an interrupt, the core stacks ra, t0-t2 and a0-a5 itself, then
      the mcause and mepc of the trap it was in. mret returns as the
      current mcause and mepc say, then takes them all back. Bit 0 of the
      stacked mepc tells that the core moved sp down 4 bytes first, to
      align the frame on 8. The trap entry relies on it.

config RISCV_WFI_NEEDS_MIE
    bool
    help
      The core only wakes from wfi with interrupts unmasked.

config RISCV_SOC_CYCLE_COUNTER
    bool
    help
      mcycle does not count: the SoC provides the cycle counter, in
      soc_riscv.h.

config RISCV_CLIC
    bool
    help
      Core-local interrupt controller (CLIC), vectoring every line in
      hardware through mtvt.

config RISCV_CLIC_INTCTL_BITS
    int
    depends on RISCV_CLIC
    default 2 if CPU_NORDIC_VPR
    default 8
    help
      Bits of the interrupt control byte the CLIC implements, all of
      them the level.

config RISCV_CLIC_IRQ_OFFSET
    int
    depends on RISCV_CLIC
    default 16 if CPU_NORDIC_VPR
    default 0
    help
      Interrupt code, in mcause and mtvt, of the first CLIC line.

config CPU_NORDIC_VPR
    bool
    select RISCV
    select RISCV_ISA_RV32E
    select RISCV_ISA_EXT_M
    select RISCV_ISA_EXT_C
    select RISCV_HW_STACKING
    select RISCV_WFI_NEEDS_MIE
    select RISCV_SOC_CYCLE_COUNTER
    select RISCV_CLIC
    help
      Nordic VPR: an RV32EMC core with a CLIC, which stacks the
      caller-saved registers itself on an interrupt, and whose mcycle
      does not count.
```

## lib/Kconfig
```kconfig
# SPDX-FileCopyrightText: 2026 Core Devices LLC
# SPDX-License-Identifier: Apache-2.0

rsource "c/Kconfig"

menu "Libraries"

config BTUTIL
    bool "Bluetooth utilities"
    help
      Build the Bluetooth device address, UUID and security manager
      helpers.

config KRAEPELIN
    bool "Kraepelin"
    help
      Build the Kraepelin step and sleep tracking algorithm.

rsource "fuel_gauge/Kconfig"

config PDM
    bool
    help
      Decimation of the stream of PDM microphones to PCM, for the audio
      interfaces that capture it raw.

config VANHEES
    bool "van Hees"
    help
      Build the van Hees wrist angle sleep classifier.

endmenu
```

## pebble/boards/qemu_emery.conf
```kconfig
# Firmware settings for the qemu_emery board.

CONFIG_PLATFORM_EMERY=y

CONFIG_WATCHDOG=y

CONFIG_QEMU_SERIAL=y

CONFIG_SPEAKER=y
CONFIG_TOUCH=y

CONFIG_APP_SCALING=y
CONFIG_ORIENTATION_MANAGER=y

CONFIG_SERVICE_ACCEL_MANAGER_DEFAULT_SENSITIVITY=85

CONFIG_HRM=y

CONFIG_SERVICE_BLUETOOTH_VENDOR_NAME="QEMU"
```

## pebble/platforms/Kconfig.emery
```kconfig
# SPDX-FileCopyrightText: 2026 Core Devices LLC
# SPDX-License-Identifier: Apache-2.0

if PLATFORM_EMERY

config PLATFORM_NAME
    default "emery"

config PLATFORM_COLOR
    default y

config PLATFORM_DISPLAY_WIDTH
    default 200

config PLATFORM_DISPLAY_HEIGHT
    default 228

config PLATFORM_MICROPHONE
    default y

config PLATFORM_SMARTSTRAP
    default y

config PLATFORM_SMARTSTRAP_POWER
    default y

config PLATFORM_HEALTH
    default y

config PLATFORM_COMPASS
    default y

config PLATFORM_TOUCH
    default y

config PLATFORM_RGB_BACKLIGHT
    default y

config PLATFORM_SPEAKER
    default y

config PLATFORM_MODDABLE_XS
    default y

config PLATFORM_MAX_APP_MEMORY_SIZE
    default 131072

config PLATFORM_MAX_FONT_GLYPH_SIZE
    default 512

# RAM of an app and of its runtime. The segment holds a 4 KiB app stack.

config APP_RAM_4X_SEGMENT_SIZE
    default 135168

config APP_RAM_4X_RUNTIME_SIZE
    default 63488

endif # PLATFORM_EMERY
```

## pebble/platforms/Kconfig.flint
```kconfig
# SPDX-FileCopyrightText: 2026 Core Devices LLC
# SPDX-License-Identifier: Apache-2.0

if PLATFORM_FLINT

config PLATFORM_NAME
    default "flint"

config PLATFORM_DISPLAY_WIDTH
    default 144

config PLATFORM_DISPLAY_HEIGHT
    default 168

config PLATFORM_MICROPHONE
    default y

config PLATFORM_HEALTH
    default y

config PLATFORM_COMPASS
    default y

config PLATFORM_SPEAKER
    default y

# RAM of an app and of its runtime.

config APP_RAM_4X_SEGMENT_SIZE
    default 67584

config APP_RAM_4X_RUNTIME_SIZE
    default 30720

endif # PLATFORM_FLINT
```

## pebble/platforms/Kconfig.gabbro
```kconfig
# SPDX-FileCopyrightText: 2026 Core Devices LLC
# SPDX-License-Identifier: Apache-2.0

if PLATFORM_GABBRO

config PLATFORM_NAME
    default "gabbro"

config PLATFORM_COLOR
    default y

config PLATFORM_ROUND
    default y

config PLATFORM_DISPLAY_WIDTH
    default 260

config PLATFORM_DISPLAY_HEIGHT
    default 260

config PLATFORM_MICROPHONE
    default y

config PLATFORM_HEALTH
    default y

config PLATFORM_COMPASS
    default y

config PLATFORM_TOUCH
    default y

config PLATFORM_MODDABLE_XS
    default y

config PLATFORM_MAX_APP_MEMORY_SIZE
    default 131072

config PLATFORM_MAX_FONT_GLYPH_SIZE
    default 512

# RAM of an app and of its runtime. The segment holds a 4 KiB app stack.

config APP_RAM_4X_SEGMENT_SIZE
    default 135168

config APP_RAM_4X_RUNTIME_SIZE
    default 96256

endif # PLATFORM_GABBRO
```
