## dts/bindings/connector/sifli,lcd-qspi-connector.yaml
```yaml
# SPDX-License-Identifier: (GPL-2.0-only OR BSD-2-Clause)
%YAML 1.2
---
$id: http://devicetree.org/schemas/connector/sifli,lcd-qspi-connector.yaml#
$schema: http://devicetree.org/meta-schemas/core.yaml#

title: SiFli quad SPI LCD connector

maintainers:
  - Gerard Marull-Paretas <gerard@teslabs.com>

description: |
  The FPC of SiFli development kits for quad SPI display modules, of 16, 22 or
  40 pins depending on the kit, which modules reach through a cable: the quad
  SPI bus of a display controller, an I2C bus for the touchscreen, and the
  signals of dt-bindings/connector/sifli,lcd-qspi-connector.h, as GPIOs and the
  touchscreen interrupt.

  The node maps those signals to the pins of the board, so that a module
  refers to the connector alone. The trigger of the touchscreen interrupt is
  the module's: the map has an entry for each one the pin takes. The board
  labels the display controller lcd_qspi_lcdc, the I2C bus lcd_qspi_i2c and
  the pin state of the touchscreen interrupt lcd_qspi_touch_default.

allOf:
  - $ref: /schemas/gpio/gpio-nexus-node.yaml#

properties:
  compatible:
    const: sifli,lcd-qspi-connector

  '#address-cells':
    const: 0

  '#interrupt-cells':
    const: 2

  interrupt-map: true

required:
  - compatible
  - '#gpio-cells'
  - gpio-map

unevaluatedProperties: false

examples:
  - |
    #include <dt-bindings/connector/sifli,lcd-qspi-connector.h>
    #include <dt-bindings/interrupt-controller/irq.h>
    connector {
        compatible = "sifli,lcd-qspi-connector";
        #address-cells = <0>;
        #gpio-cells = <2>;
        gpio-map-mask = <0xffffffff 0x0>;
        gpio-map-pass-thru = <0x0 0xffffffff>;
        gpio-map = <SIFLI_LCD_QSPI_RESET 0 &gpio1 43 0>,
                   <SIFLI_LCD_QSPI_TP_INT 0 &gpio1 6 0>;
        #interrupt-cells = <2>;
        interrupt-map = <SIFLI_LCD_QSPI_TP_INT IRQ_TYPE_EDGE_FALLING
                         &gpio1 6 IRQ_TYPE_EDGE_FALLING>,
                        <SIFLI_LCD_QSPI_TP_INT IRQ_TYPE_LEVEL_LOW
                         &gpio1 6 IRQ_TYPE_LEVEL_LOW>;
    };
```

## dts/bindings/crypto/nordic,nrf54l15-cracen.yaml
```yaml
# SPDX-License-Identifier: (GPL-2.0-only OR BSD-2-Clause)
%YAML 1.2
---
$id: http://devicetree.org/schemas/crypto/nordic,nrf54l15-cracen.yaml#
$schema: http://devicetree.org/meta-schemas/core.yaml#

title: Nordic nRF54L CRACEN crypto accelerator

maintainers:
  - Gerard Marull-Paretas <gerard@teslabs.com>

description:
  Crypto accelerator with a true random number generator, a bus-mastering
  cipher and hash engine (AES, SHA-2, SHA-3, ChaCha20-Poly1305) and a
  public-key engine. A wrapper enables each part and gathers their events;
  the engines sit behind it in their own address range.

properties:
  compatible:
    enum:
      - nordic,nrf54l15-cracen
      - nordic,nrf54lm20a-cracen

  reg:
    maxItems: 2

  reg-names:
    items:
      - const: wrapper
      - const: core

  interrupts:
    maxItems: 1

required:
  - compatible
  - reg
  - reg-names
  - interrupts

additionalProperties: false

examples:
  - |
    crypto@50048000 {
        compatible = "nordic,nrf54l15-cracen";
        reg = <0x50048000 0x1000>, <0x51800000 0x10000>;
        reg-names = "wrapper", "core";
        interrupts = <72>;
    };
```

## dts/bindings/display/panel/chipone,co5300.yaml
```yaml
# SPDX-License-Identifier: (GPL-2.0-only OR BSD-2-Clause)
%YAML 1.2
---
$id: http://devicetree.org/schemas/display/panel/chipone,co5300.yaml#
$schema: http://devicetree.org/meta-schemas/core.yaml#

title: AMOLED panels on the ChipOne CO5300 driver IC

maintainers:
  - Gerard Marull-Paretas <gerard@teslabs.com>

description:
  AMOLED panels with frame memory, written in RGB565 over quad SPI by the
  display controller the panel node is a child of, at up to spi-max-frequency.
  The size of the glass and where it starts in the frame memory are in
  panel-timing, as hactive and vactive and as hback-porch and vback-porch. Its
  clock-frequency is the pixel clock of the glass, and the other timings are 0.
  Brightness is set by command.

allOf:
  - $ref: panel-common.yaml#
  - $ref: /schemas/spi/spi-peripheral-props.yaml#

properties:
  compatible:
    const: chipone,co5300

  reset-gpios:
    maxItems: 1

  te-gpios:
    maxItems: 1
    description: Tearing effect output of the driver IC.

  spi-max-frequency: true

  panel-timing: true

required:
  - compatible
  - reset-gpios
  - spi-max-frequency
  - panel-timing

unevaluatedProperties: false

examples:
  - |
    #include <dt-bindings/gpio/gpio.h>
    display-controller {
        panel {
            compatible = "chipone,co5300";
            reset-gpios = <&gpio1 43 GPIO_ACTIVE_LOW>;
            te-gpios = <&gpio1 47 GPIO_ACTIVE_HIGH>;
            spi-max-frequency = <48000000>;

            panel-timing {
                clock-frequency = <10530000>;
                hactive = <390>;
                vactive = <450>;
                hback-porch = <0>;
                hfront-porch = <0>;
                hsync-len = <0>;
                vback-porch = <0>;
                vfront-porch = <0>;
                vsync-len = <0>;
            };
        };
    };
```

## dts/bindings/display/panel/jdi,lpm015m135a.yaml
```yaml
# SPDX-License-Identifier: (GPL-2.0-only OR BSD-2-Clause)
%YAML 1.2
---
$id: http://devicetree.org/schemas/display/panel/jdi,lpm015m135a.yaml#
$schema: http://devicetree.org/meta-schemas/core.yaml#

title: Memory-in-pixel panels on the JDI parallel interface

maintainers:
  - Gerard Marull-Paretas <gerard@teslabs.com>

description:
  Reflective color panels that keep their image, written over the JDI
  parallel interface with two bits per color. VCOM is inverted by an external
  signal while the image is on. Its timing is in panel-timing, with the
  horizontal clock (HCK) as clock-frequency, and hsync-len and vsync-len 0.

allOf:
  - $ref: panel-common.yaml#

properties:
  compatible:
    enum:
      - jdi,lpm015m135a
      - sharp,ls013b7dd02

  vddp-supply:
    description: Pixel memory supply, raised after VLCD.

  vlcd-supply:
    description: Liquid crystal supply.

  pwms:
    maxItems: 1
    description: VCOM inversion signal.

  jdi,enable-start:
    $ref: /schemas/types.yaml#/definitions/uint32
    description: First column of the write enable (ENB) pulse.

  jdi,enable-end:
    $ref: /schemas/types.yaml#/definitions/uint32
    description: Last column of the write enable (ENB) pulse.

  panel-timing: true
  port: true
  rotation: true

required:
  - compatible
  - vddp-supply
  - vlcd-supply
  - pwms
  - jdi,enable-start
  - jdi,enable-end
  - panel-timing
  - port

unevaluatedProperties: false

examples:
  - |
    panel {
        compatible = "jdi,lpm015m135a";
        vddp-supply = <&vddp>;
        vlcd-supply = <&vlcd>;
        pwms = <&lptim2_pwm 0 16666666 0>;
        jdi,enable-start = <3>;
        jdi,enable-end = <99>;

        panel-timing {
            clock-frequency = <746268>;
            hactive = <200>;
            vactive = <228>;
            hback-porch = <2>;
            hfront-porch = <6>;
            hsync-len = <0>;
            vback-porch = <0>;
            vfront-porch = <6>;
            vsync-len = <0>;
        };

        port {
            endpoint {
                remote-endpoint = <&lcdc1_out>;
            };
        };
    };
```

## dts/bindings/display/sifli,sf32lb52-lcdc.yaml
```yaml
# SPDX-License-Identifier: (GPL-2.0-only OR BSD-2-Clause)
%YAML 1.2
---
$id: http://devicetree.org/schemas/display/sifli,sf32lb52-lcdc.yaml#
$schema: http://devicetree.org/meta-schemas/core.yaml#

title: SiFli SF32LB52 and SF32LB57 LCD controllers

maintainers:
  - Gerard Marull-Paretas <gerard@teslabs.com>

description:
  Display controller scanning out to a panel on the JDI parallel interface,
  connected through its port, or, on the SF32LB57, sending its frames to a
  panel with frame memory over quad SPI, as the MIPI DBI host of the panel
  child node.

properties:
  compatible:
    enum:
      - sifli,sf32lb52-lcdc
      - sifli,sf32lb57-lcdc

  reg:
    maxItems: 1

  interrupts:
    maxItems: 1

  clocks:
    maxItems: 1

  resets:
    maxItems: 1

  pinctrl-0: true
  pinctrl-1: true

  pinctrl-names:
    description:
      The sleep state, if any, holds the panel inputs while the panel is power
      cycled.
    minItems: 1
    items:
      - const: default
      - const: sleep

  port:
    $ref: /schemas/graph.yaml#/properties/port
    description: Output to the panel.

  panel:
    type: object
    description: Panel with frame memory, of which the controller is the host.

  memory-region:
    maxItems: 1
    description:
      Memory reserved for the framebuffer, of at least a frame, for frames too
      large for the heap.

required:
  - compatible
  - reg
  - interrupts
  - clocks
  - resets

allOf:
  - if:
      properties:
        compatible:
          const: sifli,sf32lb52-lcdc
    then:
      required:
        - port
      properties:
        panel: false
    else:
      oneOf:
        - required:
            - port
        - required:
            - panel

additionalProperties: false

examples:
  - |
    display-controller@50008000 {
        compatible = "sifli,sf32lb52-lcdc";
        reg = <0x50008000 0x1000>;
        interrupts = <63>;
        clocks = <&hpsys_rcc 6>;
        resets = <&hpsys_rcc 7>;

        port {
            endpoint {
                remote-endpoint = <&panel_in>;
            };
        };
    };
```

## dts/bindings/dma/st,stm32h7-bdma.yaml
```yaml
# SPDX-License-Identifier: (GPL-2.0-only OR BSD-2-Clause)
%YAML 1.2
---
$id: http://devicetree.org/schemas/dma/st,stm32h7-bdma.yaml#
$schema: http://devicetree.org/meta-schemas/core.yaml#

title: STMicroelectronics STM32H7 basic DMA controller

maintainers:
  - Gerard Marull-Paretas <gerard@teslabs.com>

description:
  Eight-channel DMA controller of the D3 domain of the STM32H7, behind the
  DMAMUX2 request router, which consumers name in their DMA specifiers. It only
  reaches the memories of the D3 domain, as the SRAM4. Its specifiers take
  four cells, as those of st,stm32-dma; of the channel configuration, only the
  priority level, bits 16 and 17, applies.

allOf:
  - $ref: /schemas/dma/dma-controller.yaml#

properties:
  compatible:
    const: st,stm32h7-bdma

  reg:
    maxItems: 1

  interrupts:
    description: One per channel, from channel 0.
    minItems: 8
    maxItems: 8

  clocks:
    maxItems: 1

  "#dma-cells":
    const: 4

  dma-requests:
    const: 8

required:
  - compatible
  - reg
  - interrupts
  - clocks
  - "#dma-cells"

unevaluatedProperties: false

examples:
  - |
    bdma: dma-controller@58025400 {
      compatible = "st,stm32h7-bdma";
      reg = <0x58025400 0x400>;
      interrupts = <129>, <130>, <131>, <132>, <133>, <134>, <135>, <136>;
      clocks = <&rcc 74>;
      #dma-cells = <4>;
      dma-requests = <8>;
    };

...
```

## dts/bindings/gpio/nordic,nrf54l15-gpio.yaml
```yaml
# SPDX-License-Identifier: (GPL-2.0-only OR BSD-2-Clause)
%YAML 1.2
---
$id: http://devicetree.org/schemas/gpio/nordic,nrf54l15-gpio.yaml#
$schema: http://devicetree.org/meta-schemas/core.yaml#

title: Nordic nRF54L GPIO port

maintainers:
  - Gerard Marull-Paretas <gerard@teslabs.com>

description:
  A GPIO port of the nRF54L series. The pins of a port with a GPIOTE in its
  power domain interrupt through it, so interrupt specifiers take two cells,
  the pin and the trigger type from <dt-bindings/interrupt-controller/irq.h>.

properties:
  compatible:
    const: nordic,nrf54l15-gpio

  reg:
    maxItems: 1

  gpio-controller: true

  '#gpio-cells':
    const: 2

  ngpios:
    minimum: 1
    maximum: 32

  gpio-reserved-ranges: true

  nordic,port:
    $ref: /schemas/types.yaml#/definitions/uint32
    description: Number of the port, as the peripherals select its pins.

  nordic,gpiote:
    $ref: /schemas/types.yaml#/definitions/phandle
    description: GPIOTE the pins interrupt through, on its IN channels.

  interrupt-controller: true

  '#interrupt-cells':
    const: 2

required:
  - compatible
  - reg
  - gpio-controller
  - '#gpio-cells'
  - nordic,port

dependencies:
  interrupt-controller: ['#interrupt-cells', 'nordic,gpiote']

additionalProperties: false

examples:
  - |
    gpio@500d8200 {
        compatible = "nordic,nrf54l15-gpio";
        reg = <0x500d8200 0x300>;
        gpio-controller;
        #gpio-cells = <2>;
        ngpios = <16>;
        nordic,port = <1>;
        interrupt-controller;
        #interrupt-cells = <2>;
        nordic,gpiote = <&gpiote20>;
    };
```

## dts/bindings/gpu/sifli,sf32lb57-epic.yaml
```yaml
# SPDX-License-Identifier: (GPL-2.0-only OR BSD-2-Clause)
%YAML 1.2
---
$id: http://devicetree.org/schemas/gpu/sifli,sf32lb57-epic.yaml#
$schema: http://devicetree.org/meta-schemas/core.yaml#

title: SiFli SF32LB57 ePIC graphics accelerator

maintainers:
  - Gerard Marull-Paretas <gerard@teslabs.com>

description:
  2D graphics accelerator that composes layers read from memory into a buffer
  in memory, with blending, rotation and scaling.

properties:
  compatible:
    const: sifli,sf32lb57-epic

  reg:
    maxItems: 1

  interrupts:
    maxItems: 1

  clocks:
    maxItems: 1

  resets:
    maxItems: 1

required:
  - compatible
  - reg
  - interrupts
  - clocks
  - resets

additionalProperties: false

examples:
  - |
    gpu@50007000 {
        compatible = "sifli,sf32lb57-epic";
        reg = <0x50007000 0x1000>;
        interrupts = <62>;
        clocks = <&hpsys_rcc 5>;
        resets = <&hpsys_rcc 6>;
    };
```

## dts/bindings/iio/adc/nordic,nrf52832-saadc.yaml
```yaml
# SPDX-License-Identifier: (GPL-2.0-only OR BSD-2-Clause)
%YAML 1.2
---
$id: http://devicetree.org/schemas/iio/adc/nordic,nrf52832-saadc.yaml#
$schema: http://devicetree.org/meta-schemas/core.yaml#

title: Nordic nRF52 SAADC

maintainers:
  - Gerard Marull-Paretas <gerard@teslabs.com>

description:
  Successive approximation ADC of the nRF52 series, with EasyDMA. Its inputs,
  AIN0 to AIN7 on fixed pins and the supplies, are the channels of
  dt-bindings/iio/adc/nordic,nrf52832-saadc.h.

properties:
  compatible:
    oneOf:
      - const: nordic,nrf52832-saadc
      - items:
          - enum:
              - nordic,nrf52833-saadc
              - nordic,nrf52840-saadc
          - const: nordic,nrf52832-saadc

  reg:
    maxItems: 1

  interrupts:
    maxItems: 1

  "#io-channel-cells":
    const: 1

required:
  - compatible
  - reg
  - interrupts
  - "#io-channel-cells"

additionalProperties: false

examples:
  - |
    adc@40007000 {
        compatible = "nordic,nrf52840-saadc", "nordic,nrf52832-saadc";
        reg = <0x40007000 0x1000>;
        interrupts = <7>;
        #io-channel-cells = <1>;
    };
```

## dts/bindings/iio/pressure/bosch,bmp390.yaml
```yaml
# SPDX-FileCopyrightText: 2026 Core Devices LLC
# SPDX-License-Identifier: (GPL-2.0-only OR BSD-2-Clause)
%YAML 1.2
---
$id: http://devicetree.org/schemas/iio/pressure/bosch,bmp390.yaml#
$schema: http://devicetree.org/meta-schemas/core.yaml#

title: Bosch BMP390 barometric pressure sensor

maintainers:
  - Eric Migicovsky <eric@repebble.com>

properties:
  compatible:
    const: bosch,bmp390

  reg:
    maxItems: 1

required:
  - compatible
  - reg

additionalProperties: false

examples:
  - |
    i2c {
        #address-cells = <1>;
        #size-cells = <0>;

        pressure@76 {
            compatible = "bosch,bmp390";
            reg = <0x76>;
        };
    };
```
