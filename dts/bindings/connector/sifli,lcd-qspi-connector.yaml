## dts/bindings/mtd/nordic,nrf54l15-rramc.yaml
```yaml
# SPDX-License-Identifier: (GPL-2.0-only OR BSD-2-Clause)
%YAML 1.2
---
$id: http://devicetree.org/schemas/mtd/nordic,nrf54l15-rramc.yaml#
$schema: http://devicetree.org/meta-schemas/core.yaml#

title: Nordic nRF54L RRAM controller

maintainers:
  - Gerard Marull-Paretas <gerard@teslabs.com>

description:
  Controller that writes the internal RRAM, which the CPU reads
  and executes from at its own address. The RRAM is a child node.

properties:
  compatible:
    const: nordic,nrf54l15-rramc

  reg:
    maxItems: 1

  interrupts:
    maxItems: 1

  "#address-cells":
    const: 1

  "#size-cells":
    const: 1

patternProperties:
  "^flash@[0-9a-f]+$":
    type: object
    $ref: /schemas/mtd/mtd.yaml#
    description: The internal RRAM, at its CPU address.

    properties:
      reg:
        maxItems: 1

    required:
      - reg

    unevaluatedProperties: false

required:
  - compatible
  - reg
  - interrupts
  - "#address-cells"
  - "#size-cells"

additionalProperties: false

examples:
  - |
    flash-controller@5004b000 {
        compatible = "nordic,nrf54l15-rramc";
        reg = <0x5004b000 0x1000>;
        interrupts = <75>;
        #address-cells = <1>;
        #size-cells = <1>;

        flash@0 {
            reg = <0x0 0x17d000>;
        };
    };
```

## dts/bindings/mtd/qemu,pebble-flash.yaml
```yaml
# SPDX-License-Identifier: (GPL-2.0-only OR BSD-2-Clause)
%YAML 1.2
---
$id: http://devicetree.org/schemas/mtd/qemu,pebble-flash.yaml#
$schema: http://devicetree.org/meta-schemas/core.yaml#

title: QEMU Pebble internal flash

maintainers:
  - Gerard Marull-Paretas <gerard@teslabs.com>

description:
  Read-only flash of the QEMU Pebble machines, which the CPU reads and
  executes from. It is loaded with the firmware image and cannot be written.

allOf:
  - $ref: /schemas/mtd/mtd.yaml#

properties:
  compatible:
    const: qemu,pebble-flash

  reg:
    maxItems: 1

required:
  - compatible
  - reg

unevaluatedProperties: false

examples:
  - |
    flash@0 {
        compatible = "qemu,pebble-flash";
        reg = <0x0 0x400000>;
    };
```

## dts/bindings/mtd/st,stm32h7-flash-controller.yaml
```yaml
# SPDX-License-Identifier: (GPL-2.0-only OR BSD-2-Clause)
%YAML 1.2
---
$id: http://devicetree.org/schemas/mtd/st,stm32h7-flash-controller.yaml#
$schema: http://devicetree.org/meta-schemas/core.yaml#

title: STMicroelectronics STM32H7 embedded flash controller

maintainers:
  - Gerard Marull-Paretas <gerard@teslabs.com>

description:
  Controller that writes and erases the embedded flash, which the CPUs read
  and execute from at its own address. The flash is a child node.

properties:
  compatible:
    const: st,stm32h7-flash-controller

  reg:
    maxItems: 1

  "#address-cells":
    const: 1

  "#size-cells":
    const: 1

patternProperties:
  "^flash@[0-9a-f]+$":
    type: object
    $ref: /schemas/mtd/mtd.yaml#
    description: The embedded flash, at its CPU address.

    properties:
      reg:
        maxItems: 1

    required:
      - reg

    unevaluatedProperties: false

required:
  - compatible
  - reg
  - "#address-cells"
  - "#size-cells"

additionalProperties: false

examples:
  - |
    flash-controller@52002000 {
        compatible = "st,stm32h7-flash-controller";
        reg = <0x52002000 0x1000>;
        #address-cells = <1>;
        #size-cells = <1>;

        flash@8000000 {
            reg = <0x08000000 0x200000>;

            partitions {
                compatible = "fixed-partitions";
                #address-cells = <1>;
                #size-cells = <1>;

                partition@0 {
                    label = "code";
                    reg = <0x0 0x100000>;
                };
            };
        };
    };
```

## dts/bindings/net/can/sifli,sf32lb57-can.yaml
```yaml
# SPDX-License-Identifier: (GPL-2.0-only OR BSD-2-Clause)
%YAML 1.2
---
$id: http://devicetree.org/schemas/net/can/sifli,sf32lb57-can.yaml#
$schema: http://devicetree.org/meta-schemas/core.yaml#

title: SiFli SF32LB57 CAN controller

maintainers:
  - Gerard Marull-Paretas <gerard@teslabs.com>

description:
  CAN controller of the SF32LB57, a Fraunhofer IPMS CAN-CTRL core with its
  registers packed in 32-bit words. Its time quanta are counted in the
  controller clock.

allOf:
  - $ref: can-controller.yaml#

properties:
  compatible:
    const: sifli,sf32lb57-can

  reg:
    maxItems: 1

  interrupts:
    maxItems: 1

  clocks:
    maxItems: 1

  resets:
    maxItems: 1

  pinctrl-0: true

  pinctrl-names:
    const: default

required:
  - compatible
  - reg
  - interrupts
  - clocks
  - resets

unevaluatedProperties: false

examples:
  - |
    can@5000a000 {
        compatible = "sifli,sf32lb57-can";
        reg = <0x5000a000 0x1000>;
        interrupts = <83>;
        clocks = <&hpsys_rcc 39>;
        resets = <&hpsys_rcc 39>;
    };
```

## dts/bindings/phy/nordic,nrf54lm20a-usbhs-phy.yaml
```yaml
# SPDX-License-Identifier: (GPL-2.0-only OR BSD-2-Clause)
%YAML 1.2
---
$id: http://devicetree.org/schemas/phy/nordic,nrf54lm20a-usbhs-phy.yaml#
$schema: http://devicetree.org/meta-schemas/core.yaml#

title: Nordic nRF54LM20A USBHS PHY

maintainers:
  - Gerard Marull-Paretas <gerard@teslabs.com>

description:
  Wrapper of the USBHS controller and its UTMI+ high-speed PHY, on the
  dedicated D+ and D- pins, which powers them, resets them and overrides
  the PHY inputs. The PHY runs from XO24M, and from VREGUSB, which VBUS
  powers and which reports VBUS coming and going.

properties:
  compatible:
    const: nordic,nrf54lm20a-usbhs-phy

  reg:
    maxItems: 1

  clocks:
    maxItems: 1

  '#phy-cells':
    const: 0

  nordic,vregusb:
    $ref: /schemas/types.yaml#/definitions/phandle
    description: VREGUSB, which senses VBUS.

required:
  - compatible
  - reg
  - clocks
  - '#phy-cells'
  - nordic,vregusb

additionalProperties: false

examples:
  - |
    #include <dt-bindings/clock/nordic,nrf54l15-clock.h>
    phy@5005a000 {
        compatible = "nordic,nrf54lm20a-usbhs-phy";
        reg = <0x5005a000 0x1000>;
        clocks = <&clock NRF54L_CLOCK_XO24M>;
        #phy-cells = <0>;
        nordic,vregusb = <&vregusb>;
    };
```

## dts/bindings/remoteproc/nordic,nrf54l15-vpr.yaml
```yaml
# SPDX-License-Identifier: (GPL-2.0-only OR BSD-2-Clause)
%YAML 1.2
---
$id: http://devicetree.org/schemas/remoteproc/nordic,nrf54l15-vpr.yaml#
$schema: http://devicetree.org/meta-schemas/core.yaml#

title: Nordic nRF54L VPR

maintainers:
  - Gerard Marull-Paretas <gerard@teslabs.com>

description:
  A VPR RISC-V core of an nRF54L, such as the FLPR, as the application core
  sees it. It runs its firmware from its first instruction, in place in a
  partition or copied to RAM, once the application core starts it. The SPU
  makes it a secure bus master, which reaches the peripherals at their
  secure addresses.

properties:
  compatible:
    const: nordic,nrf54l15-vpr

  reg:
    maxItems: 1

  interrupts:
    maxItems: 1

  nordic,spu:
    $ref: /schemas/types.yaml#/definitions/phandle
    description: SPU of the bus of the VPR.

  nordic,firmware:
    $ref: /schemas/types.yaml#/definitions/phandle
    description: Partition of the internal flash holding the firmware.

  memory-region:
    maxItems: 1
    description:
      RAM the firmware, linked to run from it, is copied to before the VPR
      starts. Without it, the VPR runs the firmware in place.

  nordic,auto-boot:
    $ref: /schemas/types.yaml#/definitions/flag
    description: Start the VPR at boot, when its partition holds an image.

required:
  - compatible
  - reg
  - nordic,spu

additionalProperties: false

examples:
  - |
    vpr@5004c000 {
        compatible = "nordic,nrf54l15-vpr";
        reg = <0x5004c000 0x1000>;
        interrupts = <76>;
        nordic,spu = <&spu00>;
        nordic,firmware = <&cpuflpr_code>;
        memory-region = <&cpuflpr_sram>;
        nordic,auto-boot;
    };
```

## dts/bindings/remoteproc/sifli,sf32lb52-lcpu.yaml
```yaml
# SPDX-License-Identifier: (GPL-2.0-only OR BSD-2-Clause)
%YAML 1.2
---
$id: http://devicetree.org/schemas/remoteproc/sifli,sf32lb52-lcpu.yaml#
$schema: http://devicetree.org/meta-schemas/core.yaml#

title: SiFli SF32LB52 and SF32LB57 low-power CPU

maintainers:
  - Gerard Marull-Paretas <gerard@teslabs.com>

description:
  The LCPU of the SF32LB52 and SF32LB57, running the Bluetooth controller
  from ROM. It exchanges messages with the HCPU over rings signalled with a
  doorbell in each direction; the HCPU to LCPU ring is in HCPU memory
  reserved for it.

properties:
  compatible:
    enum:
      - sifli,sf32lb52-lcpu
      - sifli,sf32lb57-lcpu

  reg:
    description: ROM patch controller
    maxItems: 1

  "#address-cells":
    const: 1

  "#size-cells":
    const: 1

  dma-ranges:
    description:
      Memory as the LCPU sees it, LPSYS SRAM through its code bus first, then
      HPSYS SRAM.
    items:
      - description: LPSYS SRAM through the code bus
      - description: HPSYS SRAM

  mboxes:
    items:
      - description: Doorbell to the LCPU
      - description: Doorbell from the LCPU

  mbox-names:
    items:
      - const: tx
      - const: rx

  memory-region:
    description: HCPU memory holding the HCPU to LCPU ring.
    maxItems: 1

  sram:
    description: LPSYS SRAM region the LCPU works in.
    maxItems: 1

  clocks:
    items:
      - description: LCPU clock
      - description: LPSYS APB clock
      - description: LPSYS second APB clock
      - description: Low-power clock, from the RTC

  clock-names:
    items:
      - const: hclk
      - const: pclk
      - const: pclk2
      - const: lpclk

  sifli,bt-rfc:
    $ref: /schemas/types.yaml#/definitions/phandle
    description: Bluetooth RF controller, calibrated before the LCPU boots.

  sifli,bt-phy:
    $ref: /schemas/types.yaml#/definitions/phandle
    description: Bluetooth PHY, set up by the radio calibration.

  sifli,bt-mac:
    $ref: /schemas/types.yaml#/definitions/phandle
    description: Bluetooth controller, forced to transmit during calibration.

  io-channels:
    maxItems: 1
    description: ADC channel measuring the transmitter output during calibration.

  io-channel-names:
    const: rfcal

  dmas:
    maxItems: 1
    description: DMA channel capturing samples during calibration.

  dma-names:
    const: rfcal

  sifli,lpsys-rcc:
    $ref: /schemas/types.yaml#/definitions/phandle
    description: LPSYS clock and reset controller.

  sifli,hpsys-cfg:
    $ref: /schemas/types.yaml#/definitions/phandle
    description: HPSYS configuration registers, for the bandgap.

  sifli,pmuc:
    $ref: /schemas/types.yaml#/definitions/phandle
    description: Power management unit, for the buck during calibration.

required:
  - compatible
  - reg
  - "#address-cells"
  - "#size-cells"
  - dma-ranges
  - mboxes
  - mbox-names
  - memory-region
  - sram
  - clocks
  - clock-names
  - sifli,bt-rfc
  - sifli,bt-phy
  - sifli,bt-mac
  - io-channels
  - io-channel-names
  - dmas
  - dma-names
  - sifli,lpsys-rcc
  - sifli,hpsys-cfg
  - sifli,pmuc

additionalProperties: false

examples:
  - |
    remoteproc@40004000 {
        compatible = "sifli,sf32lb52-lcpu";
        reg = <0x40004000 0x1000>;
        #address-cells = <1>;
        #size-cells = <1>;
        dma-ranges = <0x00400000 0x20400000 0x10000>,
                     <0x2a000000 0x20000000 0x80000>;
        mboxes = <&mailbox1 0>, <&mailbox2 0>;
        mbox-names = "tx", "rx";
        memory-region = <&lcpu_ipc>;
        sram = <&lcpu_sram>;
        clocks = <&lpsys_rcc 1>, <&lpsys_rcc 2>, <&lpsys_rcc 3>, <&rtc>;
        clock-names = "hclk", "pclk", "pclk2", "lpclk";
        sifli,bt-rfc = <&bt_rfc>;
        sifli,bt-phy = <&bt_phy>;
        sifli,bt-mac = <&bt_mac>;
        io-channels = <&gpadc 0>;
        io-channel-names = "rfcal";
        dmas = <&dmac2 7 0 0>;
        dma-names = "rfcal";
        sifli,lpsys-rcc = <&lpsys_rcc>;
        sifli,hpsys-cfg = <&hpsys_cfg>;
        sifli,pmuc = <&pmuc>;
    };
```
