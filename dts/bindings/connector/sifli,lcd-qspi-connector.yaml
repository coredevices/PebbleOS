## dts/bindings/interrupt-controller/nordic,vpr-clic.yaml
```yaml
# SPDX-License-Identifier: (GPL-2.0-only OR BSD-2-Clause)
%YAML 1.2
---
$id: http://devicetree.org/schemas/interrupt-controller/nordic,vpr-clic.yaml#
$schema: http://devicetree.org/meta-schemas/core.yaml#

title: Nordic VPR core-local interrupt controller

maintainers:
  - Gerard Marull-Paretas <gerard@teslabs.com>

description:
  The CLIC of a VPR RISC-V core, which only that core sees. Each line has a
  pending, an enable, an attribute and a control byte, the control byte
  holding its level, of which the most urgent is the highest.

properties:
  compatible:
    const: nordic,vpr-clic

  reg:
    maxItems: 1

  interrupt-controller: true

  "#interrupt-cells":
    const: 1

  "#address-cells":
    const: 0

required:
  - compatible
  - reg
  - interrupt-controller
  - "#interrupt-cells"

additionalProperties: false

examples:
  - |
    interrupt-controller@f0000000 {
        compatible = "nordic,vpr-clic";
        reg = <0xf0000000 0x143c>;
        interrupt-controller;
        #interrupt-cells = <1>;
        #address-cells = <0>;
    };
```

## dts/bindings/leds/worldsemi,ws2812b.yaml
```yaml
# SPDX-License-Identifier: (GPL-2.0-only OR BSD-2-Clause)
%YAML 1.2
---
$id: http://devicetree.org/schemas/leds/worldsemi,ws2812b.yaml#
$schema: http://devicetree.org/meta-schemas/core.yaml#

title: Worldsemi WS2812B LED chain driven over SPI

maintainers:
  - Gerard Marull-Paretas <gerard@teslabs.com>

description: |
  WS2812B RGB LEDs, chained through their data lines, take 800 kbit/s on a
  single wire. The data line is a SPI MOSI line, each LED bit sent as three
  SPI bits, so the SPI clock is between 2.105 MHz and 2.85 MHz. The MOSI
  line idles low. The LEDs have no chip select: reg is the one of a
  controller chip select left unconnected.

  Each LED of the chain is a multi-led node, at its position in the chain,
  with one led node per color at its position in the data of the LED.

allOf:
  - $ref: /schemas/spi/spi-peripheral-props.yaml#

properties:
  compatible:
    const: worldsemi,ws2812b

  reg:
    maxItems: 1

  spi-max-frequency:
    minimum: 2105000
    maximum: 2850000

  "#address-cells":
    const: 1

  "#size-cells":
    const: 0

patternProperties:
  "^multi-led@[0-9a-f]+$":
    type: object
    $ref: leds-class-multicolor.yaml#
    unevaluatedProperties: false

    properties:
      reg:
        description: Position of the LED in the chain.

      "#address-cells":
        const: 1

      "#size-cells":
        const: 0

    patternProperties:
      "^led@[0-2]$":
        type: object
        $ref: common.yaml#
        unevaluatedProperties: false

        properties:
          reg:
            description: Position of the color in the data of the LED.
            maximum: 2

        required:
          - reg
          - color

    required:
      - reg

required:
  - compatible
  - reg
  - spi-max-frequency

unevaluatedProperties: false

examples:
  - |
    #include <dt-bindings/leds/common.h>

    spi {
        #address-cells = <1>;
        #size-cells = <0>;

        led-controller@1 {
            compatible = "worldsemi,ws2812b";
            reg = <1>;
            spi-max-frequency = <2500000>;
            #address-cells = <1>;
            #size-cells = <0>;

            multi-led@0 {
                reg = <0>;
                color = <LED_COLOR_ID_RGB>;
                #address-cells = <1>;
                #size-cells = <0>;

                led@0 {
                    reg = <0>;
                    color = <LED_COLOR_ID_GREEN>;
                };

                led@1 {
                    reg = <1>;
                    color = <LED_COLOR_ID_RED>;
                };

                led@2 {
                    reg = <2>;
                    color = <LED_COLOR_ID_BLUE>;
                };
            };
        };
    };
```

## dts/bindings/memory-controllers/ddr/jedec,sdr-sdram.yaml
```yaml
# SPDX-License-Identifier: (GPL-2.0-only OR BSD-2-Clause)
%YAML 1.2
---
$id: http://devicetree.org/schemas/memory-controllers/ddr/jedec,sdr-sdram.yaml#
$schema: http://devicetree.org/meta-schemas/core.yaml#

title: JEDEC SDR SDRAM

maintainers:
  - Gerard Marull-Paretas <gerard@teslabs.com>

description:
  A single data rate SDRAM, which has nothing to read its geometry or timings
  from, so they come from its datasheet. Timings are those of its speed
  grade, in picoseconds.

properties:
  compatible:
    items:
      - enum:
          - issi,is42s32800g
      - const: jedec,sdr-sdram

  reg:
    maxItems: 1

  io-width:
    $ref: /schemas/types.yaml#/definitions/uint32
    description: Data bus width, in bits.
    enum: [8, 16, 32]

  banks:
    $ref: /schemas/types.yaml#/definitions/uint32
    description: Internal banks.
    enum: [2, 4]

  row-bits:
    description: Row address bits. A refresh period refreshes each row once.
    minimum: 11
    maximum: 13

  col-bits:
    description: Column address bits.
    minimum: 8
    maximum: 11

  tRC:
    $ref: /schemas/types.yaml#/definitions/uint32
    description: Active to active of a bank, and refresh to refresh.

  tRAS-min:
    $ref: /schemas/types.yaml#/definitions/uint32
    description: Active to precharge.

  tRP:
    $ref: /schemas/types.yaml#/definitions/uint32
    description: Precharge to active.

  tRCD:
    $ref: /schemas/types.yaml#/definitions/uint32
    description: Active to read or write.

  tWR:
    $ref: /schemas/types.yaml#/definitions/uint32
    description: Write recovery, last data in to precharge.

  tMRD:
    $ref: /schemas/types.yaml#/definitions/uint32
    description: Load mode register to the next command.

  tXSR:
    $ref: /schemas/types.yaml#/definitions/uint32
    description: Self-refresh exit to active.

  tREF-ms:
    description: Refresh period, in milliseconds.

  cas-latency-freqs:
    $ref: /schemas/types.yaml#/definitions/uint32-matrix
    description:
      The CAS latencies of the speed grade, each with the highest clock it
      allows, in Hz.
    items:
      items:
        - description: CAS latency, in clock cycles.
          minimum: 1
          maximum: 3
        - description: Highest clock, in Hz.

required:
  - compatible
  - reg
  - io-width
  - banks
  - row-bits
  - col-bits
  - tRC
  - tRAS-min
  - tRP
  - tRCD
  - tWR
  - tMRD
  - tXSR
  - tREF-ms
  - cas-latency-freqs

additionalProperties: false

examples:
  - |
    sdram@70000000 {
        compatible = "issi,is42s32800g", "jedec,sdr-sdram";
        reg = <0x70000000 0x2000000>;
        io-width = <32>;
        banks = <4>;
        row-bits = <12>;
        col-bits = <9>;
        tRC = <60000>;
        tRAS-min = <42000>;
        tRP = <18000>;
        tRCD = <18000>;
        tWR = <12000>;
        tMRD = <12000>;
        tXSR = <70000>;
        tREF-ms = <64>;
        cas-latency-freqs = <2 100000000>, <3 166000000>;
    };
```

## dts/bindings/memory-controllers/st,stm32h7-fmc.yaml
```yaml
# SPDX-License-Identifier: (GPL-2.0-only OR BSD-2-Clause)
%YAML 1.2
---
$id: http://devicetree.org/schemas/memory-controllers/st,stm32h7-fmc.yaml#
$schema: http://devicetree.org/meta-schemas/core.yaml#

title: STMicroelectronics STM32H7 flexible memory controller

maintainers:
  - Gerard Marull-Paretas <gerard@teslabs.com>

description: |
  The FMC drives SDRAM on its two SDRAM banks, each a chip select with its
  clock enable. The SDRAM banks appear at 0xc0000000 and 0xd0000000, or at
  0x60000000 and 0x70000000 with the banks swapped, where the CPU caches
  them and executes from them by default. Each SDRAM is a child node at its
  CPU address, which gives its bank and the mapping.

properties:
  compatible:
    const: st,stm32h7-fmc

  reg:
    maxItems: 1

  clocks:
    maxItems: 1

  "#address-cells":
    const: 1

  "#size-cells":
    const: 1

  ranges: true

patternProperties:
  "^sdram@[0-9a-f]+$":
    $ref: ddr/jedec,sdr-sdram.yaml#
    description: An SDRAM.

required:
  - compatible
  - reg
  - clocks
  - "#address-cells"
  - "#size-cells"
  - ranges

allOf:
  - $ref: /schemas/pinctrl/pinctrl-consumer.yaml#

unevaluatedProperties: false

examples:
  - |
    memory-controller@52004000 {
        compatible = "st,stm32h7-fmc";
        reg = <0x52004000 0x1000>;
        clocks = <&rcc 122>;
        #address-cells = <1>;
        #size-cells = <1>;
        ranges;

        sdram@70000000 {
            compatible = "issi,is42s32800g", "jedec,sdr-sdram";
            reg = <0x70000000 0x2000000>;
            io-width = <32>;
            banks = <4>;
            row-bits = <12>;
            col-bits = <9>;
            tRC = <60000>;
            tRAS-min = <42000>;
            tRP = <18000>;
            tRCD = <18000>;
            tWR = <12000>;
            tMRD = <12000>;
            tXSR = <70000>;
            tREF-ms = <64>;
            cas-latency-freqs = <2 100000000>, <3 166000000>;
        };
    };
```

## dts/bindings/mfd/sifli,sf32lb52-gptim.yaml
```yaml
# SPDX-License-Identifier: (GPL-2.0-only OR BSD-2-Clause)
%YAML 1.2
---
$id: http://devicetree.org/schemas/mfd/sifli,sf32lb52-gptim.yaml#
$schema: http://devicetree.org/meta-schemas/core.yaml#

title: SiFli SF32LB52 general-purpose timer

maintainers:
  - Gerard Marull-Paretas <gerard@teslabs.com>

description:
  16-bit timer counting PCLK through a 16-bit prescaler, with four
  capture/compare channels. Its functions are child nodes, as the PWM
  outputs.

properties:
  compatible:
    oneOf:
      - const: sifli,sf32lb52-gptim
      - items:
          - const: sifli,sf32lb57-gptim
          - const: sifli,sf32lb52-gptim

  reg:
    maxItems: 1

  interrupts:
    maxItems: 1

  clocks:
    maxItems: 1

  resets:
    maxItems: 1

  pwm:
    type: object
    additionalProperties: false
    description:
      PWM outputs, one per channel 0-3. The channels share the period.

    properties:
      compatible:
        oneOf:
          - const: sifli,sf32lb52-gptim-pwm
          - items:
              - const: sifli,sf32lb57-gptim-pwm
              - const: sifli,sf32lb52-gptim-pwm

      "#pwm-cells":
        const: 3

      pinctrl-0: true

      pinctrl-names:
        const: default

      status: true

    required:
      - compatible
      - "#pwm-cells"

required:
  - compatible
  - reg
  - interrupts
  - clocks

additionalProperties: false

examples:
  - |
    timer@50090000 {
        compatible = "sifli,sf32lb52-gptim";
        reg = <0x50090000 0x1000>;
        interrupts = <70>;
        clocks = <&hpsys_rcc 14>;
        resets = <&hpsys_rcc 15>;

        pwm {
            compatible = "sifli,sf32lb52-gptim-pwm";
            #pwm-cells = <3>;
        };
    };
```

## dts/bindings/mmc/sifli,sf32lb57-sdmmc.yaml
```yaml
# SPDX-License-Identifier: (GPL-2.0-only OR BSD-2-Clause)
%YAML 1.2
---
$id: http://devicetree.org/schemas/mmc/sifli,sf32lb57-sdmmc.yaml#
$schema: http://devicetree.org/meta-schemas/core.yaml#

title: SiFli SF32LB57 SD/MMC controller

maintainers:
  - Gerard Marull-Paretas <gerard@teslabs.com>

description:
  SD/MMC controller with a FIFO of one block, which also maps the card into
  memory through a cache. A DMA channel on its request line can move the
  data through the FIFO, in both directions.

allOf:
  - $ref: mmc-controller.yaml#

properties:
  compatible:
    const: sifli,sf32lb57-sdmmc

  reg:
    maxItems: 1

  interrupts:
    maxItems: 1

  clocks:
    maxItems: 1

  dmas:
    maxItems: 1

  dma-names:
    const: rx-tx

required:
  - compatible
  - reg
  - interrupts
  - clocks

unevaluatedProperties: false

examples:
  - |
    mmc@50046000 {
        compatible = "sifli,sf32lb57-sdmmc";
        reg = <0x50046000 0x1000>;
        interrupts = <81>;
        clocks = <&hpsys_rcc 32>;
        bus-width = <4>;
    };
```

## dts/bindings/mtd/jedec,spi-nor.yaml
```yaml
# SPDX-License-Identifier: (GPL-2.0-only OR BSD-2-Clause)
%YAML 1.2
---
$id: http://devicetree.org/schemas/mtd/jedec,spi-nor.yaml#
$schema: http://devicetree.org/meta-schemas/core.yaml#

title: SPI NOR flash

maintainers:
  - Gerard Marull-Paretas <gerard@teslabs.com>

description:
  JEDEC NOR flash on a SPI memory controller, found by its JEDEC ID and
  described by its SFDP tables. The firmware drives one part, which the
  board names with a specific compatible before the generic one. This
  takes the place of the upstream binding of the same name, which only
  lists the specific compatibles of other parts.

allOf:
  - $ref: mtd.yaml#
  - $ref: /schemas/spi/spi-peripheral-props.yaml#

properties:
  compatible:
    oneOf:
      - items:
          - enum:
              - gigadevice,gd25lq255e
              - gigadevice,gd25q256e
              - puya,py25q128ha
          - const: jedec,spi-nor
      - const: jedec,spi-nor

  reg:
    minItems: 1
    maxItems: 2

  vcc-supply:
    description: Supply of the flash.

required:
  - compatible
  - reg

unevaluatedProperties: false

examples:
  - |
    spi {
        #address-cells = <1>;
        #size-cells = <0>;

        flash@0 {
            compatible = "gigadevice,gd25q256e", "jedec,spi-nor";
            reg = <0>;
            spi-rx-bus-width = <4>;
            spi-tx-bus-width = <4>;
        };
    };
```

## dts/bindings/mtd/nordic,nrf52832-nvmc.yaml
```yaml
# SPDX-License-Identifier: (GPL-2.0-only OR BSD-2-Clause)
%YAML 1.2
---
$id: http://devicetree.org/schemas/mtd/nordic,nrf52832-nvmc.yaml#
$schema: http://devicetree.org/meta-schemas/core.yaml#

title: Nordic nRF52 non-volatile memory controller

maintainers:
  - Gerard Marull-Paretas <gerard@teslabs.com>

description:
  Controller that writes and erases the internal flash, which the CPU reads
  and executes from at its own address. The flash is a child node.

properties:
  compatible:
    items:
      - enum:
          - nordic,nrf52840-nvmc
      - const: nordic,nrf52832-nvmc

  reg:
    maxItems: 1

  "#address-cells":
    const: 1

  "#size-cells":
    const: 1

patternProperties:
  "^flash@[0-9a-f]+$":
    type: object
    $ref: /schemas/mtd/mtd.yaml#
    description: The internal flash, at its CPU address.

    properties:
      reg:
        maxItems: 1

    required:
      - reg

    unevaluatedProperties: false

required:
  - compatible
  - reg
  - "#address-cells"
  - "#size-cells"

additionalProperties: false

examples:
  - |
    flash-controller@4001e000 {
        compatible = "nordic,nrf52840-nvmc", "nordic,nrf52832-nvmc";
        reg = <0x4001e000 0x1000>;
        #address-cells = <1>;
        #size-cells = <1>;

        flash@0 {
            reg = <0x0 0x100000>;

            partitions {
                compatible = "fixed-partitions";
                #address-cells = <1>;
                #size-cells = <1>;

                partition@0 {
                    label = "code";
                    reg = <0x0 0x100000>;
                };
            };
        };
    };
```
