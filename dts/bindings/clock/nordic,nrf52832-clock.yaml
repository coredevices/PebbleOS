## dts/bindings/clock/nordic,nrf52832-clock.yaml
```yaml
# SPDX-License-Identifier: (GPL-2.0-only OR BSD-2-Clause)
%YAML 1.2
---
$id: http://devicetree.org/schemas/clock/nordic,nrf52832-clock.yaml#
$schema: http://devicetree.org/meta-schemas/core.yaml#

title: Nordic nRF52 clock control

maintainers:
  - Gerard Marull-Paretas <gerard@teslabs.com>

description: |
  Runs the two clocks of the system:

  - HFCLK, the 64 MHz clock of the CPU and the peripherals, from the internal
    RC oscillator, or from the HFXO crystal oscillator while a consumer asks
    for it, as the radio and the audio interfaces do for its accuracy;
  - LFCLK, the 32768 Hz clock of the RTCs, from the LFXO crystal oscillator,
    the internal RC oscillator or HFCLK.

  It shares its registers and interrupt with the power control block. Clock
  specifiers take one cell, an ID from
  <dt-bindings/clock/nordic,nrf52832-clock.h>.

properties:
  compatible:
    oneOf:
      - const: nordic,nrf52832-clock
      - items:
          - enum:
              - nordic,nrf52833-clock
              - nordic,nrf52840-clock
          - const: nordic,nrf52832-clock

  reg:
    maxItems: 1

  interrupts:
    maxItems: 1

  '#clock-cells':
    const: 1

  clocks:
    minItems: 1
    items:
      - description: 32 MHz crystal
      - description: 32768 Hz crystal, if fitted

  clock-names:
    minItems: 1
    items:
      - const: hfxo
      - const: lfxo

required:
  - compatible
  - reg
  - interrupts
  - '#clock-cells'
  - clocks
  - clock-names

additionalProperties: false

examples:
  - |
    clock: clock-controller@40000000 {
        compatible = "nordic,nrf52840-clock", "nordic,nrf52832-clock";
        reg = <0x40000000 0x1000>;
        interrupts = <0>;
        #clock-cells = <1>;
        clocks = <&hfxo>, <&lfxo>;
        clock-names = "hfxo", "lfxo";
    };
```

## dts/bindings/clock/sifli,sf32lb52-hpsys-rcc.yaml
```yaml
# SPDX-License-Identifier: (GPL-2.0-only OR BSD-2-Clause)
%YAML 1.2
---
$id: http://devicetree.org/schemas/clock/sifli,sf32lb52-hpsys-rcc.yaml#
$schema: http://devicetree.org/meta-schemas/core.yaml#

title: SiFli SF32LB52 HPSYS reset and clock controller

maintainers:
  - Gerard Marull-Paretas <gerard@teslabs.com>

description: |
  Derives the clocks of the HPSYS from the HRC48 and HXT48 oscillators, gates
  those of its peripherals and drives their reset lines:

  - SYS, clk_hpsys, from HRC48, HXT48 or DLL1, divided into HCLK, the AHB
    clock, itself divided into PCLK and PCLK2, the APB clocks;
  - DLL1 and DLL2, from HXT48 through the DLL buffer of the PMUC, on the
    HPSYS bandgap, which the HPSYS configuration enables;
  - PERI, clk_peri_hpsys, from HRC48 or HXT48, for the serial peripherals,
    and PERI_DIV2, half of it, for some timers;
  - MPI1_K and MPI2_K, the kernel clocks of the MPI controllers, from PERI,
    DLL1 or DLL2, and USBC_K, that of the USB controller, from SYS or DLL2;
  - a gate for each peripheral, which runs at the rate of the clock it gates.

  Clock and reset specifiers take one cell, an ID from
  <dt-bindings/clock/sifli,sf32lb52-hpsys-rcc.h> or
  <dt-bindings/reset/sifli,sf32lb52-hpsys-rcc.h>.

properties:
  compatible:
    const: sifli,sf32lb52-hpsys-rcc

  reg:
    maxItems: 1

  '#clock-cells':
    const: 1

  '#reset-cells':
    const: 1

  clocks:
    items:
      - description: HRC48 oscillator
      - description: HXT48 oscillator
      - description: HXT48 through the DLL buffer

  clock-names:
    items:
      - const: hrc48
      - const: hxt48
      - const: hxt48-dll

  sifli,hpsys-cfg:
    $ref: /schemas/types.yaml#/definitions/phandle
    description: HPSYS configuration, for the HPSYS bandgap.

  power-domains:
    maxItems: 1
    description: The HPSYS power domain, which the clocks of the RCC run in.

  required-opps:
    maxItems: 1
    description:
      The voltage mode of the HPSYS that the assigned rates need, set before
      the RCC changes its clocks.

required:
  - compatible
  - reg
  - '#clock-cells'
  - '#reset-cells'
  - clocks
  - clock-names
  - sifli,hpsys-cfg
  - power-domains
  - required-opps

additionalProperties: false

examples:
  - |
    rcc: clock-controller@50000000 {
        compatible = "sifli,sf32lb52-hpsys-rcc";
        reg = <0x50000000 0x1000>;
        #clock-cells = <1>;
        #reset-cells = <1>;
        clocks = <&pmuc 3>, <&pmuc 4>, <&pmuc 6>;
        clock-names = "hrc48", "hxt48", "hxt48-dll";
        sifli,hpsys-cfg = <&hpsys_cfg>;
        power-domains = <&pmuc 0>;
        required-opps = <&hpsys_s1>;
        assigned-clocks = <&rcc 42>, <&rcc 38>;
        assigned-clock-parents = <0>, <&rcc 42>;
        assigned-clock-rates = <240000000>;
    };
```

## dts/bindings/clock/sifli,sf32lb52-hxt48.yaml
```yaml
# SPDX-License-Identifier: (GPL-2.0-only OR BSD-2-Clause)
%YAML 1.2
---
$id: http://devicetree.org/schemas/clock/sifli,sf32lb52-hxt48.yaml#
$schema: http://devicetree.org/meta-schemas/core.yaml#

title: SiFli SF32LB52 48 MHz crystal oscillator

maintainers:
  - Gerard Marull-Paretas <gerard@teslabs.com>

description:
  The 48 MHz crystal oscillator of the SF32LB52, whose load capacitance is
  trimmed from the factory configuration of the SoC, kept in nvmem cells.

properties:
  compatible:
    const: sifli,sf32lb52-hxt48

  "#clock-cells":
    const: 0

  clock-frequency:
    const: 48000000

  nvmem-cells:
    description: Cells holding the factory configuration, in search order.
    minItems: 1
    maxItems: 2

  nvmem-cell-names:
    minItems: 1
    items:
      - const: soc-config-user
      - const: soc-config-cust

required:
  - compatible
  - "#clock-cells"
  - clock-frequency

additionalProperties: false

examples:
  - |
    clock-hxt48 {
        compatible = "sifli,sf32lb52-hxt48";
        #clock-cells = <0>;
        clock-frequency = <48000000>;
        nvmem-cells = <&soc_config_user>, <&soc_config_cust>;
        nvmem-cell-names = "soc-config-user", "soc-config-cust";
    };
```

## dts/bindings/clock/sifli,sf32lb52-lpsys-rcc.yaml
```yaml
# SPDX-License-Identifier: (GPL-2.0-only OR BSD-2-Clause)
%YAML 1.2
---
$id: http://devicetree.org/schemas/clock/sifli,sf32lb52-lpsys-rcc.yaml#
$schema: http://devicetree.org/meta-schemas/core.yaml#

title: SiFli SF32LB52 LPSYS reset and clock controller

maintainers:
  - Gerard Marull-Paretas <gerard@teslabs.com>

description: |
  Derives the clocks of the LPSYS, which the LCPU runs from, from the HRC48
  and HXT48 oscillators:

  - SYS, clk_lpsys, from HRC48 or HXT48, divided into HCLK, the clock of the
    LCPU, itself divided into PCLK and PCLK2, the APB clocks;
  - PERI, clk_peri_lpsys, from HRC48 or HXT48.

  The LCPU changes them itself once it runs. Its registers only answer while
  the LPSYS is awake. Clock specifiers take one cell, an ID from
  <dt-bindings/clock/sifli,sf32lb52-lpsys-rcc.h>.

properties:
  compatible:
    const: sifli,sf32lb52-lpsys-rcc

  reg:
    maxItems: 1

  '#clock-cells':
    const: 1

  clocks:
    items:
      - description: HRC48 oscillator
      - description: HXT48 oscillator

  clock-names:
    items:
      - const: hrc48
      - const: hxt48

required:
  - compatible
  - reg
  - '#clock-cells'
  - clocks
  - clock-names

additionalProperties: false

examples:
  - |
    lpsys_rcc: clock-controller@40000000 {
        compatible = "sifli,sf32lb52-lpsys-rcc";
        reg = <0x40000000 0x1000>;
        #clock-cells = <1>;
        clocks = <&pmuc 3>, <&pmuc 4>;
        clock-names = "hrc48", "hxt48";
        assigned-clocks = <&lpsys_rcc 4>;
        assigned-clock-parents = <&pmuc 4>;
    };
```

## dts/bindings/clock/sifli,sf32lb52-rc10k.yaml
```yaml
# SPDX-License-Identifier: (GPL-2.0-only OR BSD-2-Clause)
%YAML 1.2
---
$id: http://devicetree.org/schemas/clock/sifli,sf32lb52-rc10k.yaml#
$schema: http://devicetree.org/meta-schemas/core.yaml#

title: SiFli SF32LB52 RC10K oscillator

maintainers:
  - Gerard Marull-Paretas <gerard@teslabs.com>

description:
  Low-power RC oscillator of about 10 kHz, which runs in deep sleep. Its rate
  is measured against the 48 MHz crystal.

properties:
  compatible:
    const: sifli,sf32lb52-rc10k

  "#clock-cells":
    const: 0

required:
  - compatible
  - "#clock-cells"

additionalProperties: false

examples:
  - |
    clock-rc10k {
        compatible = "sifli,sf32lb52-rc10k";
        #clock-cells = <0>;
    };
```

## dts/bindings/crypto/sifli,sf32lb52-aes.yaml
```yaml
# SPDX-License-Identifier: (GPL-2.0-only OR BSD-2-Clause)
%YAML 1.2
---
$id: http://devicetree.org/schemas/crypto/sifli,sf32lb52-aes.yaml#
$schema: http://devicetree.org/meta-schemas/core.yaml#

title: SiFli SF32LB52 AES and hash accelerator

maintainers:
  - Gerard Marull-Paretas <gerard@teslabs.com>

description:
  Crypto engine with its own bus master. Its AES unit runs ECB, CBC and CTR
  with 128, 192 or 256-bit keys, given by software or the root key in
  eFuse. Its hash unit computes SHA-1, SHA-224, SHA-256 and SM3, and can
  resume from an intermediate state.

properties:
  compatible:
    const: sifli,sf32lb52-aes

  reg:
    maxItems: 1

  interrupts:
    maxItems: 1

  clocks:
    maxItems: 1

  resets:
    maxItems: 1

required:
  - compatible
  - reg
  - interrupts
  - clocks
  - resets

additionalProperties: false

examples:
  - |
    crypto@5000d000 {
        compatible = "sifli,sf32lb52-aes";
        reg = <0x5000d000 0x1000>;
        interrupts = <67>;
        clocks = <&hpsys_rcc 10>;
        resets = <&hpsys_rcc 11>;
    };
```

## dts/bindings/crypto/sifli,sf32lb52-crc.yaml
```yaml
# SPDX-License-Identifier: (GPL-2.0-only OR BSD-2-Clause)
%YAML 1.2
---
$id: http://devicetree.org/schemas/crypto/sifli,sf32lb52-crc.yaml#
$schema: http://devicetree.org/meta-schemas/core.yaml#

title: SiFli SF32LB52 CRC unit

maintainers:
  - Gerard Marull-Paretas <gerard@teslabs.com>

properties:
  compatible:
    const: sifli,sf32lb52-crc

  reg:
    maxItems: 1

  clocks:
    maxItems: 1

required:
  - compatible
  - reg
  - clocks

additionalProperties: false

examples:
  - |
    crc@50048000 {
        compatible = "sifli,sf32lb52-crc";
        reg = <0x50048000 0x1000>;
        clocks = <&hpsys_rcc 11>;
    };
```

## dts/bindings/display/panel/jdi,lpm015m135a.yaml
```yaml
# SPDX-License-Identifier: (GPL-2.0-only OR BSD-2-Clause)
%YAML 1.2
---
$id: http://devicetree.org/schemas/display/panel/jdi,lpm015m135a.yaml#
$schema: http://devicetree.org/meta-schemas/core.yaml#

title: Memory-in-pixel panels on the JDI parallel interface

maintainers:
  - Gerard Marull-Paretas <gerard@teslabs.com>

description:
  Reflective color panels that keep their image, written over the JDI
  parallel interface with two bits per color. VCOM is inverted by an external
  signal while the image is on.

allOf:
  - $ref: panel-common.yaml#

properties:
  compatible:
    enum:
      - jdi,lpm015m135a
      - sharp,ls013b7dd02

  vddp-supply:
    description: Pixel memory supply, raised after VLCD.

  vlcd-supply:
    description: Liquid crystal supply.

  pwms:
    maxItems: 1
    description: VCOM inversion signal.

  port: true
  rotation: true

required:
  - compatible
  - vddp-supply
  - vlcd-supply
  - pwms
  - port

unevaluatedProperties: false

examples:
  - |
    panel {
        compatible = "jdi,lpm015m135a";
        vddp-supply = <&vddp>;
        vlcd-supply = <&vlcd>;
        pwms = <&lptim2_pwm 0 16666666 0>;

        port {
            endpoint {
                remote-endpoint = <&lcdc1_out>;
            };
        };
    };
```

## dts/bindings/display/qemu,pebble-display.yaml
```yaml
# SPDX-License-Identifier: (GPL-2.0-only OR BSD-2-Clause)
%YAML 1.2
---
$id: http://devicetree.org/schemas/display/qemu,pebble-display.yaml#
$schema: http://devicetree.org/meta-schemas/core.yaml#

title: QEMU Pebble display

maintainers:
  - Gerard Marull-Paretas <gerard@teslabs.com>

description:
  Display of the QEMU Pebble machines, shown from a memory-mapped framebuffer,
  with the backlight in the same registers.

properties:
  compatible:
    const: qemu,pebble-display

  reg:
    items:
      - description: Registers
      - description: Framebuffer

  reg-names:
    items:
      - const: regs
      - const: fb

  interrupts:
    maxItems: 1

  width:
    $ref: /schemas/types.yaml#/definitions/uint32
    description: Width, in pixels.

  height:
    $ref: /schemas/types.yaml#/definitions/uint32
    description: Height, in pixels.

  bits-per-pixel:
    $ref: /schemas/types.yaml#/definitions/uint32
    description: 8 for 2-bit ARGB, 1 for monochrome, packed in 32-bit words.
    enum: [1, 8]

  qemu,round-mask:
    type: boolean
    description: The display is round, its corners hidden.

required:
  - compatible
  - reg
  - reg-names
  - interrupts
  - width
  - height
  - bits-per-pixel

additionalProperties: false

examples:
  - |
    display-controller@40008000 {
        compatible = "qemu,pebble-display";
        reg = <0x40008000 0x1000>, <0x50000000 0x20000>;
        reg-names = "regs", "fb";
        interrupts = <7>;
        width = <200>;
        height = <228>;
        bits-per-pixel = <8>;
    };
```

## dts/bindings/display/sharp,ls010b7dh04.yaml
```yaml
# SPDX-License-Identifier: (GPL-2.0-only OR BSD-2-Clause)
%YAML 1.2
---
$id: http://devicetree.org/schemas/display/sharp,ls010b7dh04.yaml#
$schema: http://devicetree.org/meta-schemas/core.yaml#

title: Sharp Memory LCD panels

maintainers:
  - Gerard Marull-Paretas <gerard@teslabs.com>

description:
  Monochrome SPI panels that keep their image in pixel memory, as in Linux,
  with the LS013B7DH01 added. VCOM is inverted to prevent a DC bias, by the
  driver over SPI (software), by an external signal (external), or by a PWM
  output on EXTCOMIN (pwm).

allOf:
  - $ref: panel/panel-common.yaml#
  - $ref: /schemas/spi/spi-peripheral-props.yaml#
  - if:
      properties:
        sharp,vcom-mode:
          const: pwm
    then:
      required:
        - pwms

properties:
  compatible:
    enum:
      - sharp,ls010b7dh04
      - sharp,ls011b7dh03
      - sharp,ls012b7dd01
      - sharp,ls013b7dh01
      - sharp,ls013b7dh03
      - sharp,ls013b7dh05
      - sharp,ls018b7dh02
      - sharp,ls027b7dh01
      - sharp,ls027b7dh01a
      - sharp,ls032b7dd02
      - sharp,ls044q7dh01

  reg:
    maxItems: 1

  spi-max-frequency:
    maximum: 2000000

  sharp,vcom-mode:
    $ref: /schemas/types.yaml#/definitions/string
    enum: [software, external, pwm]
    description: How VCOM is inverted.

  enable-gpios: true

  pwms:
    maxItems: 1
    description: External VCOM signal.

required:
  - compatible
  - reg
  - sharp,vcom-mode

unevaluatedProperties: false

examples:
  - |
    spi {
        #address-cells = <1>;
        #size-cells = <0>;

        display@0 {
            compatible = "sharp,ls013b7dh01";
            reg = <0>;
            spi-cs-high;
            spi-max-frequency = <1000000>;
            sharp,vcom-mode = "pwm";
            pwms = <&rtc2_pwm 0 8333333 0>;
        };
    };
```
