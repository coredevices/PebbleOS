## dts/bindings/input/adc-keys-irq.yaml
```yaml
# SPDX-License-Identifier: (GPL-2.0-only OR BSD-2-Clause)
%YAML 1.2
---
$id: http://devicetree.org/schemas/input/adc-keys-irq.yaml#
$schema: http://devicetree.org/meta-schemas/core.yaml#

title: ADC attached resistor ladder buttons with an interrupt

maintainers:
  - Gerard Marull-Paretas <gerard@teslabs.com>

description:
  Keys on a resistor ladder, read through one ADC channel when an interrupt
  that a press or release raises fires, rather than polled. The key whose
  press-threshold-microvolt is the nearest to the voltage read is pressed,
  none is if keyup-threshold-microvolt is the nearest, so the ladder may rest
  at either end of the range of the keys.

allOf:
  - $ref: input.yaml#

properties:
  compatible:
    const: adc-keys-irq

  io-channels:
    maxItems: 1

  io-channel-names:
    const: buttons

  interrupts:
    maxItems: 1
    description:
      Raised when a key is pressed or released, typically a GPIO that the
      ladder also drives, on both edges.

  keyup-threshold-microvolt:
    description:
      Voltage of the ladder with no key pressed.

  pinctrl-0: true
  pinctrl-names: true
  autorepeat: true
  wakeup-source: true

patternProperties:
  '^button-':
    type: object
    $ref: input.yaml#
    additionalProperties: false
    description:
      Each button (key) is represented as a sub-node.

    properties:
      label: true

      linux,code: true

      press-threshold-microvolt:
        description:
          Voltage of the ladder while this key is pressed. No two values of
          press-threshold-microvolt may be the same, nor equal to
          keyup-threshold-microvolt.

    required:
      - linux,code
      - press-threshold-microvolt

required:
  - compatible
  - io-channels
  - io-channel-names
  - interrupts
  - keyup-threshold-microvolt

additionalProperties: false

examples:
  - |
    #include <dt-bindings/input/input.h>
    #include <dt-bindings/interrupt-controller/irq.h>

    // A ladder at 0 V with no key pressed, whose keys pull it up
    adc-keys {
        compatible = "adc-keys-irq";
        io-channels = <&adc 6>;
        io-channel-names = "buttons";
        interrupts-extended = <&gpio1 34 IRQ_TYPE_EDGE_BOTH>;
        keyup-threshold-microvolt = <0>;
        wakeup-source;

        button-up {
            label = "Up";
            linux,code = <KEY_UP>;
            press-threshold-microvolt = <2970000>;
        };

        button-select {
            label = "Select";
            linux,code = <KEY_SELECT>;
            press-threshold-microvolt = <2580000>;
        };

        button-down {
            label = "Down";
            linux,code = <KEY_DOWN>;
            press-threshold-microvolt = <2190000>;
        };
    };
...
```

## dts/bindings/input/awinic,aw86225.yaml
```yaml
# SPDX-License-Identifier: (GPL-2.0-only OR BSD-2-Clause)
%YAML 1.2
---
$id: http://devicetree.org/schemas/input/awinic,aw86225.yaml#
$schema: http://devicetree.org/meta-schemas/core.yaml#

title: Awinic AW86225 and AW86233 LRA haptic drivers

maintainers:
  - Gerard Marull-Paretas <gerard@teslabs.com>

description:
  Haptic drivers for a linear resonant actuator (LRA) over I2C, of the family
  of the AW86927. The LRA properties describe the motor they drive.

properties:
  compatible:
    enum:
      - awinic,aw86225
      - awinic,aw86233

  reg:
    maxItems: 1

  reset-gpios:
    maxItems: 1

  interrupts:
    maxItems: 1

  vdd-supply:
    description: Regulator supplying the logic, VDD.

  awinic,lra-f0-hz:
    description: Nominal resonant frequency of the LRA.

  awinic,lra-f0-tolerance-hz:
    description: Accepted deviation of the measured resonant frequency.

  awinic,lra-rated-microvolt:
    description: Rated drive voltage of the LRA, RMS.

  awinic,output-gain-percent:
    description:
      Measured output as a percentage of what the chip's model predicts, as
      characterized on the board; the drive is scaled by its inverse.
    minimum: 50
    maximum: 100
    default: 100

required:
  - compatible
  - reg
  - reset-gpios

allOf:
  - if:
      properties:
        compatible:
          const: awinic,aw86225
    then:
      required:
        - awinic,lra-f0-hz
        - awinic,lra-f0-tolerance-hz
        - awinic,lra-rated-microvolt

additionalProperties: false

examples:
  - |
    #include <dt-bindings/gpio/gpio.h>

    i2c {
        #address-cells = <1>;
        #size-cells = <0>;

        haptics@58 {
            compatible = "awinic,aw86225";
            reg = <0x58>;
            reset-gpios = <&gpio1 1 GPIO_ACTIVE_LOW>;
            awinic,lra-f0-hz = <240>;
            awinic,lra-f0-tolerance-hz = <20>;
            awinic,lra-rated-microvolt = <1200000>;
            awinic,output-gain-percent = <93>;
        };
    };
```

## dts/bindings/input/touchscreen/hynitron,cst816x.yaml
```yaml
# SPDX-License-Identifier: (GPL-2.0-only OR BSD-2-Clause)
%YAML 1.2
---
$id: http://devicetree.org/schemas/input/touchscreen/hynitron,cst816x.yaml#
$schema: http://devicetree.org/meta-schemas/core.yaml#

title: Hynitron CST816x Series Capacitive Touch controller

maintainers:
  - Gerard Marull-Paretas <gerard@teslabs.com>

description:
  Self-capacitance touch controllers with single point gestures, as in Linux,
  with the common touchscreen properties added, for the resolution it reports.

allOf:
  - $ref: /schemas/input/touchscreen/touchscreen.yaml#

properties:
  compatible:
    enum:
      - hynitron,cst816s

  reg:
    maxItems: 1

  interrupts:
    maxItems: 1

  reset-gpios:
    maxItems: 1

  linux,keycodes:
    minItems: 1
    items:
      - description: Slide up gesture
      - description: Slide down gesture
      - description: Slide left gesture
      - description: Slide right gesture
      - description: Long press gesture

required:
  - compatible
  - reg
  - interrupts

unevaluatedProperties: false

examples:
  - |
    #include <dt-bindings/gpio/gpio.h>
    #include <dt-bindings/interrupt-controller/irq.h>
    i2c {
        #address-cells = <1>;
        #size-cells = <0>;
        touchscreen@15 {
            compatible = "hynitron,cst816s";
            reg = <0x15>;
            interrupt-parent = <&gpio0>;
            interrupts = <4 IRQ_TYPE_EDGE_FALLING>;
            reset-gpios = <&gpio 17 GPIO_ACTIVE_LOW>;
            touchscreen-size-x = <200>;
            touchscreen-size-y = <228>;
        };
    };
```

## dts/bindings/input/touchscreen/qemu,pebble-touch.yaml
```yaml
# SPDX-License-Identifier: (GPL-2.0-only OR BSD-2-Clause)
%YAML 1.2
---
$id: http://devicetree.org/schemas/input/touchscreen/qemu,pebble-touch.yaml#
$schema: http://devicetree.org/meta-schemas/core.yaml#

title: QEMU Pebble touchscreen

maintainers:
  - Gerard Marull-Paretas <gerard@teslabs.com>

description:
  Touchscreen of the QEMU Pebble machines, driven by the host pointer over the
  display. It interrupts when the touch state or position changes.

allOf:
  - $ref: /schemas/input/touchscreen/touchscreen.yaml#

properties:
  compatible:
    const: qemu,pebble-touch

  reg:
    maxItems: 1

  interrupts:
    maxItems: 1

required:
  - compatible
  - reg
  - interrupts
  - touchscreen-size-x
  - touchscreen-size-y

unevaluatedProperties: false

examples:
  - |
    touchscreen@40011000 {
        compatible = "qemu,pebble-touch";
        reg = <0x40011000 0x1000>;
        interrupts = <9>;
        touchscreen-size-x = <200>;
        touchscreen-size-y = <228>;
    };
```
