## dts/bindings/display/sifli,sf32lb52-lcdc.yaml
```yaml
# SPDX-License-Identifier: (GPL-2.0-only OR BSD-2-Clause)
%YAML 1.2
---
$id: http://devicetree.org/schemas/display/sifli,sf32lb52-lcdc.yaml#
$schema: http://devicetree.org/meta-schemas/core.yaml#

title: SiFli SF32LB52 LCD controller

maintainers:
  - Gerard Marull-Paretas <gerard@teslabs.com>

description:
  Display controller scanning out to a panel, here on the JDI parallel
  interface, connected through its port.

properties:
  compatible:
    const: sifli,sf32lb52-lcdc

  reg:
    maxItems: 1

  interrupts:
    maxItems: 1

  clocks:
    maxItems: 1

  resets:
    maxItems: 1

  pinctrl-0: true
  pinctrl-1: true

  pinctrl-names:
    description:
      The sleep state, if any, holds the panel inputs while the panel is power
      cycled.
    minItems: 1
    items:
      - const: default
      - const: sleep

  port:
    $ref: /schemas/graph.yaml#/properties/port
    description: Output to the panel.

required:
  - compatible
  - reg
  - interrupts
  - clocks
  - resets
  - port

additionalProperties: false

examples:
  - |
    display-controller@50008000 {
        compatible = "sifli,sf32lb52-lcdc";
        reg = <0x50008000 0x1000>;
        interrupts = <63>;
        clocks = <&hpsys_rcc 6>;
        resets = <&hpsys_rcc 7>;

        port {
            endpoint {
                remote-endpoint = <&panel_in>;
            };
        };
    };
```

## dts/bindings/dma/sifli,sf32lb52-dmac.yaml
```yaml
# SPDX-License-Identifier: (GPL-2.0-only OR BSD-2-Clause)
%YAML 1.2
---
$id: http://devicetree.org/schemas/dma/sifli,sf32lb52-dmac.yaml#
$schema: http://devicetree.org/meta-schemas/core.yaml#

title: SiFli SF32LB52 DMA controller

maintainers:
  - Gerard Marull-Paretas <gerard@teslabs.com>

description:
  Eight-channel DMA controller. DMA specifiers take three cells, the channel
  (0 to 7), the request line (0 to 63) and the priority (0 low to 3 very high).

allOf:
  - $ref: /schemas/dma/dma-controller.yaml#

properties:
  compatible:
    const: sifli,sf32lb52-dmac

  reg:
    maxItems: 1

  clocks:
    maxItems: 1

  '#dma-cells':
    const: 3

  dma-channels:
    const: 8

required:
  - compatible
  - reg
  - clocks
  - '#dma-cells'

unevaluatedProperties: false

examples:
  - |
    dma-controller@50081000 {
        compatible = "sifli,sf32lb52-dmac";
        reg = <0x50081000 0x1000>;
        clocks = <&rcc 0>;
        #dma-cells = <3>;
        dma-channels = <8>;
    };
```

## dts/bindings/gpio/nordic,nrf52832-gpio.yaml
```yaml
# SPDX-License-Identifier: (GPL-2.0-only OR BSD-2-Clause)
%YAML 1.2
---
$id: http://devicetree.org/schemas/gpio/nordic,nrf52832-gpio.yaml#
$schema: http://devicetree.org/meta-schemas/core.yaml#

title: Nordic nRF52 GPIO port

maintainers:
  - Gerard Marull-Paretas <gerard@teslabs.com>

description:
  A GPIO port of the nRF52 series, first in the nRF52832. Its pins interrupt through the GPIOTE block, so
  interrupt specifiers take two cells, the pin and the trigger type from
  <dt-bindings/interrupt-controller/irq.h>.

properties:
  compatible:
    oneOf:
      - const: nordic,nrf52832-gpio
      - items:
          - enum:
              - nordic,nrf52833-gpio
              - nordic,nrf52840-gpio
          - const: nordic,nrf52832-gpio

  reg:
    items:
      - description: Base of the port
      - description: Registers of the port

  gpio-controller: true

  '#gpio-cells':
    const: 2

  ngpios:
    minimum: 1
    maximum: 32

  gpio-reserved-ranges: true

  interrupt-controller: true

  '#interrupt-cells':
    const: 2

required:
  - compatible
  - reg
  - gpio-controller
  - '#gpio-cells'
  - interrupt-controller
  - '#interrupt-cells'

additionalProperties: false

examples:
  - |
    gpio@50000000 {
        compatible = "nordic,nrf52832-gpio";
        reg = <0x50000000 0x200>, <0x50000500 0x300>;
        gpio-controller;
        #gpio-cells = <2>;
        ngpios = <32>;
        interrupt-controller;
        #interrupt-cells = <2>;
    };
```

## dts/bindings/gpio/qemu,pebble-gpio.yaml
```yaml
# SPDX-License-Identifier: (GPL-2.0-only OR BSD-2-Clause)
%YAML 1.2
---
$id: http://devicetree.org/schemas/gpio/qemu,pebble-gpio.yaml#
$schema: http://devicetree.org/meta-schemas/core.yaml#

title: QEMU Pebble GPIO

maintainers:
  - Gerard Marull-Paretas <gerard@teslabs.com>

description:
  Input pins of the QEMU Pebble machines, driven by the emulated buttons. Each
  pin interrupts on both edges through the controller's interrupt; interrupt
  specifiers take the pin and the trigger type from
  <dt-bindings/interrupt-controller/irq.h>.

properties:
  compatible:
    const: qemu,pebble-gpio

  reg:
    maxItems: 1

  interrupts:
    maxItems: 1

  gpio-controller: true

  '#gpio-cells':
    const: 2

  ngpios:
    const: 4

  interrupt-controller: true

  '#interrupt-cells':
    const: 2

required:
  - compatible
  - reg
  - interrupts
  - gpio-controller
  - '#gpio-cells'
  - interrupt-controller
  - '#interrupt-cells'

additionalProperties: false

examples:
  - |
    gpio@40006000 {
        compatible = "qemu,pebble-gpio";
        reg = <0x40006000 0x1000>;
        interrupts = <6>;
        gpio-controller;
        #gpio-cells = <2>;
        ngpios = <4>;
        interrupt-controller;
        #interrupt-cells = <2>;
    };
```

## dts/bindings/gpio/sifli,sf32lb52-gpio.yaml
```yaml
# SPDX-License-Identifier: (GPL-2.0-only OR BSD-2-Clause)
%YAML 1.2
---
$id: http://devicetree.org/schemas/gpio/sifli,sf32lb52-gpio.yaml#
$schema: http://devicetree.org/meta-schemas/core.yaml#

title: SiFli SF32LB52 GPIO controller (HPSYS GPIO1)

maintainers:
  - Gerard Marull-Paretas <gerard@teslabs.com>

description:
  GPIO controller of the PA pads. Each pad is also an interrupt source.

properties:
  compatible:
    const: sifli,sf32lb52-gpio

  reg:
    maxItems: 1

  interrupts:
    maxItems: 1

  clocks:
    maxItems: 1

  gpio-controller: true

  gpio-ranges:
    maxItems: 1

  '#gpio-cells':
    const: 2

  ngpios:
    maximum: 45

  gpio-reserved-ranges: true

  sifli,hpsys-aon:
    $ref: /schemas/types.yaml#/definitions/phandle
    description: HPSYS always-on block, where wakeup pins latch.

  interrupt-controller: true

  '#interrupt-cells':
    const: 2

required:
  - compatible
  - reg
  - interrupts
  - clocks
  - gpio-controller
  - '#gpio-cells'
  - ngpios
  - sifli,hpsys-aon
  - interrupt-controller
  - '#interrupt-cells'

additionalProperties: false

examples:
  - |
    gpio@500a0000 {
        compatible = "sifli,sf32lb52-gpio";
        reg = <0x500a0000 0x1000>;
        interrupts = <84>;
        clocks = <&hpsys_rcc 25>;
        gpio-controller;
        #gpio-cells = <2>;
        ngpios = <45>;
        sifli,hpsys-aon = <&hpsys_aon>;
        interrupt-controller;
        #interrupt-cells = <2>;
    };
```

## dts/bindings/i2c/nordic,nrf52832-twim.yaml
```yaml
# SPDX-License-Identifier: (GPL-2.0-only OR BSD-2-Clause)
%YAML 1.2
---
$id: http://devicetree.org/schemas/i2c/nordic,nrf52832-twim.yaml#
$schema: http://devicetree.org/meta-schemas/core.yaml#

title: Nordic nRF52 TWIM I2C controller

maintainers:
  - Gerard Marull-Paretas <gerard@teslabs.com>

description:
  I2C controller with EasyDMA of the nRF52 series, first in the nRF52832. It
  shares its registers, interrupt and address with the other serial functions
  of the same instance, such as the SPIM, each a sibling node of its own, and
  only one of them may be enabled. The peripheral selects its own pins, given as
  scl-gpios and sda-gpios.

allOf:
  - $ref: /schemas/i2c/i2c-controller.yaml#

properties:
  compatible:
    oneOf:
      - const: nordic,nrf52832-twim
      - items:
          - enum:
              - nordic,nrf52833-twim
              - nordic,nrf52840-twim
          - const: nordic,nrf52832-twim

  reg:
    maxItems: 1

  interrupts:
    maxItems: 1

  clock-frequency:
    enum: [100000, 250000, 400000]

required:
  - compatible
  - reg
  - interrupts
  - scl-gpios
  - sda-gpios

unevaluatedProperties: false

examples:
  - |
    #include <dt-bindings/gpio/gpio.h>

    i2c@40003000 {
        compatible = "nordic,nrf52832-twim";
        reg = <0x40003000 0x1000>;
        interrupts = <3>;
        clock-frequency = <400000>;
        scl-gpios = <&gpio0 25 GPIO_PULL_UP>;
        sda-gpios = <&gpio0 11 GPIO_PULL_UP>;
        #address-cells = <1>;
        #size-cells = <0>;
    };
```

## dts/bindings/i2c/sifli,sf32lb52-i2c.yaml
```yaml
# SPDX-License-Identifier: (GPL-2.0-only OR BSD-2-Clause)
%YAML 1.2
---
$id: http://devicetree.org/schemas/i2c/sifli,sf32lb52-i2c.yaml#
$schema: http://devicetree.org/meta-schemas/core.yaml#

title: SiFli SF32LB52 I2C controller

maintainers:
  - Gerard Marull-Paretas <gerard@teslabs.com>

allOf:
  - $ref: /schemas/i2c/i2c-controller.yaml#

properties:
  compatible:
    const: sifli,sf32lb52-i2c

  reg:
    maxItems: 1

  interrupts:
    maxItems: 1

  clocks:
    maxItems: 1

  clock-frequency:
    enum: [100000, 400000, 1000000]

  dmas:
    maxItems: 1

  dma-names:
    const: rx

  pinctrl-0: true
  pinctrl-names: true

required:
  - compatible
  - reg
  - interrupts
  - clocks

unevaluatedProperties: false

examples:
  - |
    i2c@5009c000 {
        compatible = "sifli,sf32lb52-i2c";
        reg = <0x5009c000 0x1000>;
        interrupts = <61>;
        clocks = <&rcc 27>;
        clock-frequency = <400000>;
        #address-cells = <1>;
        #size-cells = <0>;
    };
```

## dts/bindings/iio/adc/sifli,sf32lb52-gpadc.yaml
```yaml
# SPDX-License-Identifier: (GPL-2.0-only OR BSD-2-Clause)
%YAML 1.2
---
$id: http://devicetree.org/schemas/iio/adc/sifli,sf32lb52-gpadc.yaml#
$schema: http://devicetree.org/meta-schemas/core.yaml#

title: SiFli SF32LB52 general purpose ADC

maintainers:
  - Gerard Marull-Paretas <gerard@teslabs.com>

description:
  General purpose ADC with eight conversion slots. The radio calibration
  borrows it to measure the transmitter output.

properties:
  compatible:
    enum:
      - sifli,sf32lb52-gpadc
      - sifli,sf32lb57-gpadc

  reg:
    maxItems: 1

  interrupts:
    maxItems: 1

  clocks:
    maxItems: 1

  "#io-channel-cells":
    const: 1

  nvmem-cells:
    maxItems: 1
    description: Factory calibration of the SF32LB57 transfer, two points and the VBAT reference.

  nvmem-cell-names:
    const: calibration

  sifli,hpsys-cfg:
    $ref: /schemas/types.yaml#/definitions/phandle
    description: HPSYS configuration, enabling the bandgap the SF32LB57 reference runs from.

required:
  - compatible
  - reg
  - interrupts
  - clocks
  - "#io-channel-cells"

allOf:
  - if:
      properties:
        compatible:
          const: sifli,sf32lb57-gpadc
    then:
      required:
        - sifli,hpsys-cfg

additionalProperties: false

examples:
  - |
    adc@50087000 {
        compatible = "sifli,sf32lb52-gpadc";
        reg = <0x50087000 0x1000>;
        interrupts = <65>;
        clocks = <&rcc 35>;
        #io-channel-cells = <1>;
    };
```

## dts/bindings/iio/health/goodix,gh3026.yaml
```yaml
# SPDX-License-Identifier: (GPL-2.0-only OR BSD-2-Clause)
%YAML 1.2
---
$id: http://devicetree.org/schemas/iio/health/goodix,gh3026.yaml#
$schema: http://devicetree.org/meta-schemas/core.yaml#

title: Goodix GH3026 optical front end

maintainers:
  - Gerard Marull-Paretas <gerard@teslabs.com>

description:
  Optical front end for heart rate and blood oxygen measurements, over I2C.
  It drives LEDs and samples photodiode receivers in time slots, and raises
  an interrupt when its FIFO fills.

properties:
  compatible:
    const: goodix,gh3026

  reg:
    maxItems: 1

  interrupts:
    maxItems: 1

  reset-gpios:
    maxItems: 1

required:
  - compatible
  - reg
  - interrupts

additionalProperties: false

examples:
  - |
    #include <dt-bindings/gpio/gpio.h>
    #include <dt-bindings/interrupt-controller/irq.h>

    i2c {
        #address-cells = <1>;
        #size-cells = <0>;

        heart-rate@14 {
            compatible = "goodix,gh3026";
            reg = <0x14>;
            interrupt-parent = <&gpio1>;
            interrupts = <44 IRQ_TYPE_EDGE_FALLING>;
            reset-gpios = <&pmic 3 GPIO_ACTIVE_LOW>;
        };
    };
```

## dts/bindings/iio/light/sensortek,w1160.yaml
```yaml
# SPDX-License-Identifier: (GPL-2.0-only OR BSD-2-Clause)
%YAML 1.2
---
$id: http://devicetree.org/schemas/iio/light/sensortek,w1160.yaml#
$schema: http://devicetree.org/meta-schemas/core.yaml#

title: Sensortek W1160 ambient light sensor

maintainers:
  - Gerard Marull-Paretas <gerard@teslabs.com>

description:
  Ambient light sensor over I2C.

properties:
  compatible:
    const: sensortek,w1160

  reg:
    maxItems: 1

  interrupts:
    maxItems: 1

  vdd-supply: true

  sensortek,lux-scale:
    $ref: /schemas/types.yaml#/definitions/uint32-array
    description:
      Illuminance per count, as a numerator and a denominator, through the
      glass covering the sensor.
    items:
      - description: Numerator
        minimum: 1
      - description: Denominator
        minimum: 1

required:
  - compatible
  - reg
  - sensortek,lux-scale

additionalProperties: false

examples:
  - |
    i2c {
        #address-cells = <1>;
        #size-cells = <0>;

        light-sensor@48 {
            compatible = "sensortek,w1160";
            reg = <0x48>;
            sensortek,lux-scale = <100 483>;
        };
    };
```

## dts/bindings/iio/magnetometer/memsic,mmc5603.yaml
```yaml
# SPDX-License-Identifier: (GPL-2.0-only OR BSD-2-Clause)
%YAML 1.2
---
$id: http://devicetree.org/schemas/iio/magnetometer/memsic,mmc5603.yaml#
$schema: http://devicetree.org/meta-schemas/core.yaml#

title: MEMSIC MMC5603 3-axis magnetometer

maintainers:
  - Gerard Marull-Paretas <gerard@teslabs.com>

properties:
  compatible:
    const: memsic,mmc5603

  reg:
    maxItems: 1

  mount-matrix:
    description: An optional 3x3 mounting rotation matrix.

required:
  - compatible
  - reg

additionalProperties: false

examples:
  - |
    i2c {
        #address-cells = <1>;
        #size-cells = <0>;

        magnetometer@30 {
            compatible = "memsic,mmc5603";
            reg = <0x30>;
        };
    };
```
