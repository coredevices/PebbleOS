## dts/bindings/remoteproc/st,stm32h747-m4.yaml
```yaml
# SPDX-License-Identifier: (GPL-2.0-only OR BSD-2-Clause)
%YAML 1.2
---
$id: http://devicetree.org/schemas/remoteproc/st,stm32h747-m4.yaml#
$schema: http://devicetree.org/meta-schemas/core.yaml#

title: STMicroelectronics STM32H747 Cortex-M4

maintainers:
  - Gerard Marull-Paretas <gerard@teslabs.com>

description:
  The Cortex-M4 of a dual-core STM32H7, which runs its own firmware from the
  flash. It waits until the Cortex-M7 lets it boot, and the Cortex-M7 tells
  it before stopping it or powering the system off. A stopped Cortex-M4 starts
  again from a reset of its own.

properties:
  compatible:
    const: st,stm32h747-m4

  st,syscfg-holdboot:
    description: Lets the Cortex-M4 boot once set.
    $ref: /schemas/types.yaml#/definitions/phandle-array
    items:
      - items:
          - description: Phandle of syscon block
          - description: The offset of the hold boot setting register
          - description: The field mask of the hold boot

  st,syscfg-boot-address:
    description:
      Option bytes holding bits 31:16 of the address the Cortex-M4 boots from.
    $ref: /schemas/types.yaml#/definitions/phandle-array
    items:
      - items:
          - description: Phandle of the flash controller
          - description: The offset of the boot address register
          - description: The field mask of the boot address

  st,syscfg-flash:
    description:
      Allocates the flash, in the domain of the Cortex-M7, to the Cortex-M4,
      which runs from it, so that the domain stays up while the Cortex-M4
      runs.
    $ref: /schemas/types.yaml#/definitions/phandle-array
    items:
      - items:
          - description: Phandle of syscon block
          - description: The offset of the flash allocation register
          - description: The field mask of the flash allocation

  mboxes:
    minItems: 1
    items:
      - description:
          Tells the Cortex-M4 that the system is about to be powered off, or
          that it is stopped; its acknowledgement means it is stopping.
      - description:
          Rung by the Cortex-M4 woken alone from Stop, the system then running
          on the HSI until the Cortex-M7, which owns the clock tree, brings it
          back.

  mbox-names:
    minItems: 1
    items:
      - const: shutdown
      - const: clocks

  st,wwdg:
    $ref: /schemas/types.yaml#/definitions/phandle
    description:
      Window watchdog of the Cortex-M4, whose timeout resets the Cortex-M4
      alone, restarting a stopped Cortex-M4.

  st,auto-boot:
    $ref: /schemas/types.yaml#/definitions/flag
    description: |
      Boot the Cortex-M4 at startup, when its flash holds an image. A
      Cortex-M4 that never boots keeps the system out of Stop and Standby,
      as only a running core stops.

required:
  - compatible
  - st,syscfg-holdboot
  - st,syscfg-boot-address
  - st,syscfg-flash

additionalProperties: false

examples:
  - |
    remoteproc {
        compatible = "st,stm32h747-m4";
        st,syscfg-holdboot = <&rcc 0xa0 0x8>;
        st,syscfg-boot-address = <&flash 0x48 0xffff>;
        st,syscfg-flash = <&rcc 0x194 0x100>;
        mboxes = <&hsem 0>, <&hsem 1>;
        mbox-names = "shutdown", "clocks";
        st,wwdg = <&wwdg2>;
        st,auto-boot;
    };
```

## dts/bindings/rng/nordic,nrf52832-rng.yaml
```yaml
# SPDX-License-Identifier: (GPL-2.0-only OR BSD-2-Clause)
%YAML 1.2
---
$id: http://devicetree.org/schemas/rng/nordic,nrf52832-rng.yaml#
$schema: http://devicetree.org/meta-schemas/core.yaml#

title: Nordic nRF52 random number generator

maintainers:
  - Gerard Marull-Paretas <gerard@teslabs.com>

description:
  Random number generator from thermal noise, with optional bias correction.

properties:
  compatible:
    oneOf:
      - const: nordic,nrf52832-rng
      - items:
          - enum:
              - nordic,nrf52833-rng
              - nordic,nrf52840-rng
          - const: nordic,nrf52832-rng

  reg:
    maxItems: 1

  interrupts:
    maxItems: 1

required:
  - compatible
  - reg
  - interrupts

additionalProperties: false

examples:
  - |
    rng@4000d000 {
        compatible = "nordic,nrf52840-rng", "nordic,nrf52832-rng";
        reg = <0x4000d000 0x1000>;
        interrupts = <13>;
    };
```

## dts/bindings/rng/sifli,sf32lb52-trng.yaml
```yaml
# SPDX-License-Identifier: (GPL-2.0-only OR BSD-2-Clause)
%YAML 1.2
---
$id: http://devicetree.org/schemas/rng/sifli,sf32lb52-trng.yaml#
$schema: http://devicetree.org/meta-schemas/core.yaml#

title: SiFli SF32LB52 true random number generator

description:
  True random number generator of the SF32LB52, also found in the SF32LB57.

maintainers:
  - Gerard Marull-Paretas <gerard@teslabs.com>

properties:
  compatible:
    oneOf:
      - const: sifli,sf32lb52-trng
      - items:
          - const: sifli,sf32lb57-trng
          - const: sifli,sf32lb52-trng

  reg:
    maxItems: 1

  clocks:
    maxItems: 1

required:
  - compatible
  - reg
  - clocks

additionalProperties: false

examples:
  - |
    rng@5000f000 {
        compatible = "sifli,sf32lb52-trng";
        reg = <0x5000f000 0x1000>;
        clocks = <&hpsys_rcc 12>;
    };
```

## dts/bindings/rtc/qemu,pebble-rtc.yaml
```yaml
# SPDX-License-Identifier: (GPL-2.0-only OR BSD-2-Clause)
%YAML 1.2
---
$id: http://devicetree.org/schemas/rtc/qemu,pebble-rtc.yaml#
$schema: http://devicetree.org/meta-schemas/core.yaml#

title: QEMU Pebble RTC

maintainers:
  - Gerard Marull-Paretas <gerard@teslabs.com>

description:
  Real-time clock of the QEMU Pebble machines, following the host clock, with a free-running
  tick counter and sixteen backup registers.

properties:
  compatible:
    const: qemu,pebble-rtc

  reg:
    maxItems: 1

required:
  - compatible
  - reg

additionalProperties: false

examples:
  - |
    rtc@40005000 {
        compatible = "qemu,pebble-rtc";
        reg = <0x40005000 0x1000>;
    };
```

## dts/bindings/rtc/sifli,sf32lb52-rtc.yaml
```yaml
# SPDX-License-Identifier: (GPL-2.0-only OR BSD-2-Clause)
%YAML 1.2
---
$id: http://devicetree.org/schemas/rtc/sifli,sf32lb52-rtc.yaml#
$schema: http://devicetree.org/meta-schemas/core.yaml#

title: SiFli SF32LB52 and SF32LB57 real-time clock

maintainers:
  - Gerard Marull-Paretas <gerard@teslabs.com>

description:
  Calendar RTC with an alarm, which wakes the system from hibernate. On the
  SF32LB52 it selects clk_rtc, LRC10 or LXT32, which it counts and provides
  to the low-power timers and the Bluetooth sleep timer; on the SF32LB57 the
  PMU provides clk_rtc.

allOf:
  - $ref: rtc.yaml#
  - if:
      properties:
        compatible:
          const: sifli,sf32lb57-rtc
    then:
      properties:
        "#clock-cells": false
        clocks:
          items:
            - description: clk_rtc, from the PMU
        clock-names:
          items:
            - const: rtc
    else:
      properties:
        clocks:
          items:
            - description: LRC10 oscillator
            - description: LXT32 oscillator
        clock-names:
          items:
            - const: lrc10
            - const: lxt32
      required:
        - "#clock-cells"

properties:
  compatible:
    enum:
      - sifli,sf32lb52-rtc
      - sifli,sf32lb57-rtc

  reg:
    maxItems: 1

  interrupts:
    maxItems: 1

  "#clock-cells":
    const: 0

  clocks:
    minItems: 1
    maxItems: 2

  clock-names:
    minItems: 1
    maxItems: 2

  sifli,hpsys-cfg:
    $ref: /schemas/types.yaml#/definitions/phandle
    description: HPSYS configuration block, holding the shadow time and date.

required:
  - compatible
  - reg
  - interrupts
  - clocks
  - clock-names
  - sifli,hpsys-cfg

unevaluatedProperties: false

examples:
  - |
    rtc@500cb000 {
        compatible = "sifli,sf32lb52-rtc";
        reg = <0x500cb000 0x1000>;
        interrupts = <49>;
        #clock-cells = <0>;
        clocks = <&pmuc 0>, <&pmuc 2>;
        clock-names = "lrc10", "lxt32";
        sifli,hpsys-cfg = <&hpsys_cfg>;
    };
```

## dts/bindings/serial/nordic,nrf54l15-uarte.yaml
```yaml
# SPDX-License-Identifier: (GPL-2.0-only OR BSD-2-Clause)
%YAML 1.2
---
$id: http://devicetree.org/schemas/serial/nordic,nrf54l15-uarte.yaml#
$schema: http://devicetree.org/meta-schemas/core.yaml#

title: Nordic nRF54L UARTE

maintainers:
  - Gerard Marull-Paretas <gerard@teslabs.com>

description:
  UART with EasyDMA of the nRF54L series, on a 16 MHz peripheral clock. Its
  pins are selected in its own registers, from tx-gpios and rx-gpios, and must
  be in its power domain.

allOf:
  - $ref: /schemas/serial/serial.yaml#

properties:
  compatible:
    oneOf:
      - const: nordic,nrf54l15-uarte
      - items:
          - const: nordic,nrf54lm20a-uarte
          - const: nordic,nrf54l15-uarte

  reg:
    maxItems: 1

  interrupts:
    maxItems: 1

  current-speed:
    $ref: /schemas/types.yaml#/definitions/uint32
    description: Initial baud rate, in bits per second.

  tx-gpios:
    maxItems: 1

  rx-gpios:
    maxItems: 1

required:
  - compatible
  - reg
  - interrupts
  - tx-gpios
  - rx-gpios

unevaluatedProperties: false

examples:
  - |
    serial@500c6000 {
        compatible = "nordic,nrf54l15-uarte";
        reg = <0x500c6000 0x1000>;
        interrupts = <198>;
        current-speed = <115200>;
        tx-gpios = <&gpio1 4 0>;
        rx-gpios = <&gpio1 5 0>;
    };
```

## dts/bindings/soc/nordic/nordic,nrf52832-ficr.yaml
```yaml
# SPDX-License-Identifier: (GPL-2.0-only OR BSD-2-Clause)
%YAML 1.2
---
$id: http://devicetree.org/schemas/soc/nordic/nordic,nrf52832-ficr.yaml#
$schema: http://devicetree.org/meta-schemas/core.yaml#

title: Nordic nRF52 factory information configuration registers

maintainers:
  - Gerard Marull-Paretas <gerard@teslabs.com>

description:
  Read-only registers the factory programs, with the device ID and address and the part.

properties:
  compatible:
    oneOf:
      - const: nordic,nrf52832-ficr
      - items:
          - enum:
              - nordic,nrf52833-ficr
              - nordic,nrf52840-ficr
          - const: nordic,nrf52832-ficr

  reg:
    maxItems: 1

required:
  - compatible
  - reg

additionalProperties: false

examples:
  - |
    ficr@10000000 {
        compatible = "nordic,nrf52840-ficr", "nordic,nrf52832-ficr";
        reg = <0x10000000 0x1000>;
    };
```

## dts/bindings/soc/nordic/nordic,nrf52832-uicr.yaml
```yaml
# SPDX-License-Identifier: (GPL-2.0-only OR BSD-2-Clause)
%YAML 1.2
---
$id: http://devicetree.org/schemas/soc/nordic/nordic,nrf52832-uicr.yaml#
$schema: http://devicetree.org/meta-schemas/core.yaml#

title: Nordic nRF52 user information configuration registers

maintainers:
  - Gerard Marull-Paretas <gerard@teslabs.com>

description:
  Non-volatile registers the firmware programs, as the reset pin, the debug access port
  protection and the REGOUT0 voltage.

properties:
  compatible:
    oneOf:
      - const: nordic,nrf52832-uicr
      - items:
          - enum:
              - nordic,nrf52833-uicr
              - nordic,nrf52840-uicr
          - const: nordic,nrf52832-uicr

  reg:
    maxItems: 1

required:
  - compatible
  - reg

additionalProperties: false

examples:
  - |
    uicr@10001000 {
        compatible = "nordic,nrf52840-uicr", "nordic,nrf52832-uicr";
        reg = <0x10001000 0x1000>;
    };
```

## dts/bindings/soc/nordic/nordic,nrf54l15-cache.yaml
```yaml
# SPDX-License-Identifier: (GPL-2.0-only OR BSD-2-Clause)
%YAML 1.2
---
$id: http://devicetree.org/schemas/soc/nordic/nordic,nrf54l15-cache.yaml#
$schema: http://devicetree.org/meta-schemas/core.yaml#

title: Nordic nRF54L cache

maintainers:
  - Gerard Marull-Paretas <gerard@teslabs.com>

description:
  Instruction cache of the application core, in front of the RRAM.

properties:
  compatible:
    oneOf:
      - const: nordic,nrf54l15-cache
      - items:
          - const: nordic,nrf54lm20a-cache
          - const: nordic,nrf54l15-cache

  reg:
    maxItems: 1

required:
  - compatible
  - reg

additionalProperties: false

examples:
  - |
    node@e0082000 {
        compatible = "nordic,nrf54l15-cache";
        reg = <0xe0082000 0x1000>;
    };
```

## dts/bindings/soc/nordic/nordic,nrf54l15-ficr.yaml
```yaml
# SPDX-License-Identifier: (GPL-2.0-only OR BSD-2-Clause)
%YAML 1.2
---
$id: http://devicetree.org/schemas/soc/nordic/nordic,nrf54l15-ficr.yaml#
$schema: http://devicetree.org/meta-schemas/core.yaml#

title: Nordic nRF54L factory information configuration registers

maintainers:
  - Gerard Marull-Paretas <gerard@teslabs.com>

description:
  Read-only registers the factory programs, with the device ID, the trim
  values of the analog blocks and the crystal oscillator trims. Its cells
  are read as NVMEM cells, a word at a time.

allOf:
  - $ref: /schemas/nvmem/nvmem.yaml#
  - $ref: /schemas/nvmem/nvmem-deprecated-cells.yaml#

properties:
  compatible:
    const: nordic,nrf54l15-ficr

  reg:
    maxItems: 1

required:
  - compatible
  - reg

unevaluatedProperties: false

examples:
  - |
    node@ffc000 {
        compatible = "nordic,nrf54l15-ficr";
        reg = <0xffc000 0x1000>;
        #address-cells = <1>;
        #size-cells = <1>;

        xosc32mtrim@620 {
            reg = <0x620 0x4>;
        };
    };
```

## dts/bindings/soc/nordic/nordic,nrf54l15-gpiote.yaml
```yaml
# SPDX-License-Identifier: (GPL-2.0-only OR BSD-2-Clause)
%YAML 1.2
---
$id: http://devicetree.org/schemas/soc/nordic/nordic,nrf54l15-gpiote.yaml#
$schema: http://devicetree.org/meta-schemas/core.yaml#

title: Nordic nRF54L GPIO tasks and events (GPIOTE)

maintainers:
  - Gerard Marull-Paretas <gerard@teslabs.com>

description:
  Turns the state changes of the pins of the GPIO port of its power domain into events, on a number of channels each bound to a pin. Its interrupt is the one of the secure application core.

properties:
  compatible:
    oneOf:
      - const: nordic,nrf54l15-gpiote
      - items:
          - const: nordic,nrf54lm20a-gpiote
          - const: nordic,nrf54l15-gpiote

  reg:
    maxItems: 1

  interrupts:
    maxItems: 1

  nordic,num-channels:
    $ref: /schemas/types.yaml#/definitions/uint32
    maximum: 8
    description: Number of channels, 8 on GPIOTE20 and 4 on GPIOTE30.

required:
  - compatible
  - reg
  - interrupts
  - nordic,num-channels

additionalProperties: false

examples:
  - |
    node@500da000 {
        compatible = "nordic,nrf54l15-gpiote";
        reg = <0x500da000 0x1000>;
        interrupts = <219>;
        nordic,num-channels = <8>;
    };
```

## dts/bindings/soc/nordic/nordic,nrf54l15-memconf.yaml
```yaml
# SPDX-License-Identifier: (GPL-2.0-only OR BSD-2-Clause)
%YAML 1.2
---
$id: http://devicetree.org/schemas/soc/nordic/nordic,nrf54l15-memconf.yaml#
$schema: http://devicetree.org/meta-schemas/core.yaml#

title: Nordic nRF54L memory configuration

maintainers:
  - Gerard Marull-Paretas <gerard@teslabs.com>

description:
  Powers the RAM blocks, and chooses which of them keep their content in
  System OFF.

properties:
  compatible:
    enum:
      - nordic,nrf54l15-memconf
      - nordic,nrf54lm20a-memconf

  reg:
    maxItems: 1

required:
  - compatible
  - reg

additionalProperties: false

examples:
  - |
    node@500cf000 {
        compatible = "nordic,nrf54l15-memconf";
        reg = <0x500cf000 0x1000>;
    };
```
