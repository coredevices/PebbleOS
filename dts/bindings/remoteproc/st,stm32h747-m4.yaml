## dts/bindings/soc/nordic/nordic,nrf54l15-oscillators.yaml
```yaml
# SPDX-License-Identifier: (GPL-2.0-only OR BSD-2-Clause)
%YAML 1.2
---
$id: http://devicetree.org/schemas/soc/nordic/nordic,nrf54l15-oscillators.yaml#
$schema: http://devicetree.org/meta-schemas/core.yaml#

title: Nordic nRF54L oscillators and regulators

maintainers:
  - Gerard Marull-Paretas <gerard@teslabs.com>

description:
  Configures the crystal oscillators, their load capacitors and the PLL of the CPU clock, and shares its registers with the regulators.

properties:
  compatible:
    const: nordic,nrf54l15-oscillators

  reg:
    maxItems: 1

required:
  - compatible
  - reg

additionalProperties: false

examples:
  - |
    node@50120000 {
        compatible = "nordic,nrf54l15-oscillators";
        reg = <0x50120000 0x1000>;
    };
```

## dts/bindings/soc/nordic/nordic,nrf54l15-radio.yaml
```yaml
# SPDX-License-Identifier: (GPL-2.0-only OR BSD-2-Clause)
%YAML 1.2
---
$id: http://devicetree.org/schemas/soc/nordic/nordic,nrf54l15-radio.yaml#
$schema: http://devicetree.org/meta-schemas/core.yaml#

title: Nordic nRF54L radio

maintainers:
  - Gerard Marull-Paretas <gerard@teslabs.com>

description:
  The 2.4 GHz radio, for Bluetooth LE and IEEE 802.15.4, with two interrupt
  lines. The radio protocol stack drives it.

properties:
  compatible:
    oneOf:
      - const: nordic,nrf54l15-radio
      - items:
          - const: nordic,nrf54lm20a-radio
          - const: nordic,nrf54l15-radio

  reg:
    maxItems: 1

  interrupts:
    maxItems: 2

required:
  - compatible
  - reg
  - interrupts

additionalProperties: false

examples:
  - |
    radio@5008a000 {
        compatible = "nordic,nrf54l15-radio";
        reg = <0x5008a000 0x1000>;
        interrupts = <138>, <139>;
    };
```

## dts/bindings/soc/nordic/nordic,nrf54l15-spu.yaml
```yaml
# SPDX-License-Identifier: (GPL-2.0-only OR BSD-2-Clause)
%YAML 1.2
---
$id: http://devicetree.org/schemas/soc/nordic/nordic,nrf54l15-spu.yaml#
$schema: http://devicetree.org/meta-schemas/core.yaml#

title: Nordic nRF54L system protection unit

maintainers:
  - Gerard Marull-Paretas <gerard@teslabs.com>

description:
  Security attributes of the peripherals on a bus, and of the bus masters
  among them, by their slave index.

properties:
  compatible:
    const: nordic,nrf54l15-spu

  reg:
    maxItems: 1

  interrupts:
    maxItems: 1

required:
  - compatible
  - reg

additionalProperties: false

examples:
  - |
    spu@50040000 {
        compatible = "nordic,nrf54l15-spu";
        reg = <0x50040000 0x1000>;
        interrupts = <64>;
    };
```

## dts/bindings/soc/nordic/nordic,nrf54l15-tad.yaml
```yaml
# SPDX-License-Identifier: (GPL-2.0-only OR BSD-2-Clause)
%YAML 1.2
---
$id: http://devicetree.org/schemas/soc/nordic/nordic,nrf54l15-tad.yaml#
$schema: http://devicetree.org/meta-schemas/core.yaml#

title: Nordic nRF54L trace and debug control

maintainers:
  - Gerard Marull-Paretas <gerard@teslabs.com>

description:
  Powers and clocks the debug and trace logic of the cores.

properties:
  compatible:
    oneOf:
      - const: nordic,nrf54l15-tad
      - items:
          - const: nordic,nrf54lm20a-tad
          - const: nordic,nrf54l15-tad

  reg:
    maxItems: 1

required:
  - compatible
  - reg

additionalProperties: false

examples:
  - |
    node@50053000 {
        compatible = "nordic,nrf54l15-tad";
        reg = <0x50053000 0x1000>;
    };
```

## dts/bindings/soc/nordic/nordic,nrf54l15-tampc.yaml
```yaml
# SPDX-License-Identifier: (GPL-2.0-only OR BSD-2-Clause)
%YAML 1.2
---
$id: http://devicetree.org/schemas/soc/nordic/nordic,nrf54l15-tampc.yaml#
$schema: http://devicetree.org/meta-schemas/core.yaml#

title: Nordic nRF54L tamper controller

maintainers:
  - Gerard Marull-Paretas <gerard@teslabs.com>

description:
  Watches for tampering, and holds the signals that open the debug access
  ports to the cores.

properties:
  compatible:
    oneOf:
      - const: nordic,nrf54l15-tampc
      - items:
          - const: nordic,nrf54lm20a-tampc
          - const: nordic,nrf54l15-tampc

  reg:
    maxItems: 1

  interrupts:
    maxItems: 1

required:
  - compatible
  - reg
  - interrupts

additionalProperties: false

examples:
  - |
    node@500dc000 {
        compatible = "nordic,nrf54l15-tampc";
        reg = <0x500dc000 0x1000>;
        interrupts = <220>;
    };
```

## dts/bindings/soc/nordic/nordic,nrf54l15-uicr.yaml
```yaml
# SPDX-License-Identifier: (GPL-2.0-only OR BSD-2-Clause)
%YAML 1.2
---
$id: http://devicetree.org/schemas/soc/nordic/nordic,nrf54l15-uicr.yaml#
$schema: http://devicetree.org/meta-schemas/core.yaml#

title: Nordic nRF54L user information configuration registers

maintainers:
  - Gerard Marull-Paretas <gerard@teslabs.com>

description:
  Non-volatile registers the user programs, as the access port protection.

properties:
  compatible:
    oneOf:
      - const: nordic,nrf54l15-uicr
      - items:
          - const: nordic,nrf54lm20a-uicr
          - const: nordic,nrf54l15-uicr

  reg:
    maxItems: 1

required:
  - compatible
  - reg

additionalProperties: false

examples:
  - |
    node@ffd000 {
        compatible = "nordic,nrf54l15-uicr";
        reg = <0xffd000 0x1000>;
    };
```

## dts/bindings/soc/nordic/nordic,nrf54lm20a-vregusb.yaml
```yaml
# SPDX-License-Identifier: (GPL-2.0-only OR BSD-2-Clause)
%YAML 1.2
---
$id: http://devicetree.org/schemas/soc/nordic/nordic,nrf54lm20a-vregusb.yaml#
$schema: http://devicetree.org/meta-schemas/core.yaml#

title: Nordic nRF54LM20A USB regulator

maintainers:
  - Gerard Marull-Paretas <gerard@teslabs.com>

description:
  Regulator of the USB PHY, which VBUS powers, and which reports VBUS
  coming and going.

properties:
  compatible:
    const: nordic,nrf54lm20a-vregusb

  reg:
    maxItems: 1

  interrupts:
    maxItems: 1

required:
  - compatible
  - reg
  - interrupts

additionalProperties: false

examples:
  - |
    regulator@50121000 {
        compatible = "nordic,nrf54lm20a-vregusb";
        reg = <0x50121000 0x1000>;
        interrupts = <289>;
    };
```

## dts/bindings/soc/qemu/qemu,pebble-sysctrl.yaml
```yaml
# SPDX-License-Identifier: (GPL-2.0-only OR BSD-2-Clause)
%YAML 1.2
---
$id: http://devicetree.org/schemas/soc/qemu/qemu,pebble-sysctrl.yaml#
$schema: http://devicetree.org/meta-schemas/core.yaml#

title: QEMU Pebble system controller

maintainers:
  - Gerard Marull-Paretas <gerard@teslabs.com>

description:
  System control registers of the QEMU Pebble machines, with the reset reason and the Bluetooth
  address the host gives.

properties:
  compatible:
    items:
      - const: qemu,pebble-sysctrl
      - const: syscon

  reg:
    maxItems: 1

required:
  - compatible
  - reg

additionalProperties: false

examples:
  - |
    syscon@40007000 {
        compatible = "qemu,pebble-sysctrl", "syscon";
        reg = <0x40007000 0x1000>;
    };
```

## dts/bindings/soc/st/st,stm32h747-pwr.yaml
```yaml
# SPDX-License-Identifier: (GPL-2.0-only OR BSD-2-Clause)
%YAML 1.2
---
$id: http://devicetree.org/schemas/soc/st/st,stm32h747-pwr.yaml#
$schema: http://devicetree.org/meta-schemas/core.yaml#

title: STMicroelectronics STM32H747 power control

maintainers:
  - Gerard Marull-Paretas <gerard@teslabs.com>

description:
  Power control (PWR) of the STM32H745, STM32H747, STM32H755 and STM32H757,
  whose core domain is supplied by an internal LDO, an internal step-down
  converter (SMPS), both, or an external source. How the board wires VCAP,
  VDDLDO and VFBSMPS fixes which. The setting can only be written once per
  power-on, and one that does not match the board stalls the core supply.

properties:
  compatible:
    const: st,stm32h747-pwr

  reg:
    maxItems: 1

  st,supply-config:
    $ref: /schemas/types.yaml#/definitions/string
    description: |
      Supply configuration of the core domain, as wired on the board:
        ldo: the LDO supplies VCORE, the SMPS is off
        direct-smps: the SMPS supplies VCORE, the LDO is off
        smps-1v8-ldo, smps-2v5-ldo: the SMPS supplies the LDO at 1.8 V or 2.5 V
        smps-1v8-ext-ldo, smps-2v5-ext-ldo: the same, the SMPS also supplying
          external circuits
        smps-1v8-ext-bypass, smps-2v5-ext-bypass: the SMPS supplies external
          circuits at 1.8 V or 2.5 V, VCORE comes from an external source
        bypass: VCORE comes from an external source, the LDO and SMPS are off
    enum:
      - ldo
      - direct-smps
      - smps-1v8-ldo
      - smps-2v5-ldo
      - smps-1v8-ext-ldo
      - smps-2v5-ext-ldo
      - smps-1v8-ext-bypass
      - smps-2v5-ext-bypass
      - bypass

required:
  - compatible
  - reg
  - st,supply-config

additionalProperties: false

examples:
  - |
    power-config@58024800 {
        compatible = "st,stm32h747-pwr";
        reg = <0x58024800 0x400>;
        st,supply-config = "direct-smps";
    };
```

## dts/bindings/sound/sifli,sf32lb52-audcodec.yaml
```yaml
# SPDX-License-Identifier: (GPL-2.0-only OR BSD-2-Clause)
%YAML 1.2
---
$id: http://devicetree.org/schemas/sound/sifli,sf32lb52-audcodec.yaml#
$schema: http://devicetree.org/meta-schemas/core.yaml#

title: SiFli SF32LB52 and SF32LB57 audio codec

maintainers:
  - Gerard Marull-Paretas <gerard@teslabs.com>

description: |
  The audio codec of the SF32LB52 and SF32LB57: a DAC, with its analog bias,
  PLL and output stage, and ADCs for analog microphones, powered from its
  microphone bias. Each channel streams through a DMA channel of its own: the
  DAC through tx, the first and second ADC through rx1 and rx2.

  It has two DAIs, selected by the cell of sound-dai: 0 for the DAC, 1 for
  the ADCs.

allOf:
  - $ref: dai-common.yaml#

properties:
  compatible:
    enum:
      - sifli,sf32lb52-audcodec
      - sifli,sf32lb57-audcodec

  reg:
    maxItems: 1

  clocks:
    maxItems: 1

  dmas:
    minItems: 1
    maxItems: 3

  dma-names:
    minItems: 1
    items:
      - const: tx
      - const: rx1
      - const: rx2

  "#sound-dai-cells":
    const: 1

  sifli,pmuc:
    $ref: /schemas/types.yaml#/definitions/phandle
    description: PMUC, holding the HXT48 buffer to the codec.

required:
  - compatible
  - reg
  - clocks
  - "#sound-dai-cells"
  - sifli,pmuc

unevaluatedProperties: false

examples:
  - |
    #include <dt-bindings/dma/sifli,sf32lb52-dmac.h>
    audio-codec@50088000 {
        compatible = "sifli,sf32lb52-audcodec";
        reg = <0x50088000 0x1000>;
        clocks = <&hpsys_rcc 33>;
        dmas = <&dmac1 3 SF32LB52_DMAC1_REQ_AUDCODEC_DAC0 SF32LB52_DMA_PRIO_HIGH>;
        dma-names = "tx";
        #sound-dai-cells = <1>;
        sifli,pmuc = <&pmuc>;
    };
```

## dts/bindings/sound/sifli,sf32lb52-pdm.yaml
```yaml
# SPDX-License-Identifier: (GPL-2.0-only OR BSD-2-Clause)
%YAML 1.2
---
$id: http://devicetree.org/schemas/sound/sifli,sf32lb52-pdm.yaml#
$schema: http://devicetree.org/meta-schemas/core.yaml#

title: SiFli SF32LB52 and SF32LB57 PDM interface

maintainers:
  - Gerard Marull-Paretas <gerard@teslabs.com>

description:
  Records one or two digital microphones, with a programmable gain, through
  a DMA channel.

allOf:
  - $ref: dai-common.yaml#

properties:
  compatible:
    enum:
      - sifli,sf32lb52-pdm
      - sifli,sf32lb57-pdm

  reg:
    maxItems: 1

  interrupts:
    maxItems: 1

  clocks:
    maxItems: 1

  resets:
    maxItems: 1

  dmas:
    maxItems: 1

  dma-names:
    const: rx

  "#sound-dai-cells":
    const: 0

required:
  - compatible
  - reg
  - interrupts
  - clocks
  - resets
  - "#sound-dai-cells"

unevaluatedProperties: false

examples:
  - |
    #include <dt-bindings/dma/sifli,sf32lb52-dmac.h>
    audio-controller@5009a000 {
        compatible = "sifli,sf32lb52-pdm";
        reg = <0x5009a000 0x1000>;
        interrupts = <82>;
        clocks = <&hpsys_rcc 21>;
        resets = <&hpsys_rcc 21>;
        dmas = <&dmac1 4 SF32LB52_DMAC1_REQ_PDM1_L SF32LB52_DMA_PRIO_LOW>;
        dma-names = "rx";
        #sound-dai-cells = <0>;
    };
```

## dts/bindings/spi/nordic,nrf54l15-spim.yaml
```yaml
# SPDX-License-Identifier: (GPL-2.0-only OR BSD-2-Clause)
%YAML 1.2
---
$id: http://devicetree.org/schemas/spi/nordic,nrf54l15-spim.yaml#
$schema: http://devicetree.org/meta-schemas/core.yaml#

title: Nordic nRF54L SPIM

maintainers:
  - Gerard Marull-Paretas <gerard@teslabs.com>

description:
  SPI controller with EasyDMA of the nRF54L series. Its pins are selected in
  its own registers, from sck-gpios, mosi-gpios, miso-gpios and cs-gpios.
  The prescaler divides its core clock by an even number. SPIM00 runs from
  the 128 MHz clock of the CPU domain up to 32 MHz; the others run from
  16 MHz up to 8 MHz, and share their registers, interrupt and address with
  the TWIM, UARTE and other serial functions of the same instance, each a
  sibling node of its own, of which only one may be enabled.

allOf:
  - $ref: /schemas/spi/spi-controller.yaml#

properties:
  compatible:
    const: nordic,nrf54l15-spim

  reg:
    maxItems: 1

  interrupts:
    maxItems: 1

  clock-frequency:
    description: Core clock the prescaler divides, in Hz.

  max-frequency:
    $ref: /schemas/types.yaml#/definitions/uint32
    description: Highest SCK frequency, in Hz.

  sck-gpios:
    maxItems: 1

  mosi-gpios:
    maxItems: 1

  miso-gpios:
    maxItems: 1

required:
  - compatible
  - reg
  - interrupts
  - clock-frequency
  - max-frequency
  - sck-gpios

unevaluatedProperties: false

examples:
  - |
    spi@5004a000 {
        compatible = "nordic,nrf54l15-spim";
        reg = <0x5004a000 0x1000>;
        interrupts = <74>;
        clock-frequency = <128000000>;
        max-frequency = <32000000>;
        sck-gpios = <&gpio2 1 0>;
        mosi-gpios = <&gpio2 2 0>;
        miso-gpios = <&gpio2 4 0>;
        cs-gpios = <&gpio2 5 1>;
        #address-cells = <1>;
        #size-cells = <0>;
    };
```

## dts/bindings/spi/sifli,sf32lb57-spi.yaml
```yaml
# SPDX-License-Identifier: (GPL-2.0-only OR BSD-2-Clause)
%YAML 1.2
---
$id: http://devicetree.org/schemas/spi/sifli,sf32lb57-spi.yaml#
$schema: http://devicetree.org/meta-schemas/core.yaml#

title: SiFli SF32LB57 SPI controller

maintainers:
  - Gerard Marull-Paretas <gerard@teslabs.com>

description:
  SPI controller of the SF32LB57, shifting frames most significant bit first.
  Chip selects are GPIOs, from cs-gpios.

allOf:
  - $ref: /schemas/spi/spi-controller.yaml#

properties:
  compatible:
    const: sifli,sf32lb57-spi

  reg:
    maxItems: 1

  interrupts:
    maxItems: 1

  clocks:
    maxItems: 1

  resets:
    maxItems: 1

  dmas:
    maxItems: 1

  dma-names:
    const: tx

  pinctrl-0: true

  pinctrl-names:
    const: default

required:
  - compatible
  - reg
  - interrupts
  - clocks

unevaluatedProperties: false

examples:
  - |
    spi@50095000 {
        compatible = "sifli,sf32lb57-spi";
        reg = <0x50095000 0x1000>;
        interrupts = <60>;
        clocks = <&hpsys_rcc 19>;
        dmas = <&gpdma1 1 28 0>;
        dma-names = "tx";
        cs-gpios = <&gpio1 3 0>;
        #address-cells = <1>;
        #size-cells = <0>;
    };
```
