## CMakeLists.txt
```
# SPDX-FileCopyrightText: 2026 Core Devices LLC
# SPDX-License-Identifier: Apache-2.0

cmake_minimum_required(VERSION 3.20)

find_package(PebbleOS REQUIRED HINTS $ENV{PEBBLEOS_BASE})
project(temp)

target_sources(app PRIVATE src/main.c)
```

## prj.conf
```kconfig
CONFIG_CONSOLE=y
CONFIG_CONSOLE_STDOUT=y
CONFIG_TEMP=y
```

## src/main.c
```c
/* SPDX-FileCopyrightText: 2026 Core Devices LLC */
/* SPDX-License-Identifier: Apache-2.0 */

#include <stdint.h>
#include <stdio.h>
#include <stdlib.h>

#include <pbl/drivers/sensor.h>
#include <pbl/kernel/delay.h>

#define READS 5

int main(void) {
  for (int i = 0; i < READS; i++) {
    int32_t millicelsius;
    int ret;

    /* DIE_TEMP is the board's die temperature sensor, whatever drives it. */
    ret = pbl_sensor_read(DIE_TEMP, PBL_SENSOR_TEMP, &millicelsius, nullptr);
    if (ret != 0) {
      fprintf(stderr, "temp: read failed (%d)\n", ret);
      return ret;
    }

    printf("temp: %s%d.%d C\n", millicelsius < 0 ? "-" : "", (int)(abs(millicelsius) / 1000),
           (int)(abs(millicelsius) % 1000 / 100));

    pbl_sleep_ms(1000);
  }

  printf("Sample done\n");

  return 0;
}
```
