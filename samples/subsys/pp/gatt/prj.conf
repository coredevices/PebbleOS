## CMakeLists.txt
```
# SPDX-FileCopyrightText: 2026 Core Devices LLC
# SPDX-License-Identifier: Apache-2.0

cmake_minimum_required(VERSION 3.20)

find_package(PebbleOS REQUIRED HINTS $ENV{PEBBLEOS_BASE})
project(pp_gatt)

target_sources(app PRIVATE src/main.c src/pp.c)
```

## prj.conf
```kconfig
CONFIG_CONSOLE=y
CONFIG_CONSOLE_STDOUT=y
CONFIG_NIMBLE=y
CONFIG_NIMBLE_STORE_CONFIG=y
CONFIG_NIMBLE_BLE_SM_SC=y
CONFIG_NIMBLE_BLE_SM_BONDING=y
CONFIG_NIMBLE_BLE_SM_OUR_KEY_DIST=3
CONFIG_NIMBLE_BLE_SM_THEIR_KEY_DIST=3
CONFIG_BT_ADV=y
CONFIG_PP=y
CONFIG_PP_TRANSPORT_GATT=y
```

## boards/qemu_emery.overlay
```dts
// SPDX-FileCopyrightText: 2026 Core Devices LLC
// SPDX-License-Identifier: Apache-2.0

&flash0 {
	partitions {
		compatible = "fixed-partitions";
		#address-cells = <1>;
		#size-cells = <1>;

		partition@0 {
			label = "filesystem";
			reg = <0x0 0x2000000>;
		};
	};
};
```

## src/main.c
```c
/* SPDX-FileCopyrightText: 2026 Core Devices LLC */
/* SPDX-License-Identifier: Apache-2.0 */

#include "sample.h"

#include <stdint.h>
#include <stdio.h>
#include <string.h>

#include <pbl/kernel/sem.h>
#include <pbl/kernel/types.h>
#include <pbl/util/size.h>

#include <host/ble_hs.h>
#include <host/util/util.h>
#include <nimble/nimble_port.h>
#include <nimble/nimble_port_pebble.h>
#include <services/gap/ble_svc_gap.h>
#include <services/gatt/ble_svc_gatt.h>

#define NAME "PebbleOS"

static PBL_SEM_DEFINE(s_synced, 0, 1);
static uint8_t s_own_addr_type;

static int prv_gap_event(struct ble_gap_event *event, void *arg);

static void prv_advertise(void) {
  const struct ble_hs_adv_fields fields = {
    .flags = BLE_HS_ADV_F_DISC_GEN | BLE_HS_ADV_F_BREDR_UNSUP,
  };
  const struct ble_hs_adv_fields rsp_fields = {
    .name = (const uint8_t *)NAME,
    .name_len = strlen(NAME),
    .name_is_complete = 1,
  };
  const struct ble_gap_adv_params params = {
    .conn_mode = BLE_GAP_CONN_MODE_UND,
    .disc_mode = BLE_GAP_DISC_MODE_GEN,
  };
  int rc;

  rc = ble_gap_adv_set_fields(&fields);
  if (rc == 0) {
    rc = ble_gap_adv_rsp_set_fields(&rsp_fields);
  }
  if (rc == 0) {
    rc = ble_gap_adv_start(s_own_addr_type, nullptr, BLE_HS_FOREVER, &params, prv_gap_event,
                           nullptr);
  }
  if (rc != 0) {
    printf("pp_gatt: advertising failed (%d)\n", rc);
    return;
  }

  printf("pp_gatt: advertising as %s\n", NAME);
}

/* Runs on the host thread. */
static int prv_gap_event(struct ble_gap_event *event, void *arg) {
  struct ble_gap_conn_desc desc;

  switch (event->type) {
    case BLE_GAP_EVENT_CONNECT:
      if (event->connect.status != 0) {
        prv_advertise();
        break;
      }
      printf("pp_gatt: connected\n");
      /* The session is only opened over an encrypted link. */
      (void)ble_gap_security_initiate(event->connect.conn_handle);
      break;
    case BLE_GAP_EVENT_DISCONNECT:
      printf("pp_gatt: disconnected, reason 0x%03x\n", event->disconnect.reason);
      sample_pp_stop();
      prv_advertise();
      break;
    case BLE_GAP_EVENT_ENC_CHANGE:
      if (event->enc_change.status != 0) {
        printf("pp_gatt: encryption failed (%d)\n", event->enc_change.status);
        break;
      }
      sample_pp_start(event->enc_change.conn_handle);
      break;
    case BLE_GAP_EVENT_REPEAT_PAIRING:
      /* A bonded peer that lost its keys: forget ours, and pair again. */
      if (ble_gap_conn_find(event->repeat_pairing.conn_handle, &desc) == 0) {
        (void)ble_store_util_delete_peer(&desc.peer_id_addr);
      }
      return BLE_GAP_REPEAT_PAIRING_RETRY;
    default:
      break;
  }

  return 0;
}

static void prv_on_sync(void) {
  pbl_sem_give(&s_synced);
}

int main(void) {
  int rc;

  sample_pp_init();

  nimble_port_init();
  ble_hs_cfg.sync_cb = prv_on_sync;
  ble_hs_cfg.store_status_cb = ble_store_util_status_rr;
  ble_store_config_init();

  ble_svc_gap_init();
  ble_svc_gatt_init();

  rc = ble_svc_gap_device_name_set(NAME);
  if (rc != 0) {
    printf("pp_gatt: setting the name failed (%d)\n", rc);
    return rc;
  }

  nimble_port_pebble_init();

  pbl_sem_take(&s_synced, PBL_FOREVER);

  rc = ble_hs_util_ensure_addr(0);
  if (rc == 0) {
    rc = ble_hs_id_infer_auto(0, &s_own_addr_type);
  }
  if (rc != 0) {
    printf("pp_gatt: no address (%d)\n", rc);
    return rc;
  }

  prv_advertise();

  return 0;
}
```

## src/pp.c
```c
/* SPDX-FileCopyrightText: 2026 Core Devices LLC */
/* SPDX-License-Identifier: Apache-2.0 */

#include "sample.h"

#include <stdio.h>

#include <pbl/kernel/assert.h>
#include <pbl/kernel/compiler.h>
#include <pbl/kernel/thread.h>
#include <pbl/kernel/work.h>
#include <pbl/pp/endpoint.h>
#include <pbl/pp/main.h>
#include <pbl/pp/protocol.h>
#include <pbl/pp/send.h>
#include <pbl/pp/session.h>
#include <pbl/pp/transports/gatt.h>
#include <pbl/util/byteorder.h>

#define MAIN_STACK_SIZE 4096
#define MAIN_CALLS      32

enum : uint8_t {
  CMD_PING = 0,
  CMD_PONG = 1,
};

struct PBL_PACKED ping_msg {
  uint8_t cmd;
  uint32_t cookie;
};

/* The main thread of the protocol: a work queue of the sample. */
static PBL_WORKQ_DEFINE(s_main_q);
static PBL_WORK_POOL_DEFINE(s_main_pool, MAIN_CALLS);
static struct pbl_thread s_main_thread;
PBL_THREAD_STACK_DEFINE(s_main_stack, MAIN_STACK_SIZE);

void pbl_pp_main_call(void (*fn)(void *data), void *data) {
  /* A call from the main thread itself does not wait for a slot, and none may be lost. */
  const int rc = pbl_work_call(&s_main_q, &s_main_pool, fn, data, PBL_FOREVER);

  PBL_ASSERTN(rc == 0);
}

bool pbl_pp_main_is_current(void) {
  return pbl_workq_is_current(&s_main_q);
}

/* No response times: the sample leaves the connection as the phone set it. */
static const struct pbl_pp_gatt_config s_gatt_config = {
  .serial_number = "SAMPLE000001",
};

static void prv_session_cb(struct pbl_pp_session *session, enum pbl_pp_session_event event,
                           void *user_data) {
  switch (event) {
    case PBL_PP_SESSION_OPENED:
      printf("pp_gatt: session opened\n");
      break;
    case PBL_PP_SESSION_CLOSED:
      printf("pp_gatt: session closed\n");
      break;
    case PBL_PP_SESSION_CAPABILITIES:
      printf("pp_gatt: capabilities 0x%08x\n",
             (unsigned int)pbl_pp_session_get_capabilities(session));
      break;
    case PBL_PP_SESSION_REMOTE_INFO:
      printf("pp_gatt: phone app runs on OS %u\n", pbl_pp_session_get_remote_os(session));
      break;
  }
}

PBL_PP_SESSION_LISTENER_DEFINE(sample, prv_session_cb, nullptr);

/* Runs on the system work queue, where sending may wait for room. */
static void prv_ping_handler(struct pbl_pp_session *session, const uint8_t *data, size_t length) {
  const struct ping_msg *ping = (const struct ping_msg *)data;
  struct ping_msg pong;
  int rc;

  if (length < sizeof(*ping) || ping->cmd != CMD_PING) {
    return;
  }

  printf("pp_gatt: ping %u\n", (unsigned int)pbl_be32_to_cpu(ping->cookie));

  pong = (struct ping_msg){.cmd = CMD_PONG, .cookie = ping->cookie};
  rc = pbl_pp_send(session, PBL_PP_ENDPOINT_PING, (const uint8_t *)&pong, sizeof(pong),
                   PBL_PP_DEFAULT_TIMEOUT_MS);
  if (rc != 0) {
    printf("pp_gatt: pong not sent (%d)\n", rc);
  }
}

PBL_PP_ENDPOINT_DEFINE(PBL_PP_ENDPOINT_PING, prv_ping_handler);

static void prv_start_cb(void *data) {
  pbl_pp_gatt_destroy();
  pbl_pp_gatt_create();
  pbl_pp_gatt_discover((uint16_t)(uintptr_t)data);
}

static void prv_stop_cb(void *data) {
  pbl_pp_gatt_destroy();
}

void sample_pp_init(void) {
  const struct pbl_thread_attr attr = {
    .name = "pp",
    .entry = pbl_workq_thread,
    .arg = &s_main_q,
    .prio = CONFIG_KERNEL_MAIN_THREAD_PRIO,
    .privileged = true,
    .stack = s_main_stack,
    .stack_size = sizeof(s_main_stack),
  };

  pbl_pp_gatt_configure(&s_gatt_config);
  pbl_thread_create(&s_main_thread, &attr);
}

void sample_pp_start(uint16_t conn_handle) {
  pbl_pp_main_call(prv_start_cb, (void *)(uintptr_t)conn_handle);
}

void sample_pp_stop(void) {
  pbl_pp_main_call(prv_stop_cb, nullptr);
}
```

## src/sample.h
```c
/* SPDX-FileCopyrightText: 2026 Core Devices LLC */
/* SPDX-License-Identifier: Apache-2.0 */

#pragma once

#include <stdint.h>

void sample_pp_init(void);
void sample_pp_start(uint16_t conn_handle);
void sample_pp_stop(void);
```
