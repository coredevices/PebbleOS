## CMakeLists.txt
```
# SPDX-FileCopyrightText: 2026 Core Devices LLC
# SPDX-License-Identifier: Apache-2.0

cmake_minimum_required(VERSION 3.20)

find_package(PebbleOS REQUIRED HINTS $ENV{PEBBLEOS_BASE})
project(logging_levels)

target_sources(app PRIVATE src/main.c src/sensor.c)
```

## Kconfig
```
# SPDX-FileCopyrightText: 2026 Core Devices LLC
# SPDX-License-Identifier: Apache-2.0

mainmenu "Logging sample"

source "Kconfig.pebbleos"

module = SAMPLE
module-str = Sample
source "subsys/logging/Kconfig.template.log_level"
```

## prj.conf
```kconfig
CONFIG_CONSOLE=y
CONFIG_CONSOLE_STDOUT=y
CONFIG_LOG=y
CONFIG_SAMPLE_LOG_LEVEL_DEBUG=y
CONFIG_SAMPLE_LOG_LEVEL_RUNTIME=y
CONFIG_KERNEL_MAIN_STACK_SIZE=2048
```

## src/main.c
```c
/* SPDX-FileCopyrightText: 2026 Core Devices LLC */
/* SPDX-License-Identifier: Apache-2.0 */

#include "sensor.h"

#include <stdint.h>
#include <stdio.h>

#include <pbl/logging/logging.h>

/* The sample's Kconfig defines CONFIG_SAMPLE_LOG_LEVEL from the log level template. */
PBL_LOG_MODULE_DEFINE(sample, CONFIG_SAMPLE_LOG_LEVEL);

static void prv_log_each_level(void) {
  PBL_LOG_ERR("an error");
  PBL_LOG_WRN("a warning");
  PBL_LOG_INFO("an event worth attention");
  PBL_LOG_DBG("a routine state change");
  PBL_LOG_VERBOSE("a detail");
}

int main(void) {
  uint8_t data[16];

  /* The module starts at its configured level, debug: verbose messages are dropped. */
  prv_log_each_level();

  if (sensor_read(data, sizeof(data)) == 0) {
    PBL_LOG_HEXDUMP_INFO(data, sizeof(data));
  }
  (void)sensor_read(data, 32U);

  /* Built with CONFIG_SAMPLE_LOG_LEVEL_RUNTIME, the level can change while running. */
  PBL_LOG_MODULE_LEVEL_SET(sample, LOG_LEVEL_WARNING);
  PBL_LOG_WRN("level now %d, warning", PBL_LOG_MODULE_LEVEL_GET(sample));
  prv_log_each_level();

  printf("Sample done\n");

  return 0;
}
```

## src/sensor.c
```c
/* SPDX-FileCopyrightText: 2026 Core Devices LLC */
/* SPDX-License-Identifier: Apache-2.0 */

#include "sensor.h"

#include <errno.h>

#include <pbl/logging/logging.h>

/* Another file of the same module: it shares its level. */
PBL_LOG_MODULE_DECLARE(sample, CONFIG_SAMPLE_LOG_LEVEL);

int sensor_read(uint8_t *buf, size_t len) {
  if (len > 16U) {
    PBL_LOG_WRN("read of %zu bytes, at most 16", len);
    return -EINVAL;
  }

  for (size_t i = 0; i < len; i++) {
    buf[i] = (uint8_t)(0xa0U + i);
  }
  PBL_LOG_DBG("read %zu bytes", len);

  return 0;
}
```

## src/sensor.h
```c
/* SPDX-FileCopyrightText: 2026 Core Devices LLC */
/* SPDX-License-Identifier: Apache-2.0 */

#pragma once

#include <stddef.h>
#include <stdint.h>

int sensor_read(uint8_t *buf, size_t len);
```
