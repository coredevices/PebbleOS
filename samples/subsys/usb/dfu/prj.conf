## CMakeLists.txt
```
# SPDX-FileCopyrightText: 2026 Core Devices LLC
# SPDX-License-Identifier: Apache-2.0

cmake_minimum_required(VERSION 3.20)

find_package(PebbleOS REQUIRED HINTS $ENV{PEBBLEOS_BASE})
project(usb_dfu)

target_sources(app PRIVATE src/main.c)
```

## prj.conf
```kconfig
CONFIG_CONSOLE=y
CONFIG_CONSOLE_STDOUT=y
CONFIG_FLASH=y
CONFIG_USB_DEVICE=y
CONFIG_USB_DFU=y
```

## boards/sf32lb57_dpi_hdk.overlay
```dts
// SPDX-FileCopyrightText: 2026 Core Devices LLC
// SPDX-License-Identifier: Apache-2.0

&sip_flash {
	partitions {
		partition@400000 {
			label = "dfu";
			reg = <0x400000 0x100000>;
		};
	};
};
```

## src/main.c
```c
/* SPDX-FileCopyrightText: 2026 Core Devices LLC */
/* SPDX-License-Identifier: Apache-2.0 */

#include <stdio.h>

#include <pbl/board/partitions.h>
#include <pbl/usb/dfu.h>
#include <pbl/usb/usbd.h>

/* The partition the host downloads to, from the board overlay of the sample. */
PBL_USB_DFU_REGION_DEFINE(image, PART_DFU);

int main(void) {
  int ret;

  ret = pbl_usbd_enable();
  if (ret != 0) {
    fprintf(stderr, "dfu: USB failed (%d)\n", ret);
    return ret;
  }

  /* The device now serves the host from the USB stack's thread and the system work queue. */
  printf("dfu: ready, partition of %d KiB at 0x%x\n", (int)(PART_DFU_SIZE / 1024U),
         (unsigned int)PART_DFU_OFFSET);

  return 0;
}
```
