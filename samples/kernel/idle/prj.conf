## CMakeLists.txt
```
# SPDX-FileCopyrightText: 2026 Core Devices LLC
# SPDX-License-Identifier: Apache-2.0

cmake_minimum_required(VERSION 3.20)

find_package(PebbleOS REQUIRED HINTS $ENV{PEBBLEOS_BASE})
project(idle)

target_sources(app PRIVATE src/main.c)
```

## prj.conf
```kconfig
CONFIG_CONSOLE=y
CONFIG_CPU_IDLE=y
CONFIG_LOG=y
```

## src/main.c
```c
/* SPDX-FileCopyrightText: 2026 Core Devices LLC */
/* SPDX-License-Identifier: Apache-2.0 */

#include <stddef.h>
#include <stdint.h>

#include <pbl/kernel/delay.h>
#include <pbl/kernel/idle.h>
#include <pbl/logging/logging.h>

#define SLEEP_MS 200

/* The shallowest idle state, which every SoC has. SoCs name theirs in pbl/soc. */
#define STATE 0

/* Time in every state: the CPU idles in the deepest one worth it, which depends on the SoC. */
static uint64_t prv_idle_us(void) {
  uint64_t us = 0U;

  for (size_t i = 0U; i < pbl_soc_num_idle_states; i++) {
    us += pbl_idle_residency_us((pbl_idle_state_id_t)i);
  }

  return us;
}

static uint64_t prv_idle_us_while_sleeping(void) {
  uint64_t before_us = prv_idle_us();

  pbl_sleep_ms(SLEEP_MS);

  return prv_idle_us() - before_us;
}

int main(void) {
  uint64_t idle_us;

  /* With nothing to run, the CPU idles until the sleep is over. */
  idle_us = prv_idle_us_while_sleeping();
  PBL_LOG_INFO("main: idled for most of a %d ms sleep: %s", SLEEP_MS,
               idle_us > SLEEP_MS * 1000 / 2 ? "yes" : "no");

  /* A driver blocks a state its peripheral does not work in, while it is busy. Blocking the
   * shallowest one keeps the CPU running. */
  pbl_idle_state_block(STATE);
  idle_us = prv_idle_us_while_sleeping();
  pbl_idle_state_release(STATE);
  PBL_LOG_INFO("main: idled for any of a %d ms sleep with the state blocked: %s", SLEEP_MS,
               idle_us > 0 ? "yes" : "no");

  PBL_LOG_INFO("Sample done");

  return 0;
}
```
