## CMakeLists.txt
```
# SPDX-FileCopyrightText: 2026 Core Devices LLC
# SPDX-License-Identifier: Apache-2.0

cmake_minimum_required(VERSION 3.20)

find_package(PebbleOS REQUIRED HINTS $ENV{PEBBLEOS_BASE})
project(lvgl_music)

target_sources(app PRIVATE src/main.c)
```

## prj.conf
```kconfig
CONFIG_CONSOLE=y
CONFIG_CONSOLE_STDOUT=y
CONFIG_DISPLAY=y
CONFIG_INPUT=y
CONFIG_LVGL=y
CONFIG_LV_USE_DEMO_MUSIC=y
CONFIG_LV_DEMO_MUSIC_AUTO_PLAY=y
CONFIG_LV_FONT_MONTSERRAT_12=y
CONFIG_LV_FONT_MONTSERRAT_16=y
CONFIG_LV_MEM_SIZE=131072
# The demo ends on its average frame rate
CONFIG_LV_USE_SYSMON=y
CONFIG_LV_USE_PERF_MONITOR=y
# LVGL runs on the thread that calls it, here the main one.
CONFIG_KERNEL_MAIN_STACK_SIZE=16384
```

## boards/sf32lb57_dpi_hdk.conf
```kconfig
# The AMOLED add-on has a touchscreen.
CONFIG_TOUCH=y
# The flash driver moves the boot flash to four-line reads: the artwork is read in place.
CONFIG_FLASH=y
# An RGB565 frame in the external RAM, which LVGL renders straight into.
CONFIG_RAM=y
CONFIG_DISPLAY_SF32LB57_LCDC_FORMAT_RGB565=y
# The accelerator of the SoC draws what it can.
CONFIG_GPU=y
# A second frame in the external RAM, rendered while the first is sent.
CONFIG_SCRATCH_HEAP_SHARED=n
```

## boards/stm32h747i_disco.conf
```kconfig
# The MB1166 module has a touchscreen.
CONFIG_TOUCH=y
# The frame is in the SDRAM.
CONFIG_RAM=y
# The panel refreshes at 60 Hz.
CONFIG_LV_DEF_REFR_PERIOD=16
# The DMA2D draws what it can.
CONFIG_GPU=y
```

## src/main.c
```c
/* SPDX-FileCopyrightText: 2026 Core Devices LLC */
/* SPDX-License-Identifier: Apache-2.0 */

#include <stdio.h>

#include <pbl/kernel/delay.h>

#include <demos/lv_demos.h>
#include <pbl_lvgl.h>

int main(void) {
  int ret;

  ret = pbl_lvgl_init();
  if (ret != 0) {
    fprintf(stderr, "lvgl: init failed (%d)\n", ret);
    return ret;
  }

  /* The demos come with LVGL, each enabled by its CONFIG_LV_USE_DEMO_* option. */
  lv_demo_music();

  printf("lvgl: music player on %dx%d\n",
         (int)lv_display_get_horizontal_resolution(pbl_lvgl_get_display()),
         (int)lv_display_get_vertical_resolution(pbl_lvgl_get_display()));

  while (true) {
    pbl_sleep_ms(lv_timer_handler());
  }
}
```
