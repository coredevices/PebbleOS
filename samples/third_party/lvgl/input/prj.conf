## CMakeLists.txt
```
# SPDX-FileCopyrightText: 2026 Core Devices LLC
# SPDX-License-Identifier: Apache-2.0

cmake_minimum_required(VERSION 3.20)

find_package(PebbleOS REQUIRED HINTS $ENV{PEBBLEOS_BASE})
project(lvgl_input)

target_sources(app PRIVATE src/main.c)
```

## prj.conf
```kconfig
CONFIG_CONSOLE=y
CONFIG_CONSOLE_STDOUT=y
CONFIG_DISPLAY=y
CONFIG_INPUT=y
CONFIG_LVGL=y
# LVGL runs on the thread that calls it, here the main one.
CONFIG_KERNEL_MAIN_STACK_SIZE=8192

# LVGL turns most of itself on by default: only what the sample uses is left on.
CONFIG_LV_BUILD_EXAMPLES=n
CONFIG_LV_BUILD_DEMOS=n
CONFIG_LV_USE_OBSERVER=n
CONFIG_LV_USE_THEME_DEFAULT=n
CONFIG_LV_USE_GRID=n
CONFIG_LV_WIDGETS_HAS_DEFAULT_VALUE=n
CONFIG_LV_USE_ANIMIMG=n
CONFIG_LV_USE_ARC=n
CONFIG_LV_USE_ARCLABEL=n
CONFIG_LV_USE_BAR=n
CONFIG_LV_USE_BUTTONMATRIX=n
CONFIG_LV_USE_CALENDAR=n
CONFIG_LV_USE_CANVAS=n
CONFIG_LV_USE_CHART=n
CONFIG_LV_USE_CHECKBOX=n
CONFIG_LV_USE_DROPDOWN=n
CONFIG_LV_USE_IMAGE=n
CONFIG_LV_USE_IMAGEBUTTON=n
CONFIG_LV_USE_KEYBOARD=n
CONFIG_LV_USE_LED=n
CONFIG_LV_USE_LINE=n
CONFIG_LV_USE_LIST=n
CONFIG_LV_USE_MENU=n
CONFIG_LV_USE_MSGBOX=n
CONFIG_LV_USE_ROLLER=n
CONFIG_LV_USE_SCALE=n
CONFIG_LV_USE_SLIDER=n
CONFIG_LV_USE_SPAN=n
CONFIG_LV_USE_SPINBOX=n
CONFIG_LV_USE_SPINNER=n
CONFIG_LV_USE_SWITCH=n
CONFIG_LV_USE_TEXTAREA=n
CONFIG_LV_USE_TABLE=n
CONFIG_LV_USE_TABVIEW=n
CONFIG_LV_USE_TILEVIEW=n
CONFIG_LV_USE_WIN=n

# The port renders in RGB565, or in 1 bit per pixel on a mono display: the software renderer
# needs no other format.
CONFIG_LV_DRAW_SW_SUPPORT_RGB565_SWAPPED=n
CONFIG_LV_DRAW_SW_SUPPORT_RGB565A8=n
CONFIG_LV_DRAW_SW_SUPPORT_RGB888=n
CONFIG_LV_DRAW_SW_SUPPORT_XRGB8888=n
CONFIG_LV_DRAW_SW_SUPPORT_ARGB8888=n
CONFIG_LV_DRAW_SW_SUPPORT_ARGB8888_PREMULTIPLIED=n
CONFIG_LV_DRAW_SW_SUPPORT_L8=n
CONFIG_LV_DRAW_SW_SUPPORT_AL88=n
CONFIG_LV_DRAW_SW_SUPPORT_A8=n
```

## boards/getafix.conf
```kconfig
# The board has a touchscreen, which becomes the pointer.
CONFIG_TOUCH=y
```

## boards/sf32lb57_dpi_hdk.conf
```kconfig
# The AMOLED add-on has a touchscreen, and its frame is in the external RAM.
CONFIG_TOUCH=y
CONFIG_RAM=y
```

## boards/stm32h747i_disco.conf
```kconfig
# The MB1166 module has a touchscreen.
CONFIG_TOUCH=y
# The frame is in the SDRAM.
CONFIG_RAM=y
# The panel refreshes at 60 Hz.
CONFIG_LV_DEF_REFR_PERIOD=16
```

## src/main.c
```c
/* SPDX-FileCopyrightText: 2026 Core Devices LLC */
/* SPDX-License-Identifier: Apache-2.0 */

#include <stdio.h>

#include <pbl/kernel/delay.h>
#include <pbl/kernel/time.h>

#include <pbl_lvgl.h>

#define LISTEN_S 30

static lv_obj_t *s_label;
static int s_count;
static int s_clicks;

/* Runs from lv_timer_handler(), on the thread that calls it. */
static void prv_clicked(lv_event_t *e) {
  s_count += (int)(intptr_t)lv_event_get_user_data(e);
  s_clicks++;

  lv_label_set_text_fmt(s_label, "%d", s_count);
  printf("lvgl: count %d\n", s_count);
}

static void prv_add_button(lv_obj_t *parent, const char *text, int step) {
  lv_obj_t *button = lv_button_create(parent);
  lv_obj_t *label = lv_label_create(button);

  lv_obj_set_size(button, 56, 44);
  lv_obj_add_event_cb(button, prv_clicked, LV_EVENT_CLICKED, (void *)(intptr_t)step);
  lv_label_set_text(label, text);
  lv_obj_center(label);
}

int main(void) {
  lv_obj_t *row;
  uint64_t end;
  int ret;

  ret = pbl_lvgl_init();
  if (ret != 0) {
    fprintf(stderr, "lvgl: init failed (%d)\n", ret);
    return ret;
  }

  printf("lvgl: keypad: %s, pointer: %s\n", pbl_lvgl_get_keypad() != nullptr ? "yes" : "no",
         pbl_lvgl_get_pointer() != nullptr ? "yes" : "no");

  s_label = lv_label_create(lv_screen_active());
  lv_label_set_text(s_label, "0");
  lv_obj_align(s_label, LV_ALIGN_CENTER, 0, -45);

  row = lv_obj_create(lv_screen_active());
  lv_obj_remove_style_all(row);
  lv_obj_set_size(row, LV_SIZE_CONTENT, LV_SIZE_CONTENT);
  lv_obj_set_flex_flow(row, LV_FLEX_FLOW_ROW);
  lv_obj_set_style_pad_column(row, 12, 0);
  /* Room for the outline a theme may draw around the focused button. */
  lv_obj_set_style_pad_all(row, 4, 0);
  lv_obj_align(row, LV_ALIGN_CENTER, 0, 20);

  /*
   * Widgets that take input join the default group as they are created: Up and Down move the
   * focus between them and Select clicks the focused one, as a touch does on any of them.
   */
  prv_add_button(row, LV_SYMBOL_MINUS, -1);
  prv_add_button(row, LV_SYMBOL_PLUS, 1);

  printf("lvgl: listening for %d s\n", LISTEN_S);

  end = pbl_uptime_ms() + LISTEN_S * 1000U;
  while (pbl_uptime_ms() < end) {
    pbl_sleep_ms(lv_timer_handler());
  }

  printf("lvgl: %d clicks\n", s_clicks);
  printf("Sample done\n");

  return 0;
}
```
