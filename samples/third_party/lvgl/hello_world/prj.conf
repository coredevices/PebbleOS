## CMakeLists.txt
```
# SPDX-FileCopyrightText: 2026 Core Devices LLC
# SPDX-License-Identifier: Apache-2.0

cmake_minimum_required(VERSION 3.20)

find_package(PebbleOS REQUIRED HINTS $ENV{PEBBLEOS_BASE})
project(lvgl_hello_world)

target_sources(app PRIVATE src/main.c)
```

## prj.conf
```kconfig
CONFIG_CONSOLE=y
CONFIG_CONSOLE_STDOUT=y
CONFIG_DISPLAY=y
CONFIG_LVGL=y
# LVGL runs on the thread that calls it, here the main one.
CONFIG_KERNEL_MAIN_STACK_SIZE=8192

# LVGL turns most of itself on by default: only what the sample uses is left on.
CONFIG_LV_BUILD_EXAMPLES=n
CONFIG_LV_BUILD_DEMOS=n
CONFIG_LV_USE_OBSERVER=n
CONFIG_LV_USE_THEME_DEFAULT=n
CONFIG_LV_USE_FLEX=n
CONFIG_LV_USE_GRID=n
CONFIG_LV_WIDGETS_HAS_DEFAULT_VALUE=n
CONFIG_LV_USE_ANIMIMG=n
CONFIG_LV_USE_ARCLABEL=n
CONFIG_LV_USE_BAR=n
CONFIG_LV_USE_BUTTON=n
CONFIG_LV_USE_BUTTONMATRIX=n
CONFIG_LV_USE_CALENDAR=n
CONFIG_LV_USE_CANVAS=n
CONFIG_LV_USE_CHART=n
CONFIG_LV_USE_CHECKBOX=n
CONFIG_LV_USE_DROPDOWN=n
CONFIG_LV_USE_IMAGE=n
CONFIG_LV_USE_IMAGEBUTTON=n
CONFIG_LV_USE_KEYBOARD=n
CONFIG_LV_USE_LED=n
CONFIG_LV_USE_LINE=n
CONFIG_LV_USE_LIST=n
CONFIG_LV_USE_MENU=n
CONFIG_LV_USE_MSGBOX=n
CONFIG_LV_USE_ROLLER=n
CONFIG_LV_USE_SCALE=n
CONFIG_LV_USE_SLIDER=n
CONFIG_LV_USE_SPAN=n
CONFIG_LV_USE_SPINBOX=n
CONFIG_LV_USE_SWITCH=n
CONFIG_LV_USE_TEXTAREA=n
CONFIG_LV_USE_TABLE=n
CONFIG_LV_USE_TABVIEW=n
CONFIG_LV_USE_TILEVIEW=n
CONFIG_LV_USE_WIN=n

# The port renders in RGB565, or in 1 bit per pixel on a mono display: the software renderer
# needs no other format.
CONFIG_LV_DRAW_SW_SUPPORT_RGB565_SWAPPED=n
CONFIG_LV_DRAW_SW_SUPPORT_RGB565A8=n
CONFIG_LV_DRAW_SW_SUPPORT_RGB888=n
CONFIG_LV_DRAW_SW_SUPPORT_XRGB8888=n
CONFIG_LV_DRAW_SW_SUPPORT_ARGB8888=n
CONFIG_LV_DRAW_SW_SUPPORT_ARGB8888_PREMULTIPLIED=n
CONFIG_LV_DRAW_SW_SUPPORT_L8=n
CONFIG_LV_DRAW_SW_SUPPORT_AL88=n
CONFIG_LV_DRAW_SW_SUPPORT_A8=n
```

## boards/sf32lb57_dpi_hdk.conf
```kconfig
# The frame of the AMOLED add-on is in the external RAM.
CONFIG_RAM=y
```

## src/main.c
```c
/* SPDX-FileCopyrightText: 2026 Core Devices LLC */
/* SPDX-License-Identifier: Apache-2.0 */

#include <stdio.h>

#include <pbl/kernel/delay.h>
#include <pbl/kernel/time.h>

#include <pbl_lvgl.h>

#define SHOW_MS 5000

int main(void) {
  lv_obj_t *label;
  lv_obj_t *spinner;
  uint64_t end;
  int ret;

  ret = pbl_lvgl_init();
  if (ret != 0) {
    fprintf(stderr, "lvgl: init failed (%d)\n", ret);
    return ret;
  }

  label = lv_label_create(lv_screen_active());
  lv_label_set_text(label, "Hello World!\n" CONFIG_BOARD);
  lv_obj_set_style_text_align(label, LV_TEXT_ALIGN_CENTER, 0);
  lv_obj_align(label, LV_ALIGN_CENTER, 0, -40);

  /* An animation, so that there is something to render on every pass. */
  spinner = lv_spinner_create(lv_screen_active());
  lv_obj_set_size(spinner, 60, 60);
  lv_obj_align(spinner, LV_ALIGN_CENTER, 0, 30);

  printf("lvgl: %d.%d.%d, showing for %d s\n", lv_version_major(), lv_version_minor(),
         lv_version_patch(), SHOW_MS / 1000);

  /* LVGL does its work in lv_timer_handler(), which says when it is next due. */
  end = pbl_uptime_ms() + SHOW_MS;
  while (pbl_uptime_ms() < end) {
    pbl_sleep_ms(lv_timer_handler());
  }

  printf("Sample done\n");

  return 0;
}
```
