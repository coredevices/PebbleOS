## CMakeLists.txt
```
# SPDX-FileCopyrightText: 2026 Core Devices LLC
# SPDX-License-Identifier: Apache-2.0

cmake_minimum_required(VERSION 3.20)

find_package(PebbleOS REQUIRED HINTS $ENV{PEBBLEOS_BASE})
project(lvgl_render)

target_sources(app PRIVATE src/main.c)
```

## prj.conf
```kconfig
CONFIG_CONSOLE=y
CONFIG_CONSOLE_STDOUT=y
CONFIG_DISPLAY=y
CONFIG_LVGL=y
CONFIG_LV_USE_DEMO_RENDER=y
CONFIG_LV_MEM_SIZE=131072
# LVGL runs on the thread that calls it, here the main one.
CONFIG_KERNEL_MAIN_STACK_SIZE=16384
```

## boards/sf32lb57_dpi_hdk.conf
```kconfig
# The flash driver moves the boot flash to four-line reads: the artwork is read in place.
CONFIG_FLASH=y
# An RGB565 frame in the external RAM, which LVGL renders straight into.
CONFIG_RAM=y
CONFIG_DISPLAY_SF32LB57_LCDC_FORMAT_RGB565=y
# The accelerator of the SoC draws what it can.
CONFIG_GPU=y
# A second frame in the external RAM, rendered while the first is sent.
CONFIG_SCRATCH_HEAP_SHARED=n
```

## src/main.c
```c
/* SPDX-FileCopyrightText: 2026 Core Devices LLC */
/* SPDX-License-Identifier: Apache-2.0 */

#include <stdint.h>
#include <stdio.h>

#include <pbl/kernel/delay.h>
#include <pbl/kernel/time.h>

#include <demos/lv_demos.h>
#include <pbl_lvgl.h>

#define SCENE_MS 1000
#define POLL_MS  50

int main(void) {
  int ret;

  ret = pbl_lvgl_init();
  if (ret != 0) {
    fprintf(stderr, "lvgl: init failed (%d)\n", ret);
    return ret;
  }

  printf("lvgl: render on %dx%d\n",
         (int)lv_display_get_horizontal_resolution(pbl_lvgl_get_display()),
         (int)lv_display_get_vertical_resolution(pbl_lvgl_get_display()));

  /*
   * The demos come with LVGL, each enabled by its CONFIG_LV_USE_DEMO_* option. This one draws
   * a scene per drawing primitive, laid out for a display of 480x272 or more.
   */
  for (int scene = 0; scene < LV_DEMO_RENDER_SCENE_NUM; scene++) {
    uint64_t end = pbl_uptime_ms() + SCENE_MS;

    lv_demo_render((lv_demo_render_scene_t)scene, LV_OPA_COVER);
    /* A scene that is drawn leaves LVGL nothing to do: it would wait forever. */
    while (pbl_uptime_ms() < end) {
      uint32_t next_ms = lv_timer_handler();

      pbl_sleep_ms(LV_MIN(next_ms, POLL_MS));
    }

    printf("lvgl: %s\n", lv_demo_render_get_scene_name((lv_demo_render_scene_t)scene));
  }

  printf("Sample done\n");

  return 0;
}
```
