## lib/Kconfig
```kconfig
# SPDX-FileCopyrightText: 2026 Core Devices LLC
# SPDX-License-Identifier: Apache-2.0

rsource "c/Kconfig"

menu "Libraries"

config BTUTIL
    bool "Bluetooth utilities"
    help
      Build the Bluetooth device address, UUID and security manager
      helpers.

config KRAEPELIN
    bool "Kraepelin"
    help
      Build the Kraepelin step and sleep tracking algorithm.

endmenu
```

## lib/fuel_gauge/Kconfig
```kconfig
# SPDX-FileCopyrightText: 2026 Core Devices LLC
# SPDX-License-Identifier: Apache-2.0

config FUEL_GAUGE
    bool
    help
      Battery state-of-charge estimation from voltage, current and
      temperature measurements.

if FUEL_GAUGE

choice FUEL_GAUGE_ESTIMATOR
    prompt "Estimator"
    default FUEL_GAUGE_THEVENIN

config FUEL_GAUGE_THEVENIN
    bool "Thevenin model"
    help
      Extended Kalman filter over the cell's series resistance and one
      RC polarization pair.

endchoice

if FUEL_GAUGE_THEVENIN

config FUEL_GAUGE_THEVENIN_RC_MILLIOHM
    int "RC pair resistance (mOhm)"
    default 0
    help
      Resistance at 25 C of the RC pair, as tools/fuel_gauge/fuel_gauge.py
      fit gives it. 0 leaves the pair out.

config FUEL_GAUGE_THEVENIN_RC_TAU_MS
    int "RC pair time constant (ms)"
    default 0
    help
      Time constant of the RC pair.

config FUEL_GAUGE_THEVENIN_R_TEMP_COEFF_PPM
    int "Resistance temperature coefficient (ppm/C)"
    range 0 80000
    default 30000
    help
      The resistances scale by exp(coefficient * (25 - T)), with T in C.

config FUEL_GAUGE_THEVENIN_VOLTAGE_NOISE_UV
    int "Voltage noise (uV)"
    default 15000
    help
      Standard deviation of the voltage measurement and cell model error.

config FUEL_GAUGE_THEVENIN_CURRENT_NOISE_UA
    int "Current noise (uA)"
    default 5000
    help
      Standard deviation of the error of a current sample as the average
      current over the time since the previous sample.

endif

endif
```

## pebble/apps/demo/voice_demo/Kconfig
```kconfig
# SPDX-FileCopyrightText: 2026 Core Devices LLC
# SPDX-License-Identifier: Apache-2.0

config DEMO_APP_VOICE_DEMO
    bool "Voice Demo"
    depends on SERVICE_VOICE
```

## pebble/apps/prf/Kconfig
```kconfig
# SPDX-FileCopyrightText: 2026 Core Devices LLC
# SPDX-License-Identifier: Apache-2.0

config MFG_SPEAKER_GAIN_MDB
    int "Factory speaker test gain (mdB)"
    depends on SPEAKER
    default -25000
    help
      Gain the factory speaker test plays its tone at, the level the test
      is qualified at on the board.

config MFG_HRM_CTR_LEAKAGE
    bool "Factory heart rate CTR and light leakage test"
    default y
    depends on MFG && PPG_GH3X2X && BOARD_OBELIX
    help
      The factory test of the optical stack: crosstalk (CTR) and light
      leakage, measured with raw samples of the GH3X2X front end.
```

## pebble/boards/asterix.conf
```kconfig
# Firmware settings for the asterix board.

CONFIG_GPIO=y
CONFIG_I2C=y
CONFIG_PWM=y
CONFIG_SPI=y
CONFIG_SPI_MEM=y

CONFIG_FLASH_SPI_NOR=y
CONFIG_MAG=y
CONFIG_MFD=y
CONFIG_OTP_FLASH=y
CONFIG_PMIC=y
CONFIG_SPEAKER=y

CONFIG_AMBIENT_LIGHT_OPT3001_ALWAYS_ON=y

CONFIG_ACCEL_LSM6DSO_WK_DUR_DEFAULT=1
CONFIG_ACCEL_LSM6DSO_WK_THS_MIN=1
CONFIG_ACCEL_LSM6DSO_WK_THS_MAX=40
CONFIG_ACCEL_LSM6DSO_WK_THS_DEFAULT=16
CONFIG_ACCEL_LSM6DSO_SCALE_MG=4000

CONFIG_MFG_SPEAKER_GAIN_MDB=0

CONFIG_ACCEL_SENSITIVITY=y
CONFIG_ORIENTATION_MANAGER=y

CONFIG_SERVICE_LIGHT_BACKLIGHT_ON_PERCENT=17
CONFIG_SERVICE_LIGHT_DARK_THRESHOLD=100
CONFIG_SERVICE_LIGHT_DARK_THRESHOLD_DELTA=30
CONFIG_SERVICE_BATTERY_CAPACITY_HOURS=450
```

## pebble/boards/getafix.conf
```kconfig
# Firmware settings for the getafix board.

CONFIG_WATCHDOG=y

CONFIG_MAG=y
CONFIG_PMIC=y
CONFIG_TOUCH=y

CONFIG_ACCEL_LIS2DW12_WK_DUR_DEFAULT=1
CONFIG_ACCEL_LIS2DW12_WK_THS_MIN=1
CONFIG_ACCEL_LIS2DW12_WK_THS_MAX=28
CONFIG_ACCEL_LIS2DW12_WK_THS_DEFAULT=14
CONFIG_ACCEL_LIS2DW12_SCALE_MG=4000

CONFIG_ALS_SCREEN_COMPENSATION=y
# Upper-right edge; black_scale ~25x from `als curve`.
CONFIG_ALS_SENSOR_X=200
CONFIG_ALS_SENSOR_Y=70
CONFIG_ALS_SENSOR_W=40
CONFIG_ALS_SENSOR_H=40
CONFIG_ALS_BLACK_SCALE_Q8=6400

CONFIG_BATTERY_WARNING_FIRST_PERCENT=12
CONFIG_BATTERY_WARNING_SECOND_PERCENT=8

CONFIG_DYNAMIC_BACKLIGHT=y
CONFIG_BACKLIGHT_STANDARD_INTENSITY=25
CONFIG_ACCEL_SENSITIVITY=y
CONFIG_APP_SCALING=y
CONFIG_ORIENTATION_MANAGER=y
CONFIG_MODDABLE_XS=y

CONFIG_SERVICE_LIGHT_BACKLIGHT_ON_PERCENT=25
CONFIG_SERVICE_LIGHT_DARK_THRESHOLD=800
CONFIG_SERVICE_LIGHT_DARK_THRESHOLD_DELTA=100
CONFIG_SERVICE_BATTERY_LOW_POWER_PERCENT=5
CONFIG_SERVICE_BATTERY_CAPACITY_HOURS=150
```

## pebble/boards/obelix.conf
```kconfig
# Firmware settings for the obelix board.

CONFIG_WATCHDOG=y

CONFIG_MAG=y
CONFIG_PMIC=y
CONFIG_SPEAKER=y
CONFIG_TOUCH=y

CONFIG_ACCEL_LSM6DSO_WK_DUR_DEFAULT=1
CONFIG_ACCEL_LSM6DSO_WK_THS_MIN=1
CONFIG_ACCEL_LSM6DSO_WK_THS_MAX=40
CONFIG_ACCEL_LSM6DSO_WK_THS_DEFAULT=16
CONFIG_ACCEL_LSM6DSO_SCALE_MG=4000

CONFIG_ALS_SCREEN_COMPENSATION=y
# Upper-left edge; black_scale ~12x from `als curve`.
CONFIG_ALS_SENSOR_X=0
CONFIG_ALS_SENSOR_Y=0
CONFIG_ALS_SENSOR_W=40
CONFIG_ALS_SENSOR_H=80
CONFIG_ALS_BLACK_SCALE_Q8=3072

CONFIG_DYNAMIC_BACKLIGHT=y
CONFIG_ACCEL_SENSITIVITY=y
CONFIG_APP_SCALING=y
CONFIG_ORIENTATION_MANAGER=y

CONFIG_SERVICE_LIGHT_BACKLIGHT_ON_PERCENT=45
CONFIG_SERVICE_LIGHT_DARK_THRESHOLD=800
CONFIG_SERVICE_LIGHT_DARK_THRESHOLD_DELTA=100
CONFIG_SERVICE_LIGHT_BACKLIGHT_DEFAULT_COLOR=0xFFBFA2
CONFIG_SERVICE_BATTERY_LOW_POWER_PERCENT=4
CONFIG_SERVICE_BATTERY_CAPACITY_HOURS=400

CONFIG_HRM=y
CONFIG_HRM_GH3X2X=y
CONFIG_HRM_HRV=y
```

## pebble/kernel/Kconfig
```kconfig
# SPDX-FileCopyrightText: 2026 Core Devices LLC
# SPDX-License-Identifier: Apache-2.0

config APP_THREAD_PRIO
    int "App thread priority"
    default 2

config WORKER_THREAD_PRIO
    int "Worker thread priority"
    default 1

config PROCESS_SYSCALL_STACK_SIZE
    int "App and worker syscall stack size in bytes"
    default 2048
    depends on USERSPACE
    help
      Privileged stack each process runs its syscalls on. Size it against
      the measured high-water, reported by analytics.

config KERNEL_VOLATILE_HEAP
    bool "Volatile kernel heap in external RAM"
    depends on PSRAM_RETENTION
    default y
    help
      A kernel heap in disposable external RAM, for large transient
      buffers (e.g. voice). Live allocations hold the external RAM
      retained. Without it, kernel_volatile_*() use the kernel heap.

config KERNEL_VOLATILE_HEAP_SIZE
    int "Volatile kernel heap size"
    depends on KERNEL_VOLATILE_HEAP
    default 65536
    range 4096 131072

config PSRAM_IMAGE_POOL
    bool "Image slot pool in external RAM"
    depends on PSRAM_RETENTION
    default y
    help
      Fixed-size slots in disposable external RAM for decoded images,
      for the image cache. Slots are only usable with a retention hold.

config PSRAM_IMAGE_SLOTS
    int "Number of image slots"
    depends on PSRAM_IMAGE_POOL
    default 32
    range 1 64
    help
      Each slot takes 44 KiB of external RAM.
```

## pebble/services/app_log_endpoint/Kconfig
```kconfig
# SPDX-FileCopyrightText: 2026 Core Devices LLC
# SPDX-License-Identifier: Apache-2.0

config SERVICE_APP_LOG_ENDPOINT
    bool "App log endpoint"
    help
      Log backend that forwards app log messages to the phone, when it
      asks for them.

if SERVICE_APP_LOG_ENDPOINT

module = SERVICE_APP_LOG_ENDPOINT
module-str = App log endpoint
source "subsys/logging/Kconfig.template.log_level"

endif
```

## pebble/services/app_session/Kconfig
```kconfig
# SPDX-FileCopyrightText: 2026 Core Devices LLC
# SPDX-License-Identifier: Apache-2.0

config SERVICE_APP_SESSION
    bool "App session"
    depends on PP
    help
      Selects the Pebble protocol session serving the running watch app,
      and caches the capabilities its phone counterpart announced.
```

## pebble/services/evented_timer/Kconfig
```kconfig
# SPDX-FileCopyrightText: 2026 Core Devices LLC
# SPDX-License-Identifier: Apache-2.0

config SERVICE_EVENTED_TIMER
    bool "Evented timer"
    help
      Event-loop timer service.

if SERVICE_EVENTED_TIMER

config SERVICE_EVENTED_TIMER_MAX_PER_PROCESS
    int "Maximum timers per app or worker"
    default 128
    help
      Number of timers an app or worker can have pending at once. Each one
      takes kernel heap, so this bounds what a process can allocate.

module = SERVICE_EVENTED_TIMER
module-str = Evented timer
source "subsys/logging/Kconfig.template.log_level"

endif
```

## pebble/services/hrm/Kconfig
```kconfig
# SPDX-FileCopyrightText: 2026 Core Devices LLC
# SPDX-License-Identifier: Apache-2.0

config HRM_BACKEND
    bool
    help
      An HRM algorithm backend is built (provides HRM_PPG_BACKEND).

config HRM_BACKEND_HRV
    bool
    help
      The HRM algorithm backend reports beat-to-beat intervals.

config HRM_BACKEND_QEMU
    bool "QEMU backend"
    default y if PPG_QEMU
    depends on PPG_QEMU
    select HRM_BACKEND
    help
      Measures the synthetic pulse of the QEMU front end, which follows
      the heart rate set by the QEMU host.

config SERVICE_HRM
    bool "Heart rate monitor"
    default y if HRM_BACKEND
    depends on PPG && HRM_BACKEND
    help
      Heart rate monitor manager service: runs the PPG front end, its
      gain control and an algorithm backend for subscribers.

if SERVICE_HRM

config HRM_HRV
    bool "HRV (RR interval) support"
    default y
    depends on HRM_BACKEND_HRV
    help
      Report heart-rate-variability (RR/inter-beat interval) data. HRV
      is only sampled while an app holds an HRV subscription, with the
      green path at a higher sample rate.

module = SERVICE_HRM
module-str = Heart rate monitor
source "subsys/logging/Kconfig.template.log_level"

endif
```

## pebble/services/language_pack/Kconfig
```kconfig
# SPDX-FileCopyrightText: 2026 Core Devices LLC
# SPDX-License-Identifier: Apache-2.0

config SERVICE_LANGUAGE_PACK
    bool "Language packs"
    depends on I18N
    help
      Manages the installed language packs and gives the translation
      catalog of the selected one to the internationalization runtime.

if SERVICE_LANGUAGE_PACK

module = SERVICE_LANGUAGE_PACK
module-str = Language packs
source "subsys/logging/Kconfig.template.log_level"

endif
```

## pebble/services/music/Kconfig
```kconfig
# SPDX-FileCopyrightText: 2026 Core Devices LLC
# SPDX-License-Identifier: Apache-2.0

config SERVICE_MUSIC
    bool "Music"
    help
      Music control service.

config MUSIC_ALBUM_ART_RECENTS
    int "Album art kept of recent tracks"
    depends on SERVICE_MUSIC
    default 0 if SCRATCH_HEAP_SHARED
    default 3
    help
      While the Music app is open, the album art of this many tracks
      before the current one is kept, so going back to one of them
      needs no transfer. Each takes up to 40 KiB of the scratch heap.

if SERVICE_MUSIC

module = SERVICE_MUSIC
module-str = Music
source "subsys/logging/Kconfig.template.log_level"

endif
```

## pebble/services/notifications/Kconfig
```kconfig
# SPDX-FileCopyrightText: 2026 Core Devices LLC
# SPDX-License-Identifier: Apache-2.0

config SERVICE_NOTIFICATIONS
    bool "Notifications"
    help
      Notifications, alerts and ANCS.

if SERVICE_NOTIFICATIONS

module = SERVICE_NOTIFICATIONS
module-str = Notifications
source "subsys/logging/Kconfig.template.log_level"

config NOTIFICATION_IMAGE_RECENTS
    int "Notification images kept of recent notifications"
    default 0 if SCRATCH_HEAP_SHARED
    default 3
    help
      While notifications are on screen, the images of this many of
      them other than the one shown are kept, so going back to one
      needs no transfer. Each takes up to 40 KiB of the scratch heap.

config SERVICE_ALERTS_LOG_LEVEL_RUNTIME
    default y if !RECOVERY_FW

module = SERVICE_ALERTS
module-str = Alert UI
source "subsys/logging/Kconfig.template.log_level"

endif
```

## pebble/services/stationary/Kconfig
```kconfig
# SPDX-FileCopyrightText: 2026 Core Devices LLC
# SPDX-License-Identifier: Apache-2.0

config SERVICE_STATIONARY
    bool "Stationary"
    help
      Stationary (idle-detection) service.

if SERVICE_STATIONARY

config SERVICE_STATIONARY_MODE
    bool
    default y
    depends on !QEMU && !SOC_POSIX && !SHELL_SDK
    help
      Enter stationary mode when the watch is left still. Only on watch
      hardware running the normal shell.

module = SERVICE_STATIONARY
module-str = Stationary
source "subsys/logging/Kconfig.template.log_level"

endif
```

## pebble/services/vibes/Kconfig
```kconfig
# SPDX-FileCopyrightText: 2026 Core Devices LLC
# SPDX-License-Identifier: Apache-2.0

config SERVICE_VIBES
    bool "Vibes"
    help
      Vibe scores / intensity service.

if SERVICE_VIBES

config SERVICE_VIBES_LOG_LEVEL_RUNTIME
    default y if !RECOVERY_FW

module = SERVICE_VIBES
module-str = Vibes
source "subsys/logging/Kconfig.template.log_level"

endif
```
