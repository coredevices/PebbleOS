## subsys/coredump/Kconfig
```kconfig
# SPDX-FileCopyrightText: 2026 Core Devices LLC
# SPDX-License-Identifier: Apache-2.0

menu "Core dumps"

config COREDUMP
    bool "Core dumps"
    depends on ARCH_HAS_COREDUMP
    help
      Save the state of the system when it crashes, for analysis after
      the reset.

if COREDUMP

config COREDUMP_TEST_FAULT
    bool
    help
      Let tests inject a fault while a dump is being written.

rsource "backends/Kconfig"

endif

endmenu
```

## subsys/coredump/backends/Kconfig
```kconfig
# SPDX-FileCopyrightText: 2026 Core Devices LLC
# SPDX-License-Identifier: Apache-2.0

config COREDUMP_BACKEND_FLASH
    bool "Flash backend"
    default y
    depends on FLASH
    help
      Keep dumps in flash until they are read back, in the core dump
      partition or, without one, in the firmware update slot.

config COREDUMP_BACKEND_FLASH_IMAGES
    int "Dumps to keep"
    default 2 if SOC_NRF52
    default 1
    range 1 32
    depends on COREDUMP_BACKEND_FLASH
    help
      The storage is divided evenly between this many dumps, the oldest
      being replaced.
```

## subsys/crc/Kconfig
```kconfig
# SPDX-FileCopyrightText: 2026 Core Devices LLC
# SPDX-License-Identifier: Apache-2.0

menuconfig CRC
    bool "CRC"
    help
      CRC-8 and CRC-32 computation (pbl/crc), in software or on a
      hardware CRC unit.

if CRC

config CRC_HW_ACCEL
    bool
    help
      Selected by drivers implementing pbl_crc_hw_crc32() and
      pbl_crc_hw_crc32_legacy() from pbl/drivers/crc.h.

config CRC_HW_MIN_LEN
    int "Minimum length to compute in hardware"
    depends on CRC_HW_ACCEL
    default 32
    help
      Buffers shorter than this are computed in software, where
      programming the CRC unit would cost more than it saves.

endif # CRC
```

## subsys/cron/Kconfig
```kconfig
# SPDX-FileCopyrightText: 2026 Core Devices LLC
# SPDX-License-Identifier: Apache-2.0

config CRON
    bool "Cron"
    help
      Wall-clock based job scheduler that handles DST and time zone
      changes.

if CRON

module = CRON
module-str = Cron
source "subsys/logging/Kconfig.template.log_level"

endif
```

## subsys/crypto/Kconfig
```kconfig
# SPDX-FileCopyrightText: 2026 Core Devices LLC
# SPDX-License-Identifier: Apache-2.0

menuconfig CRYPTO
    bool "Cryptography"
    select MBEDTLS
    help
      SHA-256 and AES (pbl/crypto), on mbedTLS or on a hardware
      accelerator.

if CRYPTO

config CRYPTO_SHA256_HW_ACCEL
    bool
    help
      Selected by drivers implementing pbl_crypto_hw_sha256_blocks()
      from pbl/drivers/crypto.h.

config CRYPTO_SHA256_HW_MIN_LEN
    int "Minimum length to hash in hardware"
    depends on CRYPTO_SHA256_HW_ACCEL
    default 64
    help
      Runs of whole blocks shorter than this are hashed in software,
      where programming the accelerator would cost more than it saves.

config CRYPTO_AES_HW_ACCEL
    bool
    help
      Selected by drivers implementing pbl_crypto_hw_aes_ecb_encrypt()
      and pbl_crypto_hw_aes_ecb_decrypt() from pbl/drivers/crypto.h.

config CRYPTO_AES_HW_MIN_LEN
    int "Minimum length to encrypt or decrypt in hardware"
    depends on CRYPTO_AES_HW_ACCEL
    default 32
    help
      Shorter runs of blocks are processed in software, where
      programming the accelerator would cost more than it saves.

config CRYPTO_SELFTEST
    bool "Check the accelerators before first use"
    depends on CRYPTO_SHA256_HW_ACCEL || CRYPTO_AES_HW_ACCEL
    help
      Run known-answer tests through the hardware hooks before the
      first hardware use of each algorithm, and keep that algorithm in
      software if they fail. Also adds the pbl_crypto_selftest() API
      and, with CONFIG_CRYPTO_SHELL, the "crypto selftest" command.

config CRYPTO_SHELL
    bool "Shell commands"
    default SUBSYS_SHELL
    depends on SHELL && (CRYPTO_SHA256_HW_ACCEL || CRYPTO_AES_HW_ACCEL)
    help
      The crypto command: run the self-test, check the accelerators
      against software and time both. Its buffers take about 12 KB of
      RAM.

if CRYPTO_SHA256_HW_ACCEL || CRYPTO_AES_HW_ACCEL

module = CRYPTO
module-str = Crypto
source "subsys/logging/Kconfig.template.log_level"

endif

endif # CRYPTO
```

## subsys/fs/Kconfig
```kconfig
# SPDX-FileCopyrightText: 2026 Core Devices LLC
# SPDX-License-Identifier: Apache-2.0

menuconfig FS
    bool "File system"
    select TASK_WDT
    help
      Access to files on mounted file systems, regardless of their
      format.

if FS

config FS_PFS
    bool "Pebble File System (PFS)"
    select CRC
    default y
    help
      PFS, the wear-leveled file system on the external NOR flash.

config FS_PFS_SHELL_LITTER
    bool "PFS litter shell command"
    depends on FS_PFS && SHELL
    help
      The pfs litter command, to fragment the file system for testing.

module = FS
module-str = File system
source "subsys/logging/Kconfig.template.log_level"

endif
```

## subsys/fuel_gauge/Kconfig
```kconfig
# SPDX-FileCopyrightText: 2026 Core Devices LLC
# SPDX-License-Identifier: Apache-2.0

config FUEL_GAUGE
    bool "Fuel gauge"
    help
      Battery state-of-charge estimator: an extended Kalman filter over an
      equivalent-circuit cell model, fed with voltage, current and
      temperature measurements.
```

## subsys/i18n/Kconfig
```kconfig
# SPDX-FileCopyrightText: 2026 Core Devices LLC
# SPDX-License-Identifier: Apache-2.0

config I18N
    bool "Internationalization"
    help
      Translates strings with a gettext message catalog. Without a
      catalog, the English source strings are used.

if I18N

module = I18N
module-str = Internationalization
source "subsys/logging/Kconfig.template.log_level"

endif
```

## subsys/input/Kconfig
```kconfig
# SPDX-FileCopyrightText: 2026 Core Devices LLC
# SPDX-License-Identifier: Apache-2.0

menuconfig INPUT
    bool "Input"
    help
      Input events from the button and touch drivers to their listeners.

if INPUT

config INPUT_SHELL
    bool "Shell commands"
    default y
    depends on SHELL
    help
      The input command: dump and report events.

module = INPUT
module-str = Input
source "subsys/logging/Kconfig.template.log_level"

endif
```

## subsys/loader/Kconfig
```kconfig
# SPDX-FileCopyrightText: 2026 Core Devices LLC
# SPDX-License-Identifier: Apache-2.0

config LOADER
    bool "Loader"
    help
      Loader for position-independent images with absolute
      relocations.

if LOADER

module = LOADER
module-str = Loader
source "subsys/logging/Kconfig.template.log_level"

endif
```

## subsys/logging/Kconfig
```kconfig
# SPDX-FileCopyrightText: 2026 Core Devices LLC
# SPDX-License-Identifier: Apache-2.0

menu "Logging"

config LOG
    bool "Logging"
    default y
    help
      Build the PBL_LOG macros. Disable to save space.

config LOG_HASHED
    bool "Hashed logs"
    default y
    depends on LOG && !QEMU
    help
      Replace log format strings with hashes to save space. Disable
      for human-readable logs.

choice
    prompt "Default log level"
    default DEFAULT_LOG_LEVEL_INFO

config DEFAULT_LOG_LEVEL_ERROR
    bool "Error"

config DEFAULT_LOG_LEVEL_WARNING
    bool "Warning"

config DEFAULT_LOG_LEVEL_INFO
    bool "Info"

config DEFAULT_LOG_LEVEL_DEBUG
    bool "Debug"

config DEFAULT_LOG_LEVEL_DEBUG_VERBOSE
    bool "Debug verbose"

endchoice

config DEFAULT_LOG_LEVEL
    int
    default 1 if DEFAULT_LOG_LEVEL_ERROR
    default 50 if DEFAULT_LOG_LEVEL_WARNING
    default 100 if DEFAULT_LOG_LEVEL_INFO
    default 200 if DEFAULT_LOG_LEVEL_DEBUG
    default 255 if DEFAULT_LOG_LEVEL_DEBUG_VERBOSE

config LOG_TASK_PREFIX
    bool "Task prefix"
    depends on LOG
    help
      Prefix log messages with the originating task identifier char
      (uppercase when logged from privileged mode).

config LOG_BOOT_BUFFER_SIZE
    int "Boot buffer size"
    default 512
    help
      Messages that a disabled backend would write are kept in a buffer
      of this many bytes, until it is full, and replayed to the backends
      started with pbl_log_backend_start(), e.g. the flash backend, so
      their log begins with the boot banner. 0 disables it.

rsource "backends/Kconfig"

endmenu
```

## subsys/logging/backends/Kconfig
```kconfig
# SPDX-FileCopyrightText: 2026 Core Devices LLC
# SPDX-License-Identifier: Apache-2.0

config LOG_BACKEND_PULSE
    bool "PULSE backend"
    default y
    depends on PULSE_EVERYWHERE
    help
      Write log messages over the PULSE protocol.

if LOG_BACKEND_PULSE

choice "LOG_BACKEND_PULSE_LEVEL_CHOICE"
    default LOG_BACKEND_PULSE_LEVEL_DEBUG
endchoice

backend = PULSE
backend-str = PULSE
source "subsys/logging/Kconfig.template.backend_level"

endif

config LOG_BACKEND_UART
    bool "UART backend"
    default y
    depends on !PULSE_EVERYWHERE
    help
      Write log messages as text lines to the serial console.

if LOG_BACKEND_UART

choice "LOG_BACKEND_UART_LEVEL_CHOICE"
    default LOG_BACKEND_UART_LEVEL_DEBUG
endchoice

backend = UART
backend-str = UART
source "subsys/logging/Kconfig.template.backend_level"

endif

config LOG_BACKEND_FLASH
    bool "Flash backend"
    default y
    help
      Store log messages in the debug flash region, one log generation
      per boot.

if LOG_BACKEND_FLASH

backend = FLASH
backend-str = Flash
source "subsys/logging/Kconfig.template.backend_level"

endif
```

## subsys/pp/Kconfig
```kconfig
# SPDX-FileCopyrightText: 2026 Core Devices LLC
# SPDX-License-Identifier: Apache-2.0

menuconfig PP
    bool "Pebble protocol"
    help
      Pebble protocol sessions with phone apps: endpoints, send queues
      and the transports that carry them.

if PP

module = PP
module-str = Pebble protocol
source "subsys/logging/Kconfig.template.log_level"

endif
```

## subsys/profiler/Kconfig
```kconfig
# SPDX-FileCopyrightText: 2026 Core Devices LLC
# SPDX-License-Identifier: Apache-2.0

menuconfig PROFILER
    bool "Profiler"
    help
      Cycle-counting profiler: named nodes accumulate the cycles spent
      between their start and stop calls.

if PROFILER

config PROFILER_SHELL
    bool "Shell commands"
    default y
    depends on SHELL
    help
      The profiler command: start, stop and log the stats.

module = PROFILER
module-str = Profiler
source "subsys/logging/Kconfig.template.log_level"

endif
```

## subsys/samsa/Kconfig
```kconfig
# SPDX-FileCopyrightText: 2026 Core Devices LLC
# SPDX-License-Identifier: Apache-2.0

config SAMSA
    bool "Run third-party apps with the Samsa Thumb-2 interpreter"
    depends on !CPU_CORTEX_M
    # The thunks are generated from the SDK built for apps.
    select REQUIRES_ARM_TOOLCHAIN
    select UZLIB
    help
      Interpret the ARM code of third-party apps and workers with Samsa,
      so a native build can install and run .pbw files.

if SAMSA

module = SAMSA
module-str = Samsa
source "subsys/logging/Kconfig.template.log_level"

endif
```

## subsys/settings/Kconfig
```kconfig
# SPDX-FileCopyrightText: 2026 Core Devices LLC
# SPDX-License-Identifier: Apache-2.0

config SETTINGS
    bool "Settings files"
    depends on FS
    select TASK_WDT
    help
      Atomic key-value store kept in a single file.

if SETTINGS

module = SETTINGS
module-str = Settings
source "subsys/logging/Kconfig.template.log_level"

endif
```

## subsys/shell/Kconfig
```kconfig
# SPDX-FileCopyrightText: 2026 Core Devices LLC
# SPDX-License-Identifier: Apache-2.0

menuconfig SHELL
    bool "Shell"
    default y
    help
      Command shell. Commands register themselves with
      PBL_SHELL_CMD_REGISTER() and run on KernelBG, one shell instance per
      backend.

if SHELL

config SHELL_CMD_BUFF_SIZE
    int "Command line buffer size"
    default 128
    help
      Longest command line, in bytes, a shell accepts.

config SHELL_ARGC_MAX
    int "Maximum number of arguments"
    default 12
    help
      Most words a command line may have, the command included.

config SHELL_PRINTF_BUFF_SIZE
    int "Print buffer size"
    default 128
    help
      Stack buffer each print is formatted into; longer output is truncated.

config SHELL_RX_BUFF_SIZE
    int "Receive buffer size"
    range 16 255
    default 64
    help
      Characters an interactive shell queues from its backend before they
      are processed.

endif # SHELL
```

## subsys/task_wdt/Kconfig
```kconfig
# SPDX-FileCopyrightText: 2026 Core Devices LLC
# SPDX-License-Identifier: Apache-2.0

menuconfig TASK_WDT
    bool "Task watchdog"
    default y if WATCHDOG
    help
      Software watchdog that catches stuck threads, and the one feeding
      the hardware watchdog: without it, a hardware watchdog the SoC has
      started resets the system.

if TASK_WDT

config TASK_WDT_CHANNELS
    int "Channels"
    range 1 8
    default 8
    help
      Threads the task watchdog can watch at once.

config TASK_WDT_TIMEOUT_MS
    int "System thread timeout in milliseconds"
    default 5000
    help
      Timeout the system threads (KernelMain, SysWorkq, SysWorkqHigh)
      register their channels with.

config TASK_WDT_CHECK_PERIOD_MS
    int "Check period in milliseconds"
    default 3000 if WATCHDOG && WATCHDOG_TIMEOUT_MS < 20000
    default 10000
    help
      How often the watchdog thread checks its channels and feeds the
      hardware watchdog, waking the system up to do so. Must stay below
      half of the hardware watchdog timeout.

config TASK_WDT_GRACE_MS
    int "Grace period in milliseconds"
    default 1000
    help
      How long a channel may stay expired after a check first finds it
      expired, with its callback running on every check, before the
      system resets with a core dump. While a channel is expired, the
      checks run at most this far apart.

config TASK_WDT_THREAD_PRIO
    int "Watchdog thread priority"
    default 4

config TASK_WDT_THREAD_STACK_SIZE
    int "Watchdog thread stack size in bytes"
    default 1536
    help
      The expiry path logs synchronously and runs the channel callbacks
      on this stack; the QEMU build uses about 700 bytes of it there.

module = TASK_WDT
module-str = Task watchdog
source "subsys/logging/Kconfig.template.log_level"

endif
```

## third_party/Kconfig
```kconfig
# SPDX-FileCopyrightText: 2026 Core Devices LLC
# SPDX-License-Identifier: Apache-2.0

menu "Third-party"

rsource "cmsis_core/Kconfig"
rsource "hal_nordic/Kconfig"
rsource "hal_sifli/Kconfig"
if BT
rsource "nimble/Kconfig"
endif

config MBEDTLS
    bool "mbedTLS"
    help
      Build the mbedTLS cryptography library.

config NANOPB
    bool "Nanopb"
    help
      Build the Nanopb Protocol Buffers library.

config QR_CODE_GENERATOR
    bool "QR Code generator"
    help
      Build the QR Code generator library.

config UPNG
    bool "uPNG"
    help
      Build the uPNG PNG decoder.

config SPEEX
    bool "Speex"
    help
      Build the Speex audio codec.

config TINYMT
    bool "TinyMT"
    help
      Build the TinyMT pseudo-random number generator.

config UZLIB
    bool "uzlib"
    help
      Build the uzlib deflate decompressor.

config CST816_FW
    bool
    help
      Hynitron CST816 touch controller firmware image for the board.

config HRM_BACKEND_GOODIX
    bool "Goodix heart rate algorithms"
    depends on PPG_GH3X2X && BOARD_OBELIX
    default y
    select HRM_BACKEND
    select HRM_BACKEND_HRV
    help
      Heart rate, SpO2, HRV and wear detection from the Goodix algorithm
      libraries, fed with samples of the GH3X2X front end.

endmenu
```

## third_party/cmsis_core/Kconfig
```kconfig
# SPDX-FileCopyrightText: 2026 Core Devices LLC
# SPDX-License-Identifier: Apache-2.0

config CMSIS_CORE
    bool
    help
      Provide the Arm CMSIS Cortex-M core headers, for vendor headers built
      on them.
```
