## third_party/hal_nordic/Kconfig
```kconfig
# SPDX-FileCopyrightText: 2026 Core Devices LLC
# SPDX-License-Identifier: Apache-2.0

menuconfig HAL_NORDIC
    bool "Nordic nrfx HAL"
    help
      Provide the Nordic MDK and nrfx HAL headers.

if HAL_NORDIC

config HAL_NORDIC_NRF52840
    bool
    default y if SOC_NRF52840
    help
      Configure the nrfx HAL headers for the Nordic nRF52840 SoC.

endif # HAL_NORDIC
```

## third_party/hal_sifli/Kconfig
```kconfig
# SPDX-FileCopyrightText: 2026 Core Devices LLC
# SPDX-License-Identifier: Apache-2.0

menuconfig HAL_SIFLI
    bool "SiFli SDK HAL"
    help
      Build the SiFli SDK HAL. This enables the HAL driver
      umbrella (USE_HAL_DRIVER), selects the high-performance CPU
      (SOC_BF0_HCPU), sets the HAL tick rate to 1024 Hz, and lets
      our NMI handler override SiFli's default. The HAL core
      (bf0_hal, HLP, PMU, RCC, system config) is always
      built; other modules are gated by the options below.

if HAL_SIFLI

config HAL_SIFLI_SF32LB52
    bool "SF32LB52 SoC variant"
    select HAL_SIFLI_AON
    help
      Configure the SiFli HAL for the SF32LB52 SoC. This sets the
      SF32LB52X target define and adds the SF32LB52-specific cmsis
      and local glue sources to the build. It also selects the HAL
      modules required by SoC-level PebbleOS code (sleep).

config HAL_SIFLI_AON
    bool "AON HAL module"
    help
      Enable the AON (always-on, HPSYS/LPSYS power and wakeup)
      SiFli HAL module driver.

endif # HAL_SIFLI
```

## third_party/nimble/Kconfig
```kconfig
# SPDX-FileCopyrightText: 2026 Core Devices LLC
# SPDX-License-Identifier: Apache-2.0

menu "NimBLE BLE stack"

choice
    prompt "SF32LB52 HCI trace"
    default NIMBLE_HCI_SF32LB52_TRACE_NONE
    depends on BT_HCI_SF32LB52
    help
      Trace mode for the SF32LB52 HCI transport.

config NIMBLE_HCI_SF32LB52_TRACE_NONE
    bool "Disabled"

config NIMBLE_HCI_SF32LB52_TRACE_BINARY
    bool "Binary"
    help
      Capture raw HCI traffic in a binary format suitable for offline
      decoding.

config NIMBLE_HCI_SF32LB52_TRACE_LOG
    bool "Log"
    help
      Emit human-readable HCI trace lines through the standard logger.

endchoice

choice "NIMBLE_LOG_LEVEL_CHOICE"
    default NIMBLE_LOG_LEVEL_OFF
endchoice

module = NIMBLE
module-str = NimBLE host
source "subsys/logging/Kconfig.template.log_level"

endmenu
```
