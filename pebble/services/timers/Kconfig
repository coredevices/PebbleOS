## pebble/services/timers/Kconfig
```kconfig
# SPDX-FileCopyrightText: 2026 Core Devices LLC
# SPDX-License-Identifier: Apache-2.0

config SERVICE_TIMERS
    bool "Timers"
    help
      Disposable countdown timers created by apps.

if SERVICE_TIMERS

module = SERVICE_TIMERS
module-str = Timers
source "subsys/logging/Kconfig.template.log_level"

endif
```

## platforms/Kconfig.flint
```kconfig
# SPDX-FileCopyrightText: 2026 Core Devices LLC
# SPDX-License-Identifier: Apache-2.0

if PLATFORM_FLINT

config PLATFORM_NAME
    default "flint"

config PLATFORM_DISPLAY_WIDTH
    default 144

config PLATFORM_DISPLAY_HEIGHT
    default 168

config PLATFORM_MICROPHONE
    default y

config PLATFORM_HEALTH
    default y

config PLATFORM_COMPASS
    default y

config PLATFORM_SPEAKER
    default y

endif # PLATFORM_FLINT
```

## platforms/Kconfig.gabbro
```kconfig
# SPDX-FileCopyrightText: 2026 Core Devices LLC
# SPDX-License-Identifier: Apache-2.0

if PLATFORM_GABBRO

config PLATFORM_NAME
    default "gabbro"

config PLATFORM_COLOR
    default y

config PLATFORM_ROUND
    default y

config PLATFORM_DISPLAY_WIDTH
    default 260

config PLATFORM_DISPLAY_HEIGHT
    default 260

config PLATFORM_MICROPHONE
    default y

config PLATFORM_HEALTH
    default y

config PLATFORM_COMPASS
    default y

config PLATFORM_TOUCH
    default y

config PLATFORM_MODDABLE_XS
    default y

config PLATFORM_MAX_APP_MEMORY_SIZE
    default 131072

config PLATFORM_MAX_FONT_GLYPH_SIZE
    default 512

config PLATFORM_ANIMATION_FRAME_INTERVAL_MS
    default 28

config PLATFORM_ANIMATION_RENDER_INTERVAL_MS
    default 48

endif # PLATFORM_GABBRO
```

## soc/Kconfig
```kconfig
# SPDX-FileCopyrightText: 2026 Core Devices LLC
# SPDX-License-Identifier: Apache-2.0

choice
    prompt "SoC"
    help
      SoC. Real boards pick their SoC line; QEMU boards pick the core of
      the Pebble QEMU machine.

rsource "*/Kconfig.soc"

endchoice

config SOC_HAS_IDLE_STATES
    bool
    help
      The SoC defines its idle states in pbl_soc_idle_states. Without
      it, the kernel provides a single state that waits for an
      interrupt.

config SOC_HAS_MPU_REGIONS
    bool
    help
      The SoC declares MPU regions in pbl_soc_mpu_regions.

config SOC_HAS_RESET
    bool
    help
      The SoC implements pbl_soc_reset(), which the kernel uses instead
      of the architecture's reset.

config SOC_HAS_POWER_OFF
    bool
    help
      The SoC implements pbl_soc_power_off(), which the kernel uses to
      power off when no power-off handler does.

config SOC
    string
    default "NRF52" if SOC_NRF52
    default "SF32LB52" if SOC_SF32LB52
    default "SF32LB57" if SOC_SF32LB57
    default "STM32H747" if SOC_STM32H747_M7 || SOC_STM32H747_M4
    help
      Stringified SoC name, for places that need the name as a token
      (e.g. sftool -c). Empty on QEMU and POSIX boards.

config QEMU
    bool
    help
      Derived alias for SOC_QEMU_PEBBLE. Gates features that don't make
      sense under emulation.

rsource "*/Kconfig"
```

## soc/native/Kconfig
```kconfig
# SPDX-FileCopyrightText: 2026 Core Devices LLC
# SPDX-License-Identifier: Apache-2.0

config SOC_FAMILY_NATIVE
    bool
    help
      Native SoCs, running the firmware as a host application, selected
      by the host.

rsource "*/Kconfig"
```

## soc/native/posix/Kconfig
```kconfig
# SPDX-FileCopyrightText: 2026 Core Devices LLC
# SPDX-License-Identifier: Apache-2.0

config POSIX_EMSCRIPTEN
    bool "Emscripten"
    depends on SOC_POSIX
    select ARCH_POSIX_FIBERS
    help
      The host is a browser, running the firmware as WebAssembly built
      with Emscripten. Kernel threads are fibers on the browser's single
      thread, and the browser's event loop drives the host side.

config POSIX_EMSCRIPTEN_FRAME
    string
    help
      The watch the Emscripten page draws around the display: a directory of
      soc/native/posix/emscripten/frames and an entry of the page's table of
      frames. Set per board in boards/<board>/Kconfig.defconfig.

config SDL
    bool
    depends on SOC_POSIX
    help
      SDL, for the host halves of the drivers of a native build that
      need a window or its input. Selected by those drivers.
```

## soc/native/posix/Kconfig.soc
```kconfig
# SPDX-FileCopyrightText: 2026 Core Devices LLC
# SPDX-License-Identifier: Apache-2.0

config SOC_POSIX
    bool "POSIX host"
    select SOC_FAMILY_NATIVE
    select ARCH_POSIX
    select SOC_HAS_RESET
    select TIMER_POSIX
    help
      Run the firmware as a native application on a POSIX host
      (Linux, macOS), with emulated peripherals.
```

## soc/nrf/Kconfig
```kconfig
# SPDX-FileCopyrightText: 2026 Core Devices LLC
# SPDX-License-Identifier: Apache-2.0

config SOC_FAMILY_NRF
    bool
    help
      Nordic nRF family, selected by its series.

rsource "*/Kconfig"
```

## soc/nrf/nrf52/Kconfig
```kconfig
# SPDX-FileCopyrightText: 2026 Core Devices LLC
# SPDX-License-Identifier: Apache-2.0

config SOC_NRF52
    bool
    select SOC_FAMILY_NRF
    select CPU_CORTEX_M4
    select CPU_HAS_FPU
    select CRC
    select FLASH_IDLE_PM if FLASH && CPU_IDLE
    select SOC_HAS_POWER_OFF
    select SOC_HAS_UNIQUE_ID
    select TIMER_NRF5_RTC
    help
      Nordic nRF52 series, selected by its lines.

if SOC_NRF52

config SOC_NRF52_RETAINED_RAM
    bool
    default $(dt_has_nodelabel,retained_ram)
    help
      The retained registers, in the RAM the retained_ram reserved memory
      region keeps across resets, when the application reserves it.

config SOC_NRF52_RETAINED_RAM_BASE
    hex
    depends on SOC_NRF52_RETAINED_RAM
    default $(dt_nodelabel_reg_addr,retained_ram)
    help
      Base of the RAM kept across resets, the retained_ram reserved memory
      region.

config SOC_NRF52_RETAINED_RAM_SIZE
    hex
    depends on SOC_NRF52_RETAINED_RAM
    default $(dt_nodelabel_reg_size,retained_ram)
    help
      Size of the RAM kept across resets.

config SOC_NRF52_RESET_PIN
    int
    default 21 if SOC_NRF52832
    default 18
    help
      P0 pin of the reset input, connected through UICR PSELRESET.

endif # SOC_NRF52
```

## soc/nrf/nrf54l/Kconfig
```kconfig
# SPDX-FileCopyrightText: 2026 Core Devices LLC
# SPDX-License-Identifier: Apache-2.0

config SOC_NRF54L
    bool
    select SOC_FAMILY_NRF
    select NVMEM if SOC_NRF54L_CPUAPP
    select TIMER_NRF_GRTC
    help
      Nordic nRF54L series, selected by its lines.

config SOC_NRF54L15
    bool
    select SOC_NRF54L
    help
      Nordic nRF54L15, selected by its cores.

config SOC_NRF54LM20A
    bool
    select SOC_NRF54L
    help
      Nordic nRF54LM20A, selected by its cores.

config SOC_NRF54L_CPUAPP
    bool
    select CPU_CORTEX_M33
    select CPU_HAS_FPU
    select SOC_HAS_POWER_OFF
    select SOC_HAS_UNIQUE_ID
    select REMOTEPROC if DT_HAS_NORDIC_NRF54L15_VPR_ENABLED
    help
      The secure application core of an nRF54L, which starts the FLPR
      when its tree enables it.

config SOC_NRF54L_CPUFLPR
    bool
    select CPU_NORDIC_VPR
    help
      The FLPR of an nRF54L, reaching the secure peripherals.
```

## soc/nrf/nrf54l/Kconfig.defconfig
```kconfig
# SPDX-FileCopyrightText: 2026 Core Devices LLC
# SPDX-License-Identifier: Apache-2.0

if SOC_NRF54L

config FLASH_BASE
    default 0x00000000

config FLASH_SIZE
    default $(dt_nodelabel_reg_size,internal_flash)

config NUM_IRQS
    default 270

endif # SOC_NRF54L
```

## soc/nrf/nrf54l/Kconfig.soc
```kconfig
# SPDX-FileCopyrightText: 2026 Core Devices LLC
# SPDX-License-Identifier: Apache-2.0

config SOC_NRF54L15_CPUAPP
    bool "Nordic nRF54L15, application core"
    select SOC_NRF54L15
    select SOC_NRF54L_CPUAPP
    help
      The secure Cortex-M33 of the nRF54L15, which sets up the supply and
      the clocks and starts the FLPR.

config SOC_NRF54L15_CPUFLPR
    bool "Nordic nRF54L15, FLPR"
    select SOC_NRF54L15
    select SOC_NRF54L_CPUFLPR
    help
      The fast lightweight peripheral processor of the nRF54L15, a VPR
      RISC-V core, which runs once the application core starts it, and
      leaves the supply and the clocks to it.

config SOC_NRF54LM20A_CPUAPP
    bool "Nordic nRF54LM20A, application core"
    select SOC_NRF54LM20A
    select SOC_NRF54L_CPUAPP
    help
      The secure Cortex-M33 of the nRF54LM20A.
```

## soc/qemu/Kconfig
```kconfig
# SPDX-FileCopyrightText: 2026 Core Devices LLC
# SPDX-License-Identifier: Apache-2.0

config SOC_FAMILY_QEMU
    bool
    help
      QEMU machines, selected by the machine.

rsource "*/Kconfig"
```

## soc/qemu/Kconfig.defconfig
```kconfig
# SPDX-FileCopyrightText: 2026 Core Devices LLC
# SPDX-License-Identifier: Apache-2.0

if SOC_QEMU_PEBBLE

choice NIMBLE_ID_ADDR_SOURCE
    default NIMBLE_ID_ADDR_QEMU
endchoice

# 4 MiB of emulated flash.
config FLASH_BASE
    default 0x00000000

config FLASH_SIZE
    default 0x400000

# The SRAM layout is the machine's, and so given by the board.

config NUM_IRQS
    default 13

config NUM_IRQ_PRIO_BITS
    default 3

endif # SOC_QEMU_PEBBLE
```

## soc/sf32lb/Kconfig
```kconfig
# SPDX-FileCopyrightText: 2026 Core Devices LLC
# SPDX-License-Identifier: Apache-2.0

config SOC_FAMILY_SF32LB
    bool
    help
      SiFli SF32LB family, selected by its series.

config SF32LB_FTAB
    bool "Boot ROM flash table"
    default y
    depends on SOC_FAMILY_SF32LB
    help
      Generate the flash table (FTAB) the boot ROM reads from the ptable
      partition, pointing it at the first image of the build: the
      bootloader the application boots with, or the application itself.
      It is flashed with that image.

rsource "*/Kconfig"
```

## soc/sf32lb/sf32lb52x/Kconfig.defconfig
```kconfig
# SPDX-FileCopyrightText: 2026 Core Devices LLC
# SPDX-License-Identifier: Apache-2.0

if SOC_SF32LB52

choice NIMBLE_HCI
    default NIMBLE_HCI_SF32LB
endchoice

choice NIMBLE_ID_ADDR_SOURCE
    default NIMBLE_ID_ADDR_SF32LB_EFUSE
endchoice

# 32 MiB of external flash, memory-mapped through MPI.
config FLASH_BASE
    default 0x12000000

config FLASH_SIZE
    default 0x2000000

config FIRMWARE_OFFSET
    default 4096 if PBLBOOT

config NUM_IRQS
    default 99

config KERNEL_MPU_REGIONS
    default 12

endif # SOC_SF32LB52
```

## soc/sf32lb/sf32lb57x/Kconfig
```kconfig
# SPDX-FileCopyrightText: 2026 Core Devices LLC
# SPDX-License-Identifier: Apache-2.0

config SOC_SF32LB57
    bool
    select SOC_FAMILY_SF32LB
    select CPU_STAR_MC1
    select CPU_HAS_FPU
    select CPU_HAS_ICACHE
    select CPU_HAS_DCACHE
    select ARCH_VECTOR_TABLE_RAM
    select KERNEL_MPU_IN_FAULTS
    select FLASH if CPU_IDLE
    select RAMFUNC
    select SOC_HAS_IDLE_STATES
    select SOC_HAS_MPU_REGIONS
    select SOC_HAS_POWER_OFF
    select PINCTRL
    select TIMER_SF32LB_LPTIM
    help
      SiFli SF32LB57 series, selected by its lines.
```

## soc/sf32lb/sf32lb57x/Kconfig.soc
```kconfig
# SPDX-FileCopyrightText: 2026 Core Devices LLC
# SPDX-License-Identifier: Apache-2.0

config SOC_SF32LB579
    bool "SiFli SF32LB579"
    select SOC_SF32LB57
```

## soc/st/Kconfig
```kconfig
# SPDX-FileCopyrightText: 2026 Core Devices LLC
# SPDX-License-Identifier: Apache-2.0

config SOC_FAMILY_STM32
    bool
    help
      ST STM32 family, selected by its series.

rsource "*/Kconfig"
```

## soc/st/Kconfig.soc
```kconfig
# SPDX-FileCopyrightText: 2026 Core Devices LLC
# SPDX-License-Identifier: Apache-2.0

config SOC_STM32H747
    bool "ST STM32H747"
    select SOC_STM32H7

choice SOC_STM32H747_CORE
    prompt "STM32H747 core"
    depends on SOC_STM32H747
    default SOC_STM32H747_M7

config SOC_STM32H747_M7
    bool "Cortex-M7"
    select SOC_STM32H7_CM7

config SOC_STM32H747_M4
    bool "Cortex-M4"
    select SOC_STM32H7_CM4

endchoice
```

## soc/st/stm32h7/Kconfig
```kconfig
# SPDX-FileCopyrightText: 2026 Core Devices LLC
# SPDX-License-Identifier: Apache-2.0

config SOC_STM32H7
    bool
    select SOC_FAMILY_STM32
    select CPU_HAS_FPU
    select CPU_HAS_FPU_DOUBLE if CPU_CORTEX_M7
    select CPU_HAS_ICACHE if CPU_CORTEX_M7
    select CPU_HAS_DCACHE if CPU_CORTEX_M7
    select PINCTRL
    select SOC_HAS_IDLE_STATES
    select SOC_HAS_POWER_OFF
    select RAMFUNC if CPU_CORTEX_M4
    select REMOTEPROC if DT_HAS_ST_STM32H747_M4_ENABLED && CPU_CORTEX_M7
    select TIMER_STM32_LPTIM
    help
      ST STM32H7 series, selected by its SoCs.

config SOC_STM32H7_CM4_SHUTDOWN
    bool "Power-off requests of the Cortex-M7"
    default y
    depends on CPU_CORTEX_M4 && DT_HAS_ST_STM32H747_M4_ENABLED
    select KERNEL_SYS_WORKQ
    select MBOX
    help
      Power this core off when the Cortex-M7 asks, before it powers the
      system off: Standby needs both cores stopped.
```
