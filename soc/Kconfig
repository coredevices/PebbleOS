## src/fw/drivers/flash/Kconfig
```kconfig
# SPDX-FileCopyrightText: 2026 Core Devices LLC
# SPDX-License-Identifier: Apache-2.0

menuconfig FLASH
    bool "Flash"
    help
      Flash Drivers

if FLASH

choice FLASH_NOR_PART
    prompt "NOR flash part"
    optional
    help
      The SPI NOR part the board is fitted with. Selects the command set
      used by the flash driver and the flash region layout.

config FLASH_GD25LQ255E
    bool "GigaDevice GD25LQ255E"

config FLASH_GD25Q256E
    bool "GigaDevice GD25Q256E"

endchoice

config FLASH_NRF5_QSPI
    bool "nRF5 QSPI NOR flash"
    depends on SOC_NRF52
    default y
    help
      SPI NOR flash attached to the nRF5 QSPI peripheral.

if FLASH_NRF5_QSPI

config FLASH_NRF5_QSPI_CLK_FREQ_HZ
    int "QSPI clock frequency (Hz)"
    default 8000000
    help
      Frequencies above 8 MHz are exposed to nRF52 anomaly 244.

config FLASH_NRF5_QSPI_SCK_PIN
    int "SCK pin"
    default 0

config FLASH_NRF5_QSPI_CSN_PIN
    int "CSN pin"
    default 0

config FLASH_NRF5_QSPI_IO0_PIN
    int "IO0 pin"
    default 0

config FLASH_NRF5_QSPI_IO1_PIN
    int "IO1 pin"
    default 0

config FLASH_NRF5_QSPI_IO2_PIN
    int "IO2 pin"
    default 0

config FLASH_NRF5_QSPI_IO3_PIN
    int "IO3 pin"
    default 0

choice FLASH_NRF5_QSPI_READ_MODE
    prompt "Read command"
    default FLASH_NRF5_QSPI_READ_READ4IO

config FLASH_NRF5_QSPI_READ_FASTREAD
    bool "Fast read (single line)"

config FLASH_NRF5_QSPI_READ_READ2O
    bool "Dual output"

config FLASH_NRF5_QSPI_READ_READ2IO
    bool "Dual I/O"

config FLASH_NRF5_QSPI_READ_READ4O
    bool "Quad output"

config FLASH_NRF5_QSPI_READ_READ4IO
    bool "Quad I/O"

endchoice

choice FLASH_NRF5_QSPI_WRITE_MODE
    prompt "Program command"
    default FLASH_NRF5_QSPI_WRITE_PP4O

config FLASH_NRF5_QSPI_WRITE_PP
    bool "Page program (single line)"

config FLASH_NRF5_QSPI_WRITE_PP2O
    bool "Dual output"

config FLASH_NRF5_QSPI_WRITE_PP4O
    bool "Quad output"

config FLASH_NRF5_QSPI_WRITE_PP4IO
    bool "Quad I/O"

endchoice

endif # FLASH_NRF5_QSPI

config FLASH_SF32LB52_MPI
    bool "SF32LB52 MPI NOR flash"
    depends on SOC_SF32LB52
    default y
    help
      SPI NOR flash attached to an SF32LB52 MPI controller.

if FLASH_SF32LB52_MPI

config FLASH_SF32LB52_MPI_INSTANCE
    int "MPI controller instance"
    range 1 2
    default 2

config FLASH_SF32LB52_MPI_MSIZE
    int "Memory window size (MB)"
    default 32

config FLASH_SF32LB52_MPI_CLK_DIV
    int "Clock divider"
    default 0

config FLASH_SF32LB52_MPI_DMA_CHANNEL
    int "DMAC1 channel"
    range 1 8
    default 2

config FLASH_SF32LB52_MPI_DMA_REQUEST
    int "DMA request"
    default 1

endif # FLASH_SF32LB52_MPI

config FLASH_QEMU
    bool "QEMU External Flash"
    depends on SOC_QEMU
    default y
    help
      Support for the QEMU external flash peripheral.

if FLASH_QEMU

config FLASH_QEMU_SIZE
    hex "Flash size"
    default 0x2000000

endif # FLASH_QEMU

module = DRIVER_FLASH
module-str = Flash
source "subsys/logging/Kconfig.template.log_level"

endif # FLASH
```

## src/fw/drivers/gpio/Kconfig
```kconfig
# SPDX-FileCopyrightText: 2026 Core Devices LLC
# SPDX-License-Identifier: Apache-2.0

menuconfig GPIO
    bool "GPIO"
    help
      GPIO Drivers

if GPIO

config GPIO_NRF5
    bool "Nordic nRF5"
    default y if SOC_NRF52
    select HAL_NORDIC
    help
      Support for the Nordic nRF5 GPIO controller.

config GPIO_SF32LB
    bool "SiFli SF32LB"
    default y if SOC_SF32LB52
    select HAL_SIFLI
    select HAL_SIFLI_GPIO
    help
      Support for the SiFli SF32LB GPIO controller.

config GPIO_QEMU
    bool "QEMU GPIO"
    default y if SOC_QEMU
    help
      Support for the QEMU GPIO peripheral.

endif # GPIO
```

## src/fw/drivers/i2c/Kconfig
```kconfig
# SPDX-FileCopyrightText: 2026 Core Devices LLC
# SPDX-License-Identifier: Apache-2.0

menuconfig I2C
    bool "I2C"
    help
      I2C Drivers

if I2C

config I2C_NRF5
    bool "Nordic nRF5 I2C Controller"
    default y if SOC_NRF52
    select HAL_NORDIC
    help
      Support for the Nordic nRF5 I2C controller.

config I2C_SF32LB
    bool "SiFli SF32LB I2C Controller"
    default y if SOC_SF32LB52
    select HAL_SIFLI
    select HAL_SIFLI_I2C
    help
      Support for the SiFli SF32LB I2C controller.

module = DRIVER_I2C
module-str = I2C
source "subsys/logging/Kconfig.template.log_level"

endif # I2C
```

## src/fw/drivers/mic/Kconfig
```kconfig
# SPDX-FileCopyrightText: 2026 Core Devices LLC
# SPDX-License-Identifier: Apache-2.0

menuconfig MIC
    bool "Microphone"
    help
      Microphone Drivers

if MIC

config MIC_NRF5
    bool "Nordic nRF5 PDM"
    default y if SOC_NRF52
    select HAL_NORDIC
    help
      Support for the Nordic nRF5 PDM microphone interface.

config MIC_SF32LB
    bool "SiFli SF32LB PDM"
    default y if SOC_SF32LB52
    select HAL_SIFLI
    select HAL_SIFLI_AUDCODEC
    select HAL_SIFLI_PDM
    help
      Support for the SiFli SF32LB PDM microphone interface.

config MIC_QEMU
    bool "QEMU stub"
    default y if SOC_QEMU
    help
      Software-only microphone stub for QEMU. Delivers silence at
      MIC_SAMPLE_RATE so the voice service can run end-to-end against
      `pebble transcribe`, which ignores audio frames and replies with
      a canned transcription on a timer.

module = DRIVER_MIC
module-str = Microphone
source "subsys/logging/Kconfig.template.log_level"

endif # MIC
```

## src/fw/drivers/pwm/Kconfig
```kconfig
# SPDX-FileCopyrightText: 2026 Core Devices LLC
# SPDX-License-Identifier: Apache-2.0

menuconfig PWM
    bool "PWM"
    help
      PWM Drivers

if PWM

config PWM_NRF5
    bool "Nordic nRF5"
    default y if SOC_NRF52
    select HAL_NORDIC
    help
      Support for the Nordic nRF5 PWM controller.

config PWM_SF32LB
    bool "SiFli SF32LB"
    default y if SOC_SF32LB52
    select HAL_SIFLI
    select HAL_SIFLI_GPT
    help
      Support for the SiFli SF32LB PWM controller.

config PWM_QEMU
    bool "QEMU PWM"
    default y if SOC_QEMU
    help
      Support for the QEMU PWM peripheral.

endif # PWM
```

## src/fw/drivers/rng/Kconfig
```kconfig
# SPDX-FileCopyrightText: 2026 Core Devices LLC
# SPDX-License-Identifier: Apache-2.0

menuconfig RNG
    bool "Random Number Generator"
    help
      RNG Drivers

if RNG

config RNG_SF32LB
    bool "SiFli SF32LB"
    default y if SOC_SF32LB52
    select HAL_SIFLI
    select HAL_SIFLI_RNG
    help
      Support for the SiFli SF32LB RNG.

config RNG_STUB
    bool "Stub"
    help
      Stub RNG implementation.

module = DRIVER_RNG
module-str = Random Number Generator
source "subsys/logging/Kconfig.template.log_level"

endif # RNG
```

## src/fw/drivers/rtc/Kconfig
```kconfig
# SPDX-FileCopyrightText: 2026 Core Devices LLC
# SPDX-License-Identifier: Apache-2.0

menuconfig RTC
    bool "RTC"
    help
      RTC Drivers

if RTC

config RTC_NRF5
    bool "Nordic nRF5"
    default y if SOC_NRF52
    select HAL_NORDIC
    help
      Support for the Nordic nRF5 RTC.

config RTC_SF32LB
    bool "SiFli SF32LB"
    default y if SOC_SF32LB52
    select HAL_SIFLI
    select HAL_SIFLI_LRC_CAL
    select HAL_SIFLI_RTC
    help
      Support for the SiFli SF32LB RTC.

config RTC_QEMU
    bool "QEMU RTC"
    default y if SOC_QEMU
    help
      Support for the QEMU RTC peripheral.

module = DRIVER_RTC
module-str = RTC
source "subsys/logging/Kconfig.template.log_level"

endif # RTC
```

## src/fw/drivers/speaker/Kconfig
```kconfig
# SPDX-FileCopyrightText: 2026 Core Devices LLC
# SPDX-License-Identifier: Apache-2.0

menuconfig SPEAKER
    bool "Speaker"
    help
      Speaker (audio output) Drivers

if SPEAKER

config SPEAKER_DA7212
    bool "Dialog DA7212 codec (nRF5 I2S)"
    select HAL_NORDIC
    help
      Support for the Dialog DA7212 audio codec driven over nRF5 I2S.

config SPEAKER_SF32LB
    bool "SiFli SF32LB AUDEC"
    default y if SOC_SF32LB52
    select HAL_SIFLI
    select HAL_SIFLI_AUDCODEC
    help
      Support for the SiFli SF32LB audio codec / DAC speaker output.

config SPEAKER_QEMU
    bool "QEMU audio"
    default y if SOC_QEMU
    help
      QEMU audio device backing the speaker for emulated builds.

module = DRIVER_SPEAKER
module-str = Speaker
source "subsys/logging/Kconfig.template.log_level"

endif # SPEAKER
```

## src/fw/drivers/temperature/Kconfig
```kconfig
# SPDX-FileCopyrightText: 2026 Core Devices LLC
# SPDX-License-Identifier: Apache-2.0

menuconfig TEMPERATURE
    bool "Temperature Sensor"
    help
      Temperature Sensor Drivers

if TEMPERATURE

config TEMPERATURE_SF32LB
    bool "SiFli SF32LB"
    default y if SOC_SF32LB52
    select HAL_SIFLI
    help
      Support for the SiFli SF32LB temperature sensor.

config TEMPERATURE_STUB
    bool "Stub"
    help
      Stub temperature sensor implementation.

endif # TEMPERATURE
```

## src/fw/drivers/touch/Kconfig
```kconfig
# SPDX-FileCopyrightText: 2026 Core Devices LLC
# SPDX-License-Identifier: Apache-2.0

menuconfig TOUCH
    bool "Touchscreen"
    help
      Touchscreen Drivers

if TOUCH

config TOUCH_CST816
    bool "Hynitron CST816"
    select CST816_FW
    help
      Support for the Hynitron CST816 touch controller.

config TOUCH_QEMU
    bool "QEMU Touchscreen"
    default y if SOC_QEMU
    help
      Support for the QEMU touchscreen peripheral.

module = DRIVER_TOUCH
module-str = Touchscreen
source "subsys/logging/Kconfig.template.log_level"

endif # TOUCH
```
