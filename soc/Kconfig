## soc/Kconfig
```kconfig
# SPDX-FileCopyrightText: 2026 Core Devices LLC
# SPDX-License-Identifier: Apache-2.0

choice
    prompt "SoC"
    help
      SoC. Real boards pick their SoC line; QEMU boards pick the core of
      the Pebble QEMU machine.

rsource "nrf/Kconfig.soc"
rsource "sf32lb/Kconfig.soc"
rsource "qemu/Kconfig.soc"

config SOC_POSIX
    bool "POSIX host"
    select ARCH_POSIX
    select SOC_HAS_RESET
    select TIMER_POSIX
    help
      Run the firmware as a native application on a POSIX host
      (Linux, macOS), with emulated peripherals.

endchoice

config SOC_HAS_MPU_REGIONS
    bool
    help
      The SoC declares MPU regions in pbl_soc_mpu_regions.

config SOC_HAS_RESET
    bool
    help
      The SoC implements pbl_soc_reset(), which the kernel uses instead
      of the architecture's reset.

config SOC
    string
    default "NRF52" if SOC_NRF52
    default "SF32LB52" if SOC_SF32LB52
    default "SF32LB57" if SOC_SF32LB57
    help
      Stringified SoC name, for places that need the name as a token
      (e.g. sftool -c). Empty on QEMU and POSIX boards.

config POSIX_EMSCRIPTEN
    bool "Emscripten"
    depends on SOC_POSIX
    select ARCH_POSIX_FIBERS
    help
      The host is a browser, running the firmware as WebAssembly built
      with Emscripten. Kernel threads are fibers on the browser's single
      thread, and the browser's event loop drives the host side.

config SDL
    bool
    depends on SOC_POSIX
    help
      SDL, for the host halves of the drivers of a native build that
      need a window or its input. Selected by those drivers.

config QEMU
    bool
    help
      Derived alias for SOC_QEMU_PEBBLE. Gates features that don't make
      sense under emulation.

rsource "nrf/Kconfig"
rsource "qemu/Kconfig"
rsource "sf32lb/Kconfig"
```

## soc/nrf/Kconfig
```kconfig
# SPDX-FileCopyrightText: 2026 Core Devices LLC
# SPDX-License-Identifier: Apache-2.0

config SOC_NRF52
    bool
    select HAL_NORDIC
    select CPU_CORTEX_M4
    select CPU_HAS_FPU
    select TIMER_NRF5_RTC
    help
      Nordic nRF52 series, selected by its lines.
```

## soc/nrf/Kconfig.soc
```kconfig
# SPDX-FileCopyrightText: 2026 Core Devices LLC
# SPDX-License-Identifier: Apache-2.0

config SOC_NRF52840
    bool "Nordic nRF52840"
    select SOC_NRF52
```

## soc/qemu/Kconfig
```kconfig
# SPDX-FileCopyrightText: 2026 Core Devices LLC
# SPDX-License-Identifier: Apache-2.0

config SOC_QEMU_PEBBLE
    bool
    select QEMU
    select TIMER_ARM_SYSTICK
    select TIMER_QEMU
    help
      Pebble QEMU machine, a custom machine emulating Pebble hardware,
      selected by its cores.
```

## soc/qemu/Kconfig.soc
```kconfig
# SPDX-FileCopyrightText: 2026 Core Devices LLC
# SPDX-License-Identifier: Apache-2.0

config SOC_QEMU_PEBBLE_CORTEX_M4
    bool "Pebble QEMU machine, Cortex-M4"
    select SOC_QEMU_PEBBLE
    select CPU_CORTEX_M4

config SOC_QEMU_PEBBLE_CORTEX_M33
    bool "Pebble QEMU machine, Cortex-M33"
    select SOC_QEMU_PEBBLE
    select CPU_CORTEX_M33
```

## soc/sf32lb/Kconfig
```kconfig
# SPDX-FileCopyrightText: 2026 Core Devices LLC
# SPDX-License-Identifier: Apache-2.0

config SOC_FAMILY_SF32LB
    bool
    help
      SiFli SF32LB family, selected by its series.

config SOC_SF32LB52
    bool
    select SOC_FAMILY_SF32LB
    select CPU_STAR_MC1
    select CPU_HAS_FPU
    select CPU_HAS_ICACHE
    select CPU_HAS_DCACHE
    select ARCH_VECTOR_TABLE_RAM
    select KERNEL_MPU_IN_FAULTS
    select RAMFUNC
    select SOC_HAS_MPU_REGIONS
    select SOC_HAS_RESET
    select NVMEM
    select PINCTRL
    select TIMER_SF32LB_LPTIM
    help
      SiFli SF32LB52 series, selected by its lines.

config SOC_SF32LB57
    bool
    select SOC_FAMILY_SF32LB
    select CPU_STAR_MC1
    select CPU_HAS_FPU
    select CPU_HAS_ICACHE
    select CPU_HAS_DCACHE
    select ARCH_VECTOR_TABLE_RAM
    select KERNEL_MPU_IN_FAULTS
    select RAMFUNC
    select SOC_HAS_MPU_REGIONS
    select PINCTRL
    select TIMER_SF32LB_LPTIM
    help
      SiFli SF32LB57 series, selected by its lines.

config SF32LB_FTAB
    bool "Boot ROM flash table"
    default y
    depends on SOC_FAMILY_SF32LB && !PBLBOOT
    help
      Generate the flash table (FTAB) the boot ROM reads from the ptable
      partition, pointing it at the firmware image, and flash it along with
      the firmware. Builds for PBLBOOT leave the table to the bootloader.
```

## soc/sf32lb/Kconfig.soc
```kconfig
# SPDX-FileCopyrightText: 2026 Core Devices LLC
# SPDX-License-Identifier: Apache-2.0

config SOC_SF32LB520
    bool "SiFli SF32LB520"
    select SOC_SF32LB52

config SOC_SF32LB523
    bool "SiFli SF32LB523"
    select SOC_SF32LB52

config SOC_SF32LB525
    bool "SiFli SF32LB525"
    select SOC_SF32LB52

config SOC_SF32LB527
    bool "SiFli SF32LB527"
    select SOC_SF32LB52

config SOC_SF32LB52B
    bool "SiFli SF32LB52B"
    select SOC_SF32LB52

config SOC_SF32LB52D
    bool "SiFli SF32LB52D"
    select SOC_SF32LB52

config SOC_SF32LB52E
    bool "SiFli SF32LB52E"
    select SOC_SF32LB52

config SOC_SF32LB52G
    bool "SiFli SF32LB52G"
    select SOC_SF32LB52

config SOC_SF32LB52J
    bool "SiFli SF32LB52J"
    select SOC_SF32LB52
```

## src/bluetooth-fw/Kconfig
```kconfig
# SPDX-FileCopyrightText: 2026 Core Devices LLC
# SPDX-License-Identifier: Apache-2.0

menu "Bluetooth"

choice BT_FW
    prompt "Bluetooth backend"
    default BT_FW_STUB
    help
      Which Bluetooth backend implementation to build. The default is
      derived from the SoC (see each soc/<soc>/Kconfig.defconfig);
      the stub is the fallback when no SoC default applies.

config BT_FW_NIMBLE
    bool "NimBLE"
    select HAL_SIFLI_IPC_QUEUE if SOC_SF32LB52
    select HAL_SIFLI_LCPU if SOC_SF32LB52

config BT_FW_QEMU
    bool "QEMU transport"

config BT_FW_STUB
    bool "Stub (no backend)"

endchoice

module = BT
module-str = Bluetooth
source "subsys/logging/Kconfig.template.log_level"

config GH3X2X_TUNING_SERVICE_ENABLED
    bool "GH3X2X tuning service"
    depends on HRM_GH3X2X
    help
      Build the GH3X2X heart-rate sensor tuning GATT service, used to
      tune the sensor over BLE. Off by default.

config BLE_HRM_SERVICE
    bool "BLE Heart Rate Monitor service"
    depends on BT_FW_NIMBLE && HRM
    default y if BT_FW_NIMBLE && HRM && !RECOVERY_FW
    help
      Expose the GATT Heart Rate Service (0x180D) over BLE so fitness
      apps like Strava can subscribe to heart-rate measurements. Requires
      an HRM sensor driver (CONFIG_HRM) and a NimBLE Bluetooth backend.
      Off in the recovery firmware, which has no HRM-sharing UI.

endmenu
```

## src/fw/Kconfig
```kconfig
# SPDX-FileCopyrightText: 2026 Core Devices LLC
# SPDX-License-Identifier: Apache-2.0

rsource "apps/Kconfig"
rsource "drivers/Kconfig"
rsource "kernel/Kconfig"
rsource "services/Kconfig"

menu "Software Features"

config SETTINGS_ICONS
    bool "Settings menu icons"
    help
      Show icons next to entries in the system Settings menu.

config THEMING
    bool "Color theming"
    help
      Expose the highlight-color theming UI under Settings.

config DYNAMIC_BACKLIGHT
    bool "Dynamic backlight"
    help
      Adjust backlight intensity based on ambient light readings.
      Requires an ambient light sensor.

config ACCEL_SENSITIVITY
    bool "Accelerometer sensitivity setting"
    help
      Expose the accelerometer tap/shake sensitivity adjustment in
      Settings.

config APP_SCALING
    bool "App scaling"
    help
      Scale legacy lower-resolution apps to the current display via
      the compositor.

config ORIENTATION_MANAGER
    bool "Orientation manager UI"
    help
      Expose the device-orientation / rotation prefs in shell and
      Settings. Independent of CONFIG_SERVICE_ORIENTATION_MANAGER,
      which controls whether the underlying service is built.

config MODDABLE_XS
    bool "Moddable XS JavaScript engine"
    help
      Build Moddable XS support for running JavaScript apps. PRF
      variant builds force this off regardless of the board default.

config MMAP_RESOURCES
    bool "Memory-mapped (zero-copy) resource reads"
    help
      Serve read-only system resources as direct pointers into
      memory-mapped flash instead of copying them out.

config HIBERNATE
    bool "Hibernate"
    default y
    depends on SOC_SF32LB52
    help
      Add a hibernate quick-launch toggle and settings menu item that
      puts the watch into an RTC-preserving low-power state. Only
      supported on SF32LB52-based watches.

endmenu

choice
    prompt "Shell"
    default SHELL_NORMAL

config SHELL_NORMAL
    bool "Normal shell"

config SHELL_SDK
    bool "SDK shell"
    help
      Use the SDK shell instead of the normal shell.

endchoice

menu "Debug & instrumentation"

config NO_WATCH_TIMEOUT
    bool "Disable watchface idle timeout"

config NO_WATCHDOG
    bool "Disable watchdog reboots"
    help
      Do not reboot automatically when a watchdog fires; break into
      the debugger instead.

config UI_DEBUG
    bool "UI debug commands"
    help
      Enable the window dump and layer nudge CLI commands.

config PROMPT
    bool "Serial console prompt"
    default y
    help
      Build the serial console. Disable to save space.

config MALLOC_INSTRUMENTATION
    bool "Malloc instrumentation"
    help
      Track the caller PC of every heap allocation.

config PROFILER
    bool "Profiler"

config PROFILE_INTERRUPTS
    bool "Profile all interrupts"
    select PROFILER

config PERFORMANCE_TESTS
    bool "Performance test instrumentation"
    select PROFILER

endmenu
```

## src/fw/apps/demo/Kconfig
```kconfig
# SPDX-FileCopyrightText: 2026 Core Devices LLC
# SPDX-License-Identifier: Apache-2.0

menu "Demo"

rsource "accel_demo/Kconfig"
rsource "action_menu/Kconfig"
rsource "activity_demo/Kconfig"
rsource "activity_test/Kconfig"
rsource "amb_light_read/Kconfig"
rsource "animated_demo/Kconfig"
rsource "app_heap_demo/Kconfig"
rsource "bouncing_box_demo/Kconfig"
rsource "click/Kconfig"
rsource "data_logging_test/Kconfig"
rsource "deadlock/Kconfig"
rsource "dialogs/Kconfig"
rsource "double_tap_test/Kconfig"
rsource "emoji_test/Kconfig"
rsource "event_service/Kconfig"
rsource "exit/Kconfig"
rsource "flash_diagnostic/Kconfig"
rsource "flash_prof/Kconfig"
rsource "font_test/Kconfig"
rsource "fs_resources/Kconfig"
rsource "fw_update_progress_sim/Kconfig"
rsource "gdrawmask_demo/Kconfig"
rsource "gfx_tests/Kconfig"
rsource "hrm_demo/Kconfig"
rsource "idl/Kconfig"
rsource "kill_bt/Kconfig"
rsource "kino_layer/Kconfig"
rsource "light_config/Kconfig"
rsource "menu/Kconfig"
rsource "menu_overflow/Kconfig"
rsource "menu_right_icon/Kconfig"
rsource "menu_round/Kconfig"
rsource "morph_square/Kconfig"
rsource "movable_line/Kconfig"
rsource "mpu_test/Kconfig"
rsource "mpu_violation_test/Kconfig"
rsource "number_field/Kconfig"
rsource "option_menu/Kconfig"
rsource "pebble_colors/Kconfig"
rsource "pebble_shapes/Kconfig"
rsource "persist/Kconfig"
rsource "profile_mutexes/Kconfig"
rsource "progress/Kconfig"
rsource "scroll/Kconfig"
rsource "simple_menu/Kconfig"
rsource "spo2_test/Kconfig"
rsource "statusbar/Kconfig"
rsource "stroke_width/Kconfig"
rsource "swap_layer/Kconfig"
rsource "temperature_demo/Kconfig"
rsource "test_args_receiver/Kconfig"
rsource "test_args_sender/Kconfig"
rsource "test_bluetooth/Kconfig"
rsource "test_core_dump/Kconfig"
rsource "test_sys_timer/Kconfig"
rsource "text_clipping/Kconfig"
rsource "text_flow/Kconfig"
rsource "text_layout/Kconfig"
rsource "text_spacing/Kconfig"
rsource "timeline_pins/Kconfig"
rsource "timer/Kconfig"
rsource "trigger_alarm/Kconfig"
rsource "vibe_and_logs/Kconfig"
rsource "vibe_score/Kconfig"
rsource "vibe_strength/Kconfig"

endmenu
```

## src/fw/apps/demo/mic_demo/Kconfig
```kconfig
# SPDX-FileCopyrightText: 2026 Core Devices LLC
# SPDX-License-Identifier: Apache-2.0

config DEMO_APP_MIC_DEMO
    bool "Mic Demo"
    depends on SERVICE_MIC_CAPTURE
```

## src/fw/drivers/display/Kconfig
```kconfig
# SPDX-FileCopyrightText: 2026 Core Devices LLC
# SPDX-License-Identifier: Apache-2.0

menuconfig DISPLAY
    bool "Display"
    help
      Display Drivers

if DISPLAY

config DISPLAY_JDI_SF32LB
    bool "JDI (SiFli SF32LB)"
    default y if SOC_SF32LB52
    select HAL_SIFLI
    select HAL_SIFLI_LCD
    help
      Support for JDI display via SiFli SF32LB.

config DISPLAY_SHARP_LS013B7DH01_NRF5
    bool "Sharp LS013B7DH01 (nRF5)"
    default y if SOC_NRF52
    select HAL_NORDIC
    help
      Support for the Sharp LS013B7DH01 display via nRF5.

config DISPLAY_QEMU
    bool "QEMU Framebuffer Display"
    default y if SOC_QEMU
    help
      Support for the QEMU framebuffer display peripheral.

module = DRIVER_DISPLAY
module-str = Display
source "subsys/logging/Kconfig.template.log_level"

endif # DISPLAY
```

## src/fw/drivers/exti/Kconfig
```kconfig
# SPDX-FileCopyrightText: 2026 Core Devices LLC
# SPDX-License-Identifier: Apache-2.0

menuconfig EXTI
    bool "External Interrupt"
    help
      External Interrupt Drivers

if EXTI

config EXTI_NRF5
    bool "Nordic nRF5"
    default y if SOC_NRF52
    select HAL_NORDIC
    help
      Support for the Nordic nRF5 external interrupt controller.

config EXTI_SF32LB
    bool "SiFli SF32LB"
    default y if SOC_SF32LB52
    select HAL_SIFLI
    select HAL_SIFLI_GPIO
    help
      Support for the SiFli SF32LB external interrupt controller.

config EXTI_QEMU
    bool "QEMU External Interrupt"
    default y if SOC_QEMU
    help
      Support for the QEMU external interrupt peripheral.

module = DRIVER_EXTI
module-str = External Interrupt
source "subsys/logging/Kconfig.template.log_level"

endif # EXTI
```
