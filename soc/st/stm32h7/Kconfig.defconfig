## soc/st/stm32h7/Kconfig.soc
```kconfig
# SPDX-FileCopyrightText: 2026 Core Devices LLC
# SPDX-License-Identifier: Apache-2.0

config SOC_STM32H747_M7
    bool "ST STM32H747, Cortex-M7"
    select SOC_STM32H7
    select CPU_CORTEX_M7
    help
      The Cortex-M7 of the STM32H747, CPU1, which sets up the supply and
      the clocks and starts the Cortex-M4.

config SOC_STM32H747_M4
    bool "ST STM32H747, Cortex-M4"
    select SOC_STM32H7
    select CPU_CORTEX_M4
    help
      The Cortex-M4 of the STM32H747, CPU2, which runs once the Cortex-M7
      starts it, and leaves the supply and the clock tree to it.
```

## subsys/bluetooth/Kconfig
```kconfig
# SPDX-FileCopyrightText: 2026 Core Devices LLC
# SPDX-License-Identifier: Apache-2.0

menu "Bluetooth"

config BT
    bool "Bluetooth"
    select BT_GATT_CLIENT
    select BT_GATT_SERVER
    select KERNEL_SYS_WORKQ
    select NIMBLE
    select NIMBLE_STORE_CONFIG
    help
      The Bluetooth subsystem: the pbl_bt API, implemented on the NimBLE
      host.

if BT

module = BT
module-str = Bluetooth
source "subsys/logging/Kconfig.template.log_level"

endif

rsource "adv/Kconfig"
rsource "clients/Kconfig"
rsource "services/Kconfig"
rsource "prf_store/Kconfig"

endmenu
```

## subsys/bluetooth/adv/Kconfig
```kconfig
# SPDX-FileCopyrightText: 2026 Core Devices LLC
# SPDX-License-Identifier: Apache-2.0

config BT_ADV
    bool "Advertising"
    depends on NIMBLE
    select KERNEL_SYS_WORKQ
    help
      Connectable advertising that follows what there is to advertise, at
      a short interval first and a long one afterwards
      (pbl/bluetooth/adv.h). It only needs NimBLE.

if BT_ADV

module = BT_ADV
module-str = Bluetooth advertising
source "subsys/logging/Kconfig.template.log_level"

endif
```

## subsys/bluetooth/clients/Kconfig
```kconfig
# SPDX-FileCopyrightText: 2026 Core Devices LLC
# SPDX-License-Identifier: Apache-2.0

config BT_GATT_CLIENT
    bool
    depends on NIMBLE
    help
      What clients of a peer's GATT services share
      (pbl/bluetooth/clients/gatt.h). It only needs NimBLE.

menu "Clients"

rsource "ams/Kconfig"
rsource "ancs/Kconfig"

endmenu
```

## subsys/bluetooth/clients/ams/Kconfig
```kconfig
# SPDX-FileCopyrightText: 2026 Core Devices LLC
# SPDX-License-Identifier: Apache-2.0

config BT_AMS_CLIENT
    bool "AMS client"
    depends on NIMBLE
    select BT_GATT_CLIENT
    help
      Client of the Apple Media Service of a connected iOS device
      (pbl/bluetooth/clients/ams.h).
```

## subsys/bluetooth/clients/ancs/Kconfig
```kconfig
# SPDX-FileCopyrightText: 2026 Core Devices LLC
# SPDX-License-Identifier: Apache-2.0

config BT_ANCS_CLIENT
    bool "ANCS client"
    depends on NIMBLE
    select BT_GATT_CLIENT
    help
      Client of the Apple Notification Center Service of a connected iOS
      device (pbl/bluetooth/clients/ancs.h): its notifications, their
      attributes and their actions.
```

## subsys/bluetooth/prf_store/Kconfig
```kconfig
# SPDX-FileCopyrightText: 2026 Core Devices LLC
# SPDX-License-Identifier: Apache-2.0

config BT_PRF_STORE
    bool "PRF store"
    depends on NIMBLE
    depends on FLASH
    help
      The bonding and root keys the recovery firmware and the normal
      firmware share, in a flash partition of its own
      (pbl/bluetooth/prf_store.h). It only needs the types of NimBLE.

choice BT_PRF_STORE_LAYOUT
    prompt "PRF store layout"
    depends on BT_PRF_STORE
    default BT_PRF_STORE_LAYOUT_RECORDS
    help
      How the partition is laid out. Both firmwares of a device have to
      agree on it, and it cannot change once a device is in the field:
      the recovery firmware there is not updated.

config BT_PRF_STORE_LAYOUT_RECORDS
    bool "Records"
    help
      A log of records of 140 bytes with one CRC, each holding all the
      store keeps: the last valid one is the store. For devices that
      have not shipped with the legacy layout.

config BT_PRF_STORE_LAYOUT_LEGACY
    bool "Legacy"
    help
      Entries of 256 bytes made of fields with a CRC each, one of them
      valid at a time. The layout of the devices that shipped with it:
      it carries fields nothing uses any more.

endchoice

if BT_PRF_STORE

module = BT_PRF_STORE
module-str = PRF store
source "subsys/logging/Kconfig.template.log_level"

endif
```

## subsys/bluetooth/services/Kconfig
```kconfig
# SPDX-FileCopyrightText: 2026 Core Devices LLC
# SPDX-License-Identifier: Apache-2.0

config BT_GATT_SERVER
    bool
    depends on NIMBLE
    help
      What the GATT services of the device share, and how they are added
      in order (pbl/bluetooth/gatts.h). It only needs NimBLE.

menu "Services"
    depends on BT

rsource "bas/Kconfig"
rsource "dis/Kconfig"
rsource "pps/Kconfig"

endmenu
```

## subsys/bluetooth/services/ppog_reversed/Kconfig
```kconfig
# SPDX-FileCopyrightText: 2026 Core Devices LLC
# SPDX-License-Identifier: Apache-2.0

config BT_SERVICE_PPOG_REVERSED
    bool "Reversed PPoGATT service"
    select BT_GATT_SERVER
    help
      PPoGATT service hosted by the watch, for phones whose GATT server
      API is broken (pbl/bluetooth/ppog_reversed.h).
```

## subsys/bluetooth/services/pps/Kconfig
```kconfig
# SPDX-FileCopyrightText: 2026 Core Devices LLC
# SPDX-License-Identifier: Apache-2.0

config BT_SERVICE_PPS
    bool "Pebble Pairing Service"
    help
      GATT service through which the phone app checks the connection
      status and triggers pairing (pbl/bluetooth/pebble_pairing_service.h).
```

## subsys/canopen/Kconfig
```kconfig
# SPDX-FileCopyrightText: 2026 Core Devices LLC
# SPDX-License-Identifier: Apache-2.0

menuconfig CANOPEN
    bool "CANopen"
    depends on CAN
    help
      CANopen device (CiA 301): NMT slave, heartbeat, SDO server, PDOs,
      SYNC consumer and emergency producer, with an object dictionary
      generated from YAML.

if CANOPEN

config CANOPEN_THREAD_PRIO
    int "Thread priority"
    default 4
    help
      Priority of the thread every node runs on, the highest by default:
      SYNC, PDOs and the SYNC callback run on it.

config CANOPEN_THREAD_STACK_SIZE
    int "Thread stack size in bytes"
    default 1536

config CANOPEN_RX_QUEUE_SIZE
    int "Received frames queued per node"
    default 16
    help
      Frames received from the controller interrupt and not yet
      processed by the node's thread. Frames past this are dropped and
      raise a CAN overrun emergency.

config CANOPEN_TX_QUEUE_SIZE
    int "Frames queued for transmission per node"
    default 16
    range 1 255
    help
      Frames waiting for room in the controller. A SYNC sends every
      synchronous TPDO due at once, so this needs room for all of them,
      a heartbeat and an emergency message.

config CANOPEN_SDO_TIMEOUT_MS
    int "SDO segmented transfer timeout in milliseconds"
    default 1000

config CANOPEN_EMCY_ACTIVE
    int "Errors raised at once per node"
    default 8
    range 1 255

config CANOPEN_EMCY_QUEUE
    int "Emergency messages held back by the inhibit time"
    default 4
    range 1 255

config CANOPEN_STORAGE
    bool "Parameter storage"
    depends on SETTINGS
    help
      Save the parameters, the entries the bus can write, to a settings
      file on command (0x1010), load them on reset, and restore their
      defaults (0x1011), for dictionaries with storage enabled.

config CANOPEN_STORAGE_SIZE
    int "Space for the stored parameters of a node, in bytes"
    default 4096
    depends on CANOPEN_STORAGE

config CANOPEN_CIA402
    bool "CiA 402 drive profile"
    help
      Drive state machine of CiA 402 on a node whose object dictionary
      has a cia402 section, for motor control.

module = CANOPEN
module-str = CANopen
source "subsys/logging/Kconfig.template.log_level"

endif
```

## subsys/console/Kconfig
```kconfig
# SPDX-FileCopyrightText: 2026 Core Devices LLC
# SPDX-License-Identifier: Apache-2.0

config CONSOLE
    bool "Serial console"
    select CRC
    help
      Text console on the board's console port, CONSOLE_UART: logs and
      the shell. Off on release firmware, which leaves the port unused.

config CONSOLE_INPUT
    bool
    depends on CONSOLE
    select KERNEL_SYS_WORKQ
    select KERNEL_SYS_WORKQ_HIGH
    help
      Receive on the console port: shell commands and frames from the
      development tools. Selected by what reads the input.

config CONSOLE_IMAGING
    bool "Flash imaging"
    depends on CONSOLE && FLASH && $(has_partition,safe-firmware)
    depends on $(has_partition,system-resources-bank-0) && $(has_partition,system-resources-bank-1)
    select CONSOLE_INPUT
    select FLASH_CRC
    help
      Write the system resources and the recovery firmware to flash
      over the console, as manufacturing does.

config CONSOLE_BAUDRATE
    int "Console baud rate"
    depends on CONSOLE
    default 1000000
    help
      Line rate of the board's console port, CONSOLE_UART.

config CONSOLE_STDOUT
    bool "Standard output"
    depends on CONSOLE
    help
      Send the C library's standard output and error, printf() and
      friends, to the console. Newlines go out as CR LF. Not for
      interrupt context. Native builds print to the process's
      standard output and error unbuffered, where their console goes.
```

## subsys/coredump/Kconfig
```kconfig
# SPDX-FileCopyrightText: 2026 Core Devices LLC
# SPDX-License-Identifier: Apache-2.0

menu "Core dumps"

config COREDUMP
    bool "Core dumps"
    depends on ARCH_HAS_COREDUMP
    help
      Save the state of the system when it crashes, for analysis after
      the reset.

if COREDUMP

config COREDUMP_STACK_SIZE
    int "Stack size of the dump in bytes"
    default 1024
    help
      Stack the dump is written on, its own so that it depends neither on
      what the code that crashed left of its stack nor overwrites it. The
      backends and the drivers they write through run on it.

config COREDUMP_TEST_FAULT
    bool
    help
      Let tests inject a fault while a dump is being written.

rsource "backends/Kconfig"

endif

endmenu
```

## subsys/coredump/backends/Kconfig
```kconfig
# SPDX-FileCopyrightText: 2026 Core Devices LLC
# SPDX-License-Identifier: Apache-2.0

config COREDUMP_BACKEND_FLASH
    bool "Flash backend"
    default y
    depends on FLASH && $(has_partition,safe-firmware)
    depends on $(has_partition,cd) || $(has_partition,scratch)
    help
      Keep dumps in flash until they are read back, in the cd partition
      or, without one, in the scratch partition.

config COREDUMP_BACKEND_FLASH_IMAGES
    int "Dumps to keep"
    default 2 if SOC_NRF52
    default 1
    range 1 32
    depends on COREDUMP_BACKEND_FLASH
    help
      The storage is divided evenly between this many dumps, the oldest
      being replaced.
```

## subsys/cron/Kconfig
```kconfig
# SPDX-FileCopyrightText: 2026 Core Devices LLC
# SPDX-License-Identifier: Apache-2.0

config CRON
    bool "Cron"
    select KERNEL_SYS_WORKQ_HIGH
    help
      Wall-clock based job scheduler that handles DST and time zone
      changes.

if CRON

module = CRON
module-str = Cron
source "subsys/logging/Kconfig.template.log_level"

endif
```

## subsys/pp/Kconfig
```kconfig
# SPDX-FileCopyrightText: 2026 Core Devices LLC
# SPDX-License-Identifier: Apache-2.0

menuconfig PP
    bool "Pebble protocol"
    select KERNEL_SYS_WORKQ
    help
      Pebble protocol sessions with phone apps: endpoints, send queues
      and the transports that carry them.

if PP

module = PP
module-str = Pebble protocol
source "subsys/logging/Kconfig.template.log_level"

config PP_TRANSPORT_GATT
    bool "PPoGATT"
    depends on NIMBLE
    select BT_GATT_CLIENT
    select KERNEL_SYS_WORKQ
    select KERNEL_SYS_WORKQ_HIGH
    help
      Pebble protocol over GATT (PPoGATT), the transport phones use.

config PP_TRANSPORT_GATT_REVERSED
    bool "Reversed PPoGATT service"
    depends on PP_TRANSPORT_GATT
    select BT_GATT_SERVER
    help
      PPoGATT service hosted by the device, for phones whose GATT server
      API is broken: the phone is the client. It is added with the other
      GATT services of the device (pbl/bluetooth/gatts.h).

config PP_TRANSPORT_CONSOLE
    bool "Console frames"
    depends on CONSOLE
    select CONSOLE_INPUT
    select KERNEL_SYS_WORKQ_HIGH
    help
      Pebble protocol over serial console frames, for development tools.

config PP_TRANSPORT_USB
    bool "USB"
    depends on USB_DEVICE
    select KERNEL_SYS_WORKQ
    select KERNEL_SYS_WORKQ_HIGH
    help
      Pebble protocol over USB, for development tools: a function of the
      USB device, with a vendor-specific interface and two bulk endpoints
      (pbl/pp/transports/usb.h).

endif
```

## subsys/rtt/Kconfig
```kconfig
# SPDX-FileCopyrightText: 2026 Core Devices LLC
# SPDX-License-Identifier: Apache-2.0

menuconfig RTT
    bool "SEGGER RTT"
    select KERNEL_NOCACHE if CPU_HAS_DCACHE
    help
      Channels in RAM that a debug probe reads and writes over SWD while
      the target runs (pbl/rtt). Its buffers take RAM, so it is only built
      when selected. With a data cache they go in the kernel's
      non-cacheable section: the probe reads RAM behind the cache.

if RTT

config RTT_NUM_UP
    int "Up channels"
    range 1 16
    default 1
    help
      Channels from the target to the probe. Channel 0 is the terminal.

config RTT_NUM_DOWN
    int "Down channels"
    range 1 16
    default 1
    help
      Channels from the probe to the target. Channel 0 is the terminal.

config RTT_UP_SIZE
    int "Up channel buffer size"
    range 16 65536
    default 2048
    help
      Bytes the target can write to a channel before the probe reads
      them; writes that do not fit are dropped.

config RTT_DOWN_SIZE
    int "Down channel buffer size"
    range 16 65536
    default 64

endif # RTT
```

## subsys/sd/Kconfig
```kconfig
# SPDX-FileCopyrightText: 2026 Core Devices LLC
# SPDX-License-Identifier: Apache-2.0

config SD
    bool "SD cards"
    select SDHC
    select DISK
    help
      The SD card stack (pbl/sd/sd.h): the card in the slot of the board's
      SD host controller, its sdhc role, brought up as a disk of 512-byte
      sectors.

if SD

module = SD
module-str = SD cards
source "subsys/logging/Kconfig.template.log_level"

endif # SD
```

## subsys/sensing/Kconfig
```kconfig
# SPDX-FileCopyrightText: 2026 Core Devices LLC
# SPDX-License-Identifier: Apache-2.0

menuconfig SENSING
    bool "Sensing"
    depends on SENSOR
    help
      Shares sensors between clients: arbitrates the sampling interval,
      batch size and events, and buffers frames for each client at its
      own rate.

if SENSING

config SENSING_SENSORS
    int "Maximum number of sensors"
    default 4
    help
      Number of sensors with clients at the same time.

config SENSING_BUFFER_FRAMES
    int "Frames buffered per sensor type"
    default 200
    help
      Minimum number of frames buffered for the clients of a sensor type,
      raised to twice the sensor's FIFO depth. The buffer is allocated
      while a client reads the type.

module = SENSING
module-str = Sensing
source "subsys/logging/Kconfig.template.log_level"

endif
```
