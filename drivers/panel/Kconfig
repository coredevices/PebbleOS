## drivers/panel/Kconfig
```kconfig
# SPDX-FileCopyrightText: 2026 Core Devices LLC
# SPDX-License-Identifier: Apache-2.0

config PANEL
    bool
    help
      Panel class, selected by the display controllers driving a panel.

config PANEL_JDI_MIP
    bool "Memory-in-pixel panels"
    default DT_HAS_JDI_LPM015M135A_ENABLED || DT_HAS_SHARP_LS013B7DD02_ENABLED
    depends on PANEL && PWM && REGULATOR
    help
      Support for the JDI LPM015M135A and Sharp LS013B7DD02 memory-in-pixel
      panels on the JDI parallel interface.
```

## drivers/pinctrl/Kconfig
```kconfig
# SPDX-FileCopyrightText: 2026 Core Devices LLC
# SPDX-License-Identifier: Apache-2.0

config PINCTRL
    bool
    help
      Pin controller class (pbl/drivers/pinctrl.h), selected by the drivers
      that route peripheral signals to pins.

config PINCTRL_SF32LB52
    bool "SiFli SF32LB52 pin controller"
    default y if SOC_SF32LB52
    select PINCTRL
    help
      Pin multiplexer and pad configuration of the SiFli SF32LB52 HPSYS
      pads.

config PINCTRL_SHELL
    bool "Pin controller shell commands"
    default y
    depends on PINCTRL && SHELL
    help
      The pinctrl shell command, to dump the pad registers of every pin
      controller.
```

## drivers/pmic/Kconfig
```kconfig
# SPDX-FileCopyrightText: 2026 Core Devices LLC
# SPDX-License-Identifier: Apache-2.0

menuconfig PMIC
    bool "PMIC"
    help
      PMIC Drivers

if PMIC

config PMIC_NPM1300
    bool "Nordic nPM1300 charger"
    default y
    depends on MFD_NPM1300
    select BATTERY_HIGH_LOAD
    help
      Support for the charger of the Nordic nPM1300 PMIC.

module = DRIVER_PMIC
module-str = PMIC
source "subsys/logging/Kconfig.template.log_level"

endif # PMIC
```

## drivers/power_domain/Kconfig
```kconfig
# SPDX-FileCopyrightText: 2026 Core Devices LLC
# SPDX-License-Identifier: Apache-2.0

config POWER_DOMAIN
    bool
    help
      Power domain class (pbl/drivers/power_domain.h), selected by the
      drivers that provide power domains.
```

## drivers/ppg/Kconfig
```kconfig
# SPDX-FileCopyrightText: 2026 Core Devices LLC
# SPDX-License-Identifier: Apache-2.0

menuconfig PPG
    bool "PPG front end"
    help
      Optical front end drivers (pbl/drivers/ppg.h): LEDs and
      photodiode receivers sampled in time slots. The board gives its
      front end the ppg role.

if PPG

config PPG_SHELL
    bool "Shell commands"
    default DRIVER_SHELL
    depends on SHELL
    help
      The ppg shell command, to inspect the front end and read raw
      samples.

config PPG_GH3X2X
    bool "Goodix GH3x2x"
    default DT_HAS_GOODIX_GH3026_ENABLED
    select GPIO
    select I2C
    help
      Support for the Goodix GH3x2x optical front ends.

config PPG_QEMU
    bool "QEMU"
    default y if SOC_QEMU_PEBBLE
    help
      Synthetic front end for QEMU, which emulates no optical sensor: it
      models a wrist with a pulse set by the host.

module = DRIVER_PPG
module-str = PPG front end
source "subsys/logging/Kconfig.template.log_level"

endif # PPG
```

## drivers/pwm/Kconfig
```kconfig
# SPDX-FileCopyrightText: 2026 Core Devices LLC
# SPDX-License-Identifier: Apache-2.0

menuconfig PWM
    bool "PWM"
    help
      PWM Drivers

if PWM

config PWM_NRF5
    bool "Nordic nRF5"
    default y if SOC_NRF52
    help
      Support for the Nordic nRF5 PWM controller.

config PWM_NRF5_RTC
    bool "Nordic nRF5 RTC PWM"
    default DT_HAS_NORDIC_NRF52832_RTC_PWM_ENABLED
    help
      Support for PWM outputs generated by an nRF5 RTC, through PPI and
      GPIOTE.

config PWM_SF32LB_LPTIM
    bool "SiFli SF32LB LPTIM"
    default DT_HAS_SIFLI_SF32LB52_LPTIM_PWM_ENABLED
    depends on PINCTRL
    help
      Support for PWM outputs of the SiFli SF32LB low-power timers.

config PWM_SHELL
    bool "Shell commands"
    default DRIVER_SHELL
    depends on SHELL
    help
      The pwm shell command, to list the controllers and run or disable
      their channels.

endif # PWM
```

## drivers/ram/Kconfig
```kconfig
# SPDX-FileCopyrightText: 2026 Core Devices LLC
# SPDX-License-Identifier: Apache-2.0

menuconfig RAM
    bool "RAM"
    help
      Memory-mapped RAM outside the SoC's own, only powered while it
      has users (pbl/drivers/ram.h). The kernel scratch heap can use
      the one a board gives the EXTRAM role.

if RAM

config RAM_SHELL
    bool "Shell commands"
    default DRIVER_SHELL
    depends on SHELL && !SCRATCH_HEAP_SHARED
    help
      The ram shell command, to show the use and power state of the
      external RAM, and to check that it keeps what is written to it.

config RAM_HYPERRAM
    bool "HyperRAM"
    default DT_HAS_CYPRESS_HYPERRAM_ENABLED
    select REGULATOR
    select HYPERBUS
    help
      Support for HyperRAM, PSRAM with a HyperBus interface, on a
      HyperBus controller.

endif # RAM
```

## drivers/regulator/Kconfig
```kconfig
# SPDX-FileCopyrightText: 2026 Core Devices LLC
# SPDX-License-Identifier: Apache-2.0

config REGULATOR
    bool
    help
      Power rail class (pbl/drivers/regulator.h), selected by the drivers
      that use regulators.

# Not only for its consumers: it also switches off a regulator nothing uses
config REGULATOR_SF32LB52_PMUC
    bool "SiFli SF32LB52 PMUC regulators"
    default DT_HAS_SIFLI_SF32LB52_PMUC_ENABLED
    depends on SOC_SF32LB52
    select REGULATOR
    help
      Support for LDO18, the supply of the package memory in the
      SF32LB52 PMUC.

if REGULATOR

config REGULATOR_NPM1300
    bool "Nordic nPM1300 regulators"
    default DT_HAS_NORDIC_NPM1300_ENABLED
    select MFD
    select MFD_NPM1300
    help
      Support for the BUCK and LDSW rails of the Nordic nPM1300 PMIC.

config REGULATOR_FIXED
    bool "Fixed regulators"
    default DT_HAS_REGULATOR_FIXED_ENABLED
    select GPIO
    help
      Support for rails switched by a GPIO.

module = DRIVER_REGULATOR
module-str = Regulator
source "subsys/logging/Kconfig.template.log_level"

endif # REGULATOR
```

## drivers/remoteproc/Kconfig
```kconfig
# SPDX-FileCopyrightText: 2026 Core Devices LLC
# SPDX-License-Identifier: Apache-2.0

menuconfig REMOTEPROC
    bool "Remote processors"
    help
      Remote processor class (pbl/drivers/remoteproc.h), selected by the
      code that boots firmware on other cores.

if REMOTEPROC

config REMOTEPROC_SF32LB52
    bool "SiFli SF32LB52 LCPU"
    default DT_HAS_SIFLI_SF32LB52_LCPU_ENABLED
    depends on SOC_SF32LB52
    select MBOX
    select NVMEM
    help
      The SF32LB52 low-power CPU, running the Bluetooth controller from
      ROM: configuration, ROM patches and radio calibration on boot.

config REMOTEPROC_SHELL
    bool "Remote processor shell commands"
    default DRIVER_SHELL
    depends on SHELL
    help
      The rproc shell command, to list the remote processors and boot or
      shut them down.

endif # REMOTEPROC
```

## drivers/reset/Kconfig
```kconfig
# SPDX-FileCopyrightText: 2026 Core Devices LLC
# SPDX-License-Identifier: Apache-2.0

menuconfig RESET
    bool "Reset controllers"
    help
      Reset controller class (pbl/drivers/reset.h), selected by the drivers
      that take reset lines.

if RESET

config RESET_SF32LB
    bool "SiFli SF32LB RCC"
    default DT_HAS_SIFLI_SF32LB52_HPSYS_RCC_ENABLED || DT_HAS_SIFLI_SF32LB57_HPSYS_RCC_ENABLED
    help
      Reset controller of the SiFli SF32LB52 and SF32LB57 HPSYS RCC.

endif # RESET
```

## drivers/retained/Kconfig
```kconfig
# SPDX-FileCopyrightText: 2026 Core Devices LLC
# SPDX-License-Identifier: Apache-2.0

menuconfig RETAINED
    bool "Retained registers"
    help
      32-bit registers that survive a reset.

if RETAINED

config RETAINED_NRF5
    bool "Nordic nRF5"
    default y if SOC_NRF52
    help
      31 registers in retained RAM, followed by their CRC32.

config RETAINED_SF32LB
    bool "SiFli SF32LB"
    default y if SOC_SF32LB52
    help
      The 10 RTC backup registers.

config RETAINED_QEMU
    bool "QEMU"
    default y if SOC_QEMU
    help
      The 16 backup registers of the QEMU RTC.

config RETAINED_POSIX
    bool "POSIX"
    default y if SOC_POSIX
    help
      16 registers in process memory: they survive a reset of the
      firmware, not of the process.

endif # RETAINED
```

## drivers/rtc/Kconfig
```kconfig
# SPDX-FileCopyrightText: 2026 Core Devices LLC
# SPDX-License-Identifier: Apache-2.0

menuconfig RTC
    bool "RTC"
    help
      Real-time clock drivers: hardware that keeps the wall clock across
      resets.

if RTC

config RTC_SHELL
    bool "RTC shell commands"
    default DRIVER_SHELL
    depends on SHELL
    help
      The rtc shell command, to read and set the RTC directly.

config RTC_RETAINED
    bool "Retained RAM"
    default y if SOC_NRF52
    help
      The time last set, kept in retained RAM, for SoCs without a calendar
      RTC. It survives resets but not power loss, and does not count while
      the system is off.

config RTC_SF32LB
    bool "SiFli SF32LB"
    default y if SOC_SF32LB52
    help
      SiFli SF32LB calendar RTC, clocked by the calibrated RC10K.

config RTC_QEMU
    bool "QEMU RTC"
    default y if SOC_QEMU
    help
      QEMU RTC, following the host clock.

config RTC_POSIX
    bool "POSIX RTC"
    default y if SOC_POSIX
    help
      RTC following the host clock.

endif # RTC
```

## drivers/sf32lb52/Kconfig
```kconfig
# SPDX-FileCopyrightText: 2026 Core Devices LLC
# SPDX-License-Identifier: Apache-2.0

config SF32LB52_HXT
    bool "SF32LB52 crystal trim"
    default y
    depends on SOC_SF32LB52 && FLASH_OTP
    help
      Apply the 48 MHz crystal load capacitance trim from the SoC factory
      configuration in the flash OTP area, once the flash is up.

if SF32LB52_HXT

module = DRIVER_SF32LB52_HXT
module-str = SF32LB52 crystal trim
source "subsys/logging/Kconfig.template.log_level"

endif # SF32LB52_HXT
```

## drivers/spi/Kconfig
```kconfig
# SPDX-FileCopyrightText: 2026 Core Devices LLC
# SPDX-License-Identifier: Apache-2.0

menuconfig SPI
    bool "SPI"
    help
      SPI Drivers

if SPI

config SPI_NRF5
    bool "Nordic nRF5 SPI Controller"
    default DT_HAS_NORDIC_NRF52832_SPIM_ENABLED
    depends on SOC_NRF52
    help
      Support for the Nordic nRF5 SPIM controller.

config SPI_NRF5_IRQ_PRIO
    int "Interrupt priority"
    default 7
    depends on SPI_NRF5
    help
      Priority of the controller interrupts.

config SPI_SHELL
    bool "Shell commands"
    default DRIVER_SHELL
    depends on SHELL
    help
      The spi shell command, to list the buses and run transfers.

module = DRIVER_SPI
module-str = SPI
source "subsys/logging/Kconfig.template.log_level"

endif # SPI
```

## drivers/spi_mem/Kconfig
```kconfig
# SPDX-FileCopyrightText: 2026 Core Devices LLC
# SPDX-License-Identifier: Apache-2.0

menuconfig SPI_MEM
    bool "SPI memory controllers"
    help
      Controllers running command, address, dummy and data operations
      against SPI memories.

if SPI_MEM

module = DRIVER_SPI_MEM
module-str = SPI memory
source "subsys/logging/Kconfig.template.log_level"

endif # SPI_MEM
```

## drivers/temp/Kconfig
```kconfig
# SPDX-FileCopyrightText: 2026 Core Devices LLC
# SPDX-License-Identifier: Apache-2.0

menuconfig TEMP
    bool "Temperature Sensor"
    help
      Temperature Sensor Drivers

if TEMP

config TEMP_SHELL
    bool "Shell commands"
    default DRIVER_SHELL
    depends on SHELL
    help
      The temp shell command, to read the die temperature.

config TEMP_NRF5
    bool "Nordic nRF5"
    default y if SOC_NRF52
    help
      Support for the Nordic nRF5 die temperature sensor.

config TEMP_SF32LB
    bool "SiFli SF32LB"
    default DT_HAS_SIFLI_SF32LB52_TSEN_ENABLED
    depends on SOC_SF32LB52
    select CLK
    help
      Support for the SiFli SF32LB temperature sensor.

config TEMP_SIM
    bool "Simulator"
    default y if SOC_QEMU_PEBBLE || SOC_POSIX
    help
      Simulated temperature sensor, reading a value set through its
      simulator API (pbl/drivers/temp/sim.h).

endif # TEMP
```

## drivers/temperature/Kconfig
```kconfig
# SPDX-FileCopyrightText: 2026 Core Devices LLC
# SPDX-License-Identifier: Apache-2.0

menuconfig TEMPERATURE
    bool "Temperature Sensor"
    help
      Temperature Sensor Drivers

if TEMPERATURE

config TEMPERATURE_SHELL
    bool "Shell commands"
    default y
    depends on SHELL && !RECOVERY_FW
    help
      The temp shell command, to read the die temperature.

config TEMPERATURE_NRF5
    bool "Nordic nRF5"
    default y if SOC_NRF52
    help
      Support for the Nordic nRF5 die temperature sensor.

config TEMPERATURE_SF32LB
    bool "SiFli SF32LB"
    default y if SOC_SF32LB52
    depends on CLK_SF32LB
    help
      Support for the SiFli SF32LB temperature sensor.

config TEMPERATURE_QEMU
    bool "QEMU"
    default y if SOC_QEMU
    help
      QEMU temperature sensor. QEMU emulates none, so it reports a fixed
      25 degrees Celsius.

config TEMPERATURE_POSIX
    bool "POSIX"
    default y if SOC_POSIX
    help
      Temperature driver for a native build (fixed value).

endif # TEMPERATURE
```

## drivers/timer/Kconfig
```kconfig
# SPDX-FileCopyrightText: 2026 Core Devices LLC
# SPDX-License-Identifier: Apache-2.0

menu "System timer"

config TIMER_ARM_SYSTICK
    bool "Arm SysTick"
    default y if SOC_QEMU
    depends on CPU_CORTEX_M
    help
      Clock event device on the Arm SysTick timer, counting CPU cycles. It
      stops in deep sleep.

config TIMER_QEMU
    bool "QEMU"
    default y if SOC_QEMU
    help
      Clock source on the 1 kHz counter of the QEMU RTC.

config TIMER_NRF5_RTC
    bool "Nordic nRF5 RTC"
    default y if SOC_NRF52
    help
      Clock source and clock event device on RTC1, counting the 32.768 kHz
      low-frequency clock. It keeps running in every sleep mode.

config TIMER_SF32LB_LPTIM
    bool "SiFli SF32LB LPTIM"
    default y if SOC_SF32LB52
    help
      Clock source and clock event device on LPTIM1, counting the calibrated
      RC10K low-power clock. It keeps running and wakes the CPU up in deep
      sleep.

config TIMER_POSIX
    bool "POSIX"
    default y if SOC_POSIX
    help
      Clock source and clock event device on the host monotonic clock.

endmenu
```

## drivers/touch/Kconfig
```kconfig
# SPDX-FileCopyrightText: 2026 Core Devices LLC
# SPDX-License-Identifier: Apache-2.0

menuconfig TOUCH
    bool "Touchscreen"
    select INPUT
    help
      Touchscreen Drivers

if TOUCH

config TOUCH_SHELL
    bool "Shell commands"
    default DRIVER_SHELL
    depends on SHELL
    help
      The touch shell command, to inspect the touchscreen and hold it
      powered up.

config TOUCH_CST816
    bool "Hynitron CST816"
    default DT_HAS_HYNITRON_CST816S_ENABLED
    select I2C
    select CST816_FW
    select PINCTRL
    help
      Support for the Hynitron CST816 touch controller.

config TOUCH_QEMU
    bool "QEMU Touchscreen"
    default DT_HAS_QEMU_PEBBLE_TOUCH_ENABLED
    depends on SOC_QEMU_PEBBLE
    help
      Support for the QEMU touchscreen peripheral.

config TOUCH_QEMU_IRQ_PRIO
    int "Interrupt priority"
    default 5
    depends on TOUCH_QEMU
    help
      Priority of the touchscreen interrupt.

config TOUCH_SDL
    bool "SDL mouse"
    default y if SOC_POSIX
    select SDL
    help
      Touchscreen driven by the mouse, through SDL, in a native build.

if TOUCH_SDL

config TOUCH_SDL_SIZE_X
    int "SDL touchscreen X coordinates"
    default DISPLAY_SDL_WIDTH if DISPLAY_SDL
    help
      Number of X coordinates the SDL touchscreen reports.

config TOUCH_SDL_SIZE_Y
    int "SDL touchscreen Y coordinates"
    default DISPLAY_SDL_HEIGHT if DISPLAY_SDL
    help
      Number of Y coordinates the SDL touchscreen reports.

endif # TOUCH_SDL

module = DRIVER_TOUCH
module-str = Touchscreen
source "subsys/logging/Kconfig.template.log_level"

endif # TOUCH
```
