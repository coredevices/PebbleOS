## drivers/uart/Kconfig
```kconfig
# SPDX-FileCopyrightText: 2026 Core Devices LLC
# SPDX-License-Identifier: Apache-2.0

menuconfig UART
    bool "UART"
    help
      UART Drivers

if UART

config UART_NRF5
    bool "Nordic nRF5 UART Controller"
    default DT_HAS_NORDIC_NRF52832_UARTE_ENABLED
    depends on SOC_NRF52
    select GPIO
    help
      Support for the Nordic nRF5 UART controller.

config UART_NRF5_IRQ_PRIO
    int "Interrupt priority"
    default 7
    depends on UART_NRF5
    help
      Priority of the port interrupts.

config UART_NRF5_RX_TIMER
    int "TIMER instance counting received bytes"
    default 2
    range 0 4
    depends on UART_NRF5
    help
      The TIMER the driver counts received bytes with, so only one port
      can receive.

config UART_SF32LB
    bool "SiFli SF32LB UART Controller"
    default y if SOC_SF32LB52
    depends on SOC_SF32LB52
    select CLK
    select DMA
    select PINCTRL
    help
      Support for the SiFli SF32LB UART controller.

config UART_SF32LB_IRQ_PRIO
    int "Interrupt priority"
    default 5
    depends on UART_SF32LB
    help
      Priority of the port interrupts.

config UART_QEMU
    bool "QEMU Simple UART"
    default DT_HAS_QEMU_PEBBLE_SIMPLE_UART_ENABLED
    depends on SOC_QEMU_PEBBLE
    help
      Support for the QEMU simple UART peripheral.

config UART_QEMU_IRQ_PRIO
    int "Interrupt priority"
    default 5
    depends on UART_QEMU
    help
      Priority of the port interrupts.

config UART_POSIX
    bool "POSIX UART"
    default y if SOC_POSIX
    help
      UART backed by a host file descriptor.

config UART_SHELL
    bool "Shell commands"
    default DRIVER_SHELL
    depends on SHELL
    help
      The uart shell command, to list the ports, change their line
      settings and send text.

module = DRIVER_UART
module-str = UART
source "subsys/logging/Kconfig.template.log_level"

endif # UART
```

## drivers/vibe/Kconfig
```kconfig
# SPDX-FileCopyrightText: 2026 Core Devices LLC
# SPDX-License-Identifier: Apache-2.0

menuconfig VIBE
    bool "Vibration Motor"
    help
      Vibration Motor Drivers

if VIBE

config VIBE_SHELL
    bool "Shell commands"
    default DRIVER_SHELL
    depends on SHELL
    help
      The vibe shell command, to drive and calibrate the motor.

config VIBE_AW86225
    bool "Awinic AW86225"
    default DT_HAS_AWINIC_AW86225_ENABLED
    select I2C
    select REGULATOR
    help
      Support for the Awinic AW86225 haptic driver.

config VIBE_AW8623X
    bool "Awinic AW86233"
    default DT_HAS_AWINIC_AW86233_ENABLED
    select I2C
    select REGULATOR
    help
      Support for the Awinic AW86233 haptic driver.

config VIBE_DRV2604
    bool "TI DRV2604"
    default DT_HAS_TI_DRV2604_ENABLED
    select I2C
    help
      Support for the TI DRV2604 haptic driver.

config VIBE_SIM
    bool "Simulator"
    default y if SOC_QEMU_PEBBLE || SOC_POSIX
    help
      Simulated vibration motor, reporting its state through its
      simulator API (pbl/drivers/vibe/sim.h).

module = DRIVER_VIBE
module-str = Vibration Motor
source "subsys/logging/Kconfig.template.log_level"

endif # VIBE
```

## drivers/watchdog/Kconfig
```kconfig
# SPDX-FileCopyrightText: 2026 Core Devices LLC
# SPDX-License-Identifier: Apache-2.0

menuconfig WATCHDOG
    bool "Watchdog"
    help
      Watchdog Drivers

if WATCHDOG

config WATCHDOG_TIMEOUT_MS
    int "Timeout in milliseconds"
    default 8000 if WATCHDOG_NRF5
    default 30000
    help
      Time without a feed after which the hardware watchdog resets the
      system. The task watchdog feeds it on every check.

      The nRF5 watchdog cannot be reconfigured once running, and the
      bootloader starts it: there this must match the bootloader timeout.

config WATCHDOG_NRF5
    bool "Nordic nRF5"
    default y if SOC_NRF52
    help
      Support for the Nordic nRF5 watchdog.

config WATCHDOG_RUNS_WHILE_HALTED
    bool
    help
      The watchdog keeps counting while a debugger has the CPU stopped,
      so the task watchdog stops it while one is attached.

config WATCHDOG_SF32LB
    bool "SiFli SF32LB"
    default y if SOC_SF32LB52
    select WATCHDOG_RUNS_WHILE_HALTED
    help
      Support for the SiFli SF32LB watchdog.

config WATCHDOG_QEMU
    bool "QEMU Watchdog"
    default y if SOC_QEMU
    help
      Support for the CMSDK APB watchdog of the QEMU Pebble machines.

endif # WATCHDOG
```

## dts/bindings/arm/nordic.yaml
```yaml
# SPDX-License-Identifier: (GPL-2.0-only OR BSD-2-Clause)
%YAML 1.2
---
$id: http://devicetree.org/schemas/arm/nordic.yaml#
$schema: http://devicetree.org/meta-schemas/core.yaml#

title: Nordic SoC based boards

maintainers:
  - Gerard Marull-Paretas <gerard@teslabs.com>

properties:
  $nodename:
    const: "/"
  compatible:
    oneOf:
      - description: Core Devices Pebble 2 Duo (asterix)
        items:
          - const: coredevices,asterix
          - const: nordic,nrf52840

additionalProperties: true
```

## dts/bindings/arm/qemu-pebble.yaml
```yaml
# SPDX-License-Identifier: (GPL-2.0-only OR BSD-2-Clause)
%YAML 1.2
---
$id: http://devicetree.org/schemas/arm/qemu-pebble.yaml#
$schema: http://devicetree.org/meta-schemas/core.yaml#

title: QEMU Pebble machines

maintainers:
  - Gerard Marull-Paretas <gerard@teslabs.com>

properties:
  $nodename:
    const: "/"
  compatible:
    enum:
      - qemu,pebble-emery
      - qemu,pebble-flint
      - qemu,pebble-gabbro

additionalProperties: true
```

## dts/bindings/arm/sifli.yaml
```yaml
# SPDX-License-Identifier: (GPL-2.0-only OR BSD-2-Clause)
%YAML 1.2
---
$id: http://devicetree.org/schemas/arm/sifli.yaml#
$schema: http://devicetree.org/meta-schemas/core.yaml#

title: SiFli SoC based boards

maintainers:
  - Gerard Marull-Paretas <gerard@teslabs.com>

properties:
  $nodename:
    const: "/"
  compatible:
    oneOf:
      - description: Core Devices Pebble Time 2 (obelix)
        items:
          - enum:
              - coredevices,obelix-bb2
              - coredevices,obelix-dvt
              - coredevices,obelix-pvt
          - const: coredevices,obelix
          - const: sifli,sf32lb52

additionalProperties: true
```
