## dts/bindings/clock/nordic,nrf54l15-clock.yaml
```yaml
# SPDX-License-Identifier: (GPL-2.0-only OR BSD-2-Clause)
%YAML 1.2
---
$id: http://devicetree.org/schemas/clock/nordic,nrf54l15-clock.yaml#
$schema: http://devicetree.org/meta-schemas/core.yaml#

title: Nordic nRF54L clock control

maintainers:
  - Gerard Marull-Paretas <gerard@teslabs.com>

description: |
  Runs the two clocks of the system:

  - HFCLK, the clock of the peripherals, from the internal RC oscillator, or
    from the HFXO crystal oscillator while a consumer asks for it;
  - LFCLK, the 32768 Hz clock of the GRTC, from the LFXO crystal oscillator.

  It shares its registers and interrupt with the power and reset control
  blocks. The load capacitors of the crystals are in the oscillators block, and
  their values follow the trims in the FICR. Clock specifiers take one cell, an
  ID from <dt-bindings/clock/nordic,nrf54l15-clock.h>.

properties:
  compatible:
    oneOf:
      - const: nordic,nrf54l15-clock
      - items:
          - const: nordic,nrf54lm20a-clock
          - const: nordic,nrf54l15-clock

  reg:
    maxItems: 1

  interrupts:
    maxItems: 1

  '#clock-cells':
    const: 1

  clocks:
    minItems: 1
    items:
      - description: 32 MHz crystal
      - description: 32768 Hz crystal, if fitted

  clock-names:
    minItems: 1
    items:
      - const: hfxo
      - const: lfxo

  nordic,oscillators:
    $ref: /schemas/types.yaml#/definitions/phandle
    description: Oscillators block, with the load capacitors of the crystals.

  nvmem-cells:
    items:
      - description: FICR trim of the load capacitors of the 32 MHz crystal
      - description: FICR trim of the load capacitors of the 32768 Hz crystal

  nvmem-cell-names:
    items:
      - const: hfxo-trim
      - const: lfxo-trim

  nordic,hfxo-load-capacitance-femtofarads:
    description:
      Internal load capacitance of the 32 MHz crystal, from 4000 to 17000 fF
      in steps of 250 fF. Without it, the internal capacitors are left off.
    minimum: 4000
    maximum: 17000

  nordic,lfxo-load-capacitance-femtofarads:
    description:
      Internal load capacitance of the 32768 Hz crystal, from 4000 to 18000
      fF in steps of 500 fF. Without it, the internal capacitors are left off.
    minimum: 4000
    maximum: 18000

required:
  - compatible
  - reg
  - interrupts
  - '#clock-cells'
  - clocks
  - clock-names
  - nordic,oscillators
  - nvmem-cells
  - nvmem-cell-names

additionalProperties: false

examples:
  - |
    clock-controller@5010e000 {
        compatible = "nordic,nrf54l15-clock";
        reg = <0x5010e000 0x1000>;
        interrupts = <261>;
        #clock-cells = <1>;
        clocks = <&hfxo>, <&lfxo>;
        clock-names = "hfxo", "lfxo";
        nordic,oscillators = <&oscillators>;
        nvmem-cells = <&hfxo_trim>, <&lfxo_trim>;
        nvmem-cell-names = "hfxo-trim", "lfxo-trim";
        nordic,hfxo-load-capacitance-femtofarads = <15000>;
        nordic,lfxo-load-capacitance-femtofarads = <17000>;
    };
```

## dts/bindings/connector/arduino,uno-r3-header.yaml
```yaml
# SPDX-License-Identifier: (GPL-2.0-only OR BSD-2-Clause)
%YAML 1.2
---
$id: http://devicetree.org/schemas/connector/arduino,uno-r3-header.yaml#
$schema: http://devicetree.org/meta-schemas/core.yaml#

title: Arduino Uno R3 header

maintainers:
  - Gerard Marull-Paretas <gerard@teslabs.com>

description: |
  The Arduino Uno R3 header of a development kit, which shields plug into:
  analog pins A0 to A5 and digital pins D0 to D15, as numbered in
  dt-bindings/connector/arduino,uno-r3-header.h, an I2C bus on D14 (SDA) and
  D15 (SCL), a SPI bus on D10 (CS) to D13 (SCK), and a UART on D0 (RX) and
  D1 (TX).

  The node maps the pins to those of the board, so that a shield refers to
  the header alone; its interrupt-map, when the board gives one, has an entry
  for each trigger a pin takes. The board labels the I2C controller
  arduino_i2c, the SPI controller arduino_spi and the UART arduino_serial,
  with their pins set and left disabled for shields to enable.

allOf:
  - $ref: /schemas/gpio/gpio-nexus-node.yaml#

properties:
  compatible:
    const: arduino,uno-r3-header

  '#address-cells':
    const: 0

  '#interrupt-cells':
    const: 2

  interrupt-map: true

  io-channels:
    maxItems: 6
    description: ADC channels of A0 to A5, in that order.

  io-channel-names:
    items:
      - const: a0
      - const: a1
      - const: a2
      - const: a3
      - const: a4
      - const: a5

required:
  - compatible
  - '#gpio-cells'
  - gpio-map

unevaluatedProperties: false

examples:
  - |
    #include <dt-bindings/connector/arduino,uno-r3-header.h>
    connector {
        compatible = "arduino,uno-r3-header";
        #gpio-cells = <2>;
        gpio-map-mask = <0xffffffff 0x0>;
        gpio-map-pass-thru = <0x0 0xffffffff>;
        gpio-map = <ARDUINO_UNO_R3_A0 0 &gpio0 3 0>,
                   <ARDUINO_UNO_R3_D0 0 &gpio1 1 0>;
    };
```
