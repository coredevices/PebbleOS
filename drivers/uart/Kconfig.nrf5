## drivers/uart/Kconfig.nrf5
```kconfig
# SPDX-FileCopyrightText: 2026 Core Devices LLC
# SPDX-License-Identifier: Apache-2.0

config UART_NRF5
    bool "Nordic nRF5 UART controller"
    default y
    depends on DT_HAS_NORDIC_NRF52832_UARTE_ENABLED
    select GPIO
    help
      Support for the Nordic nRF5 UART controller.

config UART_NRF5_IRQ_PRIO
    int "Interrupt priority"
    default 1
    depends on UART_NRF5
    help
      Priority of the port interrupts.
```

## drivers/uart/Kconfig.nrf54l
```kconfig
# SPDX-FileCopyrightText: 2026 Core Devices LLC
# SPDX-License-Identifier: Apache-2.0

config UART_NRF54L
    bool "Nordic nRF54L UART controller"
    default y
    depends on DT_HAS_NORDIC_NRF54L15_UARTE_ENABLED
    select GPIO
    help
      Support for the Nordic nRF54L UART controller.

config UART_NRF54L_IRQ_PRIO
    int "Interrupt priority"
    default 1
    depends on UART_NRF54L
    help
      Priority of the port interrupts.
```

## drivers/uart/Kconfig.posix
```kconfig
# SPDX-FileCopyrightText: 2026 Core Devices LLC
# SPDX-License-Identifier: Apache-2.0

config UART_POSIX
    bool "POSIX UART"
    default y
    depends on SOC_POSIX
    help
      UART backed by a host file descriptor.

config UART_POSIX_BT_HCI
    bool "Bluetooth HCI port"
    default y
    depends on UART_POSIX
    help
      Port for a host Bluetooth controller, attached with the -b option.
```

## drivers/uart/Kconfig.qemu
```kconfig
# SPDX-FileCopyrightText: 2026 Core Devices LLC
# SPDX-License-Identifier: Apache-2.0

config UART_QEMU
    bool "QEMU simple UART"
    default y
    depends on DT_HAS_QEMU_PEBBLE_SIMPLE_UART_ENABLED
    help
      Support for the QEMU simple UART peripheral.

config UART_QEMU_IRQ_PRIO
    int "Interrupt priority"
    default 0
    depends on UART_QEMU
    help
      Priority of the port interrupts.
```

## drivers/uart/Kconfig.rtt
```kconfig
# SPDX-FileCopyrightText: 2026 Core Devices LLC
# SPDX-License-Identifier: Apache-2.0

config UART_RTT
    bool "SEGGER RTT serial port"
    select RTT
    help
      Serial port over a channel of the SEGGER RTT control block, which a
      debug probe reads and writes over SWD (pbl/drivers/uart/rtt.h).

if UART_RTT

config UART_RTT_CHANNEL
    int "RTT channel"
    default 0
    help
      Up and down channel of the port; 0 is the terminal.

config UART_RTT_POLL_MS
    int "Receive poll period, in milliseconds"
    default 20
    help
      Received bytes are polled this often while reception is enabled,
      which keeps the system out of its deepest idle states meanwhile.

config UART_RTT_FLUSH_TIMEOUT_MS
    int "Longest flush from an interrupt, in milliseconds"
    default 1000
    help
      How long a flush from an interrupt, as the fault handler's before a
      reboot, waits for a probe seen reading to empty the channel.

endif # UART_RTT
```

## drivers/uart/Kconfig.sf32lb
```kconfig
# SPDX-FileCopyrightText: 2026 Core Devices LLC
# SPDX-License-Identifier: Apache-2.0

config UART_SF32LB
    bool "SiFli SF32LB UART controller"
    default y
    depends on DT_HAS_SIFLI_SF32LB52_USART_ENABLED
    select CLK
    select DMA
    select PINCTRL
    help
      Support for the SiFli SF32LB UART controller.

config UART_SF32LB_IRQ_PRIO
    int "Interrupt priority"
    default 0
    depends on UART_SF32LB
    help
      Priority of the port interrupts.
```

## drivers/uart/Kconfig.stm32
```kconfig
# SPDX-FileCopyrightText: 2026 Core Devices LLC
# SPDX-License-Identifier: Apache-2.0

config UART_STM32
    bool "ST STM32 UART Controller"
    default y
    depends on DT_HAS_ST_STM32H7_UART_ENABLED
    select CLK
    select DMA
    select PINCTRL
    help
      Support for the ST STM32H7 USART and UART controllers.

config UART_STM32_IRQ_PRIO
    int "Interrupt priority"
    default 0
    depends on UART_STM32
    help
      Priority of the port interrupts.
```

## drivers/udc/Kconfig
```kconfig
# SPDX-FileCopyrightText: 2026 Core Devices LLC
# SPDX-License-Identifier: Apache-2.0

menuconfig UDC
    bool "USB device controllers"
    help
      USB device controller class (pbl/drivers/udc.h), selected by the USB
      device stack.

if UDC

rsource "Kconfig.nrf5"

config UDC_VBUS_CHARGER
    bool
    default y
    depends on CHARGER
    help
      Sense USB power through the charger a controller's vbus-charger
      property points to.

rsource "Kconfig.musb"
rsource "Kconfig.dwc2"

module = DRIVER_UDC
module-str = USB device controller
source "subsys/logging/Kconfig.template.log_level"

endif # UDC
```

## drivers/udc/Kconfig.dwc2
```kconfig
# SPDX-FileCopyrightText: 2026 Core Devices LLC
# SPDX-License-Identifier: Apache-2.0

config UDC_DWC2
    bool "Synopsys DesignWare USB 2.0 OTG (DWC2)"
    default y
    depends on DT_HAS_ST_STM32F7_HSOTG_ENABLED || DT_HAS_NORDIC_NRF54LM20A_USBHS_ENABLED
    select CLK
    select PHY
    select PINCTRL
    select REGULATOR
    help
      Device mode of the DesignWare USB 2.0 OTG controller, by DMA, or
      through its FIFOs on cores without it: the USB OTG HS of the STM32F7
      and STM32H7, with an external ULPI PHY at high speed or its internal
      PHY at full speed, and the USBHS of the nRF54LM20A, with its UTMI+ PHY
      at high speed. With a PHY that senses VBUS, the core is powered only
      while VBUS is present.

config UDC_DWC2_IRQ_PRIO
    int "Interrupt priority"
    default 0
    depends on UDC_DWC2
    help
      Priority of the controller interrupt.
```

## drivers/udc/Kconfig.musb
```kconfig
# SPDX-FileCopyrightText: 2026 Core Devices LLC
# SPDX-License-Identifier: Apache-2.0

config UDC_MUSB
    bool "Mentor Graphics MUSB"
    default y
    depends on DT_HAS_SIFLI_SF32LB57_USB_ENABLED
    select CLK
    select PINCTRL
    help
      Device mode of the Mentor Graphics MUSB controller, as the USB
      controller of the SiFli SF32LB57, at full speed, through its FIFOs.

config UDC_MUSB_IRQ_PRIO
    int "Interrupt priority"
    default 0
    depends on UDC_MUSB
    help
      Priority of the controller interrupt.
```

## drivers/udc/Kconfig.nrf5
```kconfig
# SPDX-FileCopyrightText: 2026 Core Devices LLC
# SPDX-License-Identifier: Apache-2.0

config UDC_NRF5
    bool "Nordic nRF5 USBD"
    default y
    depends on DT_HAS_NORDIC_NRF52840_USBD_ENABLED
    select CLK
    help
      USB device controller of the Nordic nRF52840, at full speed, moving
      packets through EasyDMA, connected while VBUS powers its regulator.

config UDC_NRF5_IRQ_PRIO
    int "Interrupt priority"
    default 0
    depends on UDC_NRF5
    help
      Priority of the USBD and POWER interrupts.
```

## drivers/vibe/Kconfig
```kconfig
# SPDX-FileCopyrightText: 2026 Core Devices LLC
# SPDX-License-Identifier: Apache-2.0

menuconfig VIBE
    bool "Vibration motor"
    help
      Vibration motor class (pbl/drivers/vibe.h) and its drivers.

if VIBE

config VIBE_SHELL
    bool "Shell commands"
    default DRIVER_SHELL
    depends on SHELL
    help
      The vibe shell command, to drive and calibrate the motor.

rsource "Kconfig.aw86225"
rsource "Kconfig.aw8623x"
rsource "Kconfig.drv2604"
rsource "Kconfig.sim"

module = DRIVER_VIBE
module-str = Vibration motor
source "subsys/logging/Kconfig.template.log_level"

endif # VIBE
```

## drivers/vibe/Kconfig.aw86225
```kconfig
# SPDX-FileCopyrightText: 2026 Core Devices LLC
# SPDX-License-Identifier: Apache-2.0

config VIBE_AW86225
    bool "Awinic AW86225"
    default y
    depends on DT_HAS_AWINIC_AW86225_ENABLED
    select GPIO
    select I2C
    select REGULATOR
    help
      Support for the Awinic AW86225 haptic driver.
```

## drivers/vibe/Kconfig.aw8623x
```kconfig
# SPDX-FileCopyrightText: 2026 Core Devices LLC
# SPDX-License-Identifier: Apache-2.0

config VIBE_AW8623X
    bool "Awinic AW86233"
    default y
    depends on DT_HAS_AWINIC_AW86233_ENABLED
    select I2C
    select REGULATOR
    help
      Support for the Awinic AW86233 haptic driver.
```

## drivers/vibe/Kconfig.drv2604
```kconfig
# SPDX-FileCopyrightText: 2026 Core Devices LLC
# SPDX-License-Identifier: Apache-2.0

config VIBE_DRV2604
    bool "TI DRV2604"
    default y
    depends on DT_HAS_TI_DRV2604_ENABLED
    select I2C
    help
      Support for the TI DRV2604 haptic driver.
```

## drivers/vibe/Kconfig.sim
```kconfig
# SPDX-FileCopyrightText: 2026 Core Devices LLC
# SPDX-License-Identifier: Apache-2.0

config VIBE_SIM
    bool "Simulator"
    default y
    depends on SOC_QEMU_PEBBLE || SOC_POSIX
    help
      Simulated vibration motor, reporting its state through its
      simulator API (pbl/drivers/vibe/sim.h).
```

## drivers/watchdog/Kconfig
```kconfig
# SPDX-FileCopyrightText: 2026 Core Devices LLC
# SPDX-License-Identifier: Apache-2.0

menuconfig WATCHDOG
    bool "Watchdog"
    help
      Hardware watchdog class (pbl/drivers/watchdog.h) and its drivers.

if WATCHDOG

config WATCHDOG_TIMEOUT_MS
    int "Timeout in milliseconds"
    default 8000 if WATCHDOG_NRF5
    default 30000
    help
      Time without a feed after which the hardware watchdog resets the
      system. The task watchdog feeds it on every check.

      The nRF5 watchdog cannot be reconfigured once running, and the
      bootloader starts it: there this must match the bootloader timeout.

rsource "Kconfig.nrf5"

config WATCHDOG_CALLBACK
    bool
    help
      The watchdog interrupts before it resets, and reports it to the
      watchdog_set_callback() subscriber.

config WATCHDOG_RUNS_WHILE_HALTED
    bool
    help
      The watchdog keeps counting while a debugger has the CPU stopped,
      so the task watchdog stops it while one is attached.

rsource "Kconfig.sf32lb"
rsource "Kconfig.stm32_iwdg"
rsource "Kconfig.qemu"

endif # WATCHDOG
```

## drivers/watchdog/Kconfig.nrf5
```kconfig
# SPDX-FileCopyrightText: 2026 Core Devices LLC
# SPDX-License-Identifier: Apache-2.0

config WATCHDOG_NRF5
    bool "Nordic nRF5"
    default y
    depends on SOC_NRF52
    help
      Support for the Nordic nRF5 watchdog.
```

## drivers/watchdog/Kconfig.qemu
```kconfig
# SPDX-FileCopyrightText: 2026 Core Devices LLC
# SPDX-License-Identifier: Apache-2.0

config WATCHDOG_QEMU
    bool "QEMU watchdog"
    default y
    depends on SOC_QEMU_PEBBLE
    help
      Support for the CMSDK APB watchdog of the QEMU Pebble machines.
```

## drivers/watchdog/Kconfig.sf32lb
```kconfig
# SPDX-FileCopyrightText: 2026 Core Devices LLC
# SPDX-License-Identifier: Apache-2.0

config WATCHDOG_SF32LB
    bool "SiFli SF32LB"
    default y
    depends on DT_HAS_SIFLI_SF32LB52_WDT_ENABLED || DT_HAS_SIFLI_SF32LB57_IWDT_ENABLED
    depends on CLK_SF32LB52_PMUC || CLK_SF32LB57_PMUC
    select WATCHDOG_RUNS_WHILE_HALTED
    help
      Support for the SiFli SF32LB watchdog.
```

## drivers/watchdog/Kconfig.stm32_iwdg
```kconfig
# SPDX-FileCopyrightText: 2026 Core Devices LLC
# SPDX-License-Identifier: Apache-2.0

config WATCHDOG_STM32_IWDG
    bool "ST STM32 IWDG"
    default y
    depends on DT_HAS_ST_STM32_IWDG_ENABLED
    depends on CLK_STM32H7
    help
      Support for the ST STM32H7 independent watchdog.
```

## dts/bindings/arm/arm,cortex-m33.yaml
```yaml
# SPDX-License-Identifier: (GPL-2.0-only OR BSD-2-Clause)
%YAML 1.2
---
$id: http://devicetree.org/schemas/arm/arm,cortex-m33.yaml#
$schema: http://devicetree.org/meta-schemas/core.yaml#

title: ARM Cortex-M33 CPU

maintainers:
  - Gerard Marull-Paretas <gerard@teslabs.com>

description:
  The upstream ARM CPUs binding lists the Cortex-M cores up to the
  Cortex-M4. This one describes the Cortex-M33 the same way.

allOf:
  - $ref: /schemas/cpu.yaml#

properties:
  compatible:
    const: arm,cortex-m33

  reg:
    maxItems: 1

  cpu-idle-states:
    $ref: /schemas/types.yaml#/definitions/phandle-array
    items:
      maxItems: 1
    description:
      Idle states of the CPU, beyond the wait for interrupt, see
      /schemas/cpu/idle-states.yaml.

required:
  - compatible
  - device_type
  - reg

unevaluatedProperties: false

examples:
  - |
    cpus {
        #address-cells = <1>;
        #size-cells = <0>;

        cpu@0 {
            compatible = "arm,cortex-m33";
            device_type = "cpu";
            reg = <0>;
            cpu-idle-states = <&cpu_sleep>;
        };

        idle-states {
            cpu_sleep: cpu-sleep-0 {
                compatible = "arm,idle-state";
                entry-latency-us = <200>;
                exit-latency-us = <500>;
                min-residency-us = <10000>;
            };
        };
    };
```

## dts/bindings/arm/armchina,star-mc1.yaml
```yaml
# SPDX-License-Identifier: (GPL-2.0-only OR BSD-2-Clause)
%YAML 1.2
---
$id: http://devicetree.org/schemas/arm/armchina,star-mc1.yaml#
$schema: http://devicetree.org/meta-schemas/core.yaml#

title: Arm China STAR-MC1 CPU

maintainers:
  - Gerard Marull-Paretas <gerard@teslabs.com>

description:
  Armv8-M Mainline core with the DSP extension, compatible with the
  Cortex-M33.

allOf:
  - $ref: /schemas/cpu.yaml#

properties:
  compatible:
    const: armchina,star-mc1

  reg:
    maxItems: 1

  cpu-idle-states:
    $ref: /schemas/types.yaml#/definitions/phandle-array
    items:
      maxItems: 1
    description:
      Idle states of the CPU, beyond the wait for interrupt, see
      /schemas/cpu/idle-states.yaml.

required:
  - compatible
  - device_type
  - reg

unevaluatedProperties: false

examples:
  - |
    cpus {
        #address-cells = <1>;
        #size-cells = <0>;

        cpu@0 {
            compatible = "armchina,star-mc1";
            device_type = "cpu";
            reg = <0>;
            cpu-idle-states = <&cpu_sleep>;
        };

        idle-states {
            cpu_sleep: cpu-sleep-0 {
                compatible = "arm,idle-state";
                entry-latency-us = <200>;
                exit-latency-us = <500>;
                min-residency-us = <10000>;
            };
        };
    };
```
