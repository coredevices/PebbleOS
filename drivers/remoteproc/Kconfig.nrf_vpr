## drivers/remoteproc/Kconfig.nrf_vpr
```kconfig
# SPDX-FileCopyrightText: 2026 Core Devices LLC
# SPDX-License-Identifier: Apache-2.0

config REMOTEPROC_NRF_VPR
    bool "Nordic VPR"
    default y
    depends on DT_HAS_NORDIC_NRF54L15_VPR_ENABLED && SOC_NRF54L_CPUAPP
    help
      A VPR RISC-V core of an nRF54L, as the application core sees it:
      started from its firmware in the RRAM, with access to the secure
      peripherals.
```

## drivers/remoteproc/Kconfig.sf32lb
```kconfig
# SPDX-FileCopyrightText: 2026 Core Devices LLC
# SPDX-License-Identifier: Apache-2.0

config REMOTEPROC_SF32LB
    bool "SiFli SF32LB LCPU"
    default y
    depends on DT_HAS_SIFLI_SF32LB52_LCPU_ENABLED || DT_HAS_SIFLI_SF32LB57_LCPU_ENABLED
    select KERNEL_SYS_WORKQ
    select MBOX
    select NVMEM
    help
      The SF32LB52 and SF32LB57 low-power CPU, running the Bluetooth
      controller from ROM: configuration, ROM patches and radio
      calibration on boot.
```

## drivers/remoteproc/Kconfig.stm32h7_cm4
```kconfig
# SPDX-FileCopyrightText: 2026 Core Devices LLC
# SPDX-License-Identifier: Apache-2.0

config REMOTEPROC_STM32H7_CM4
    bool "STM32H7 Cortex-M4"
    default y
    depends on DT_HAS_ST_STM32H747_M4_ENABLED && CPU_CORTEX_M7
    select MBOX
    help
      The Cortex-M4 of a dual-core STM32H7, as the Cortex-M7 sees it:
      booted from the address of its option bytes, and told before the
      system powers off.
```

## drivers/reset/Kconfig
```kconfig
# SPDX-FileCopyrightText: 2026 Core Devices LLC
# SPDX-License-Identifier: Apache-2.0

menuconfig RESET
    bool "Reset controllers"
    help
      Reset controller class (pbl/drivers/reset.h), selected by the drivers
      that take reset lines.

if RESET

rsource "Kconfig.sf32lb"
rsource "Kconfig.stm32h7"

endif # RESET
```

## drivers/reset/Kconfig.sf32lb
```kconfig
# SPDX-FileCopyrightText: 2026 Core Devices LLC
# SPDX-License-Identifier: Apache-2.0

config RESET_SF32LB
    bool "SiFli SF32LB RCC"
    default y
    depends on DT_HAS_SIFLI_SF32LB52_HPSYS_RCC_ENABLED || DT_HAS_SIFLI_SF32LB57_HPSYS_RCC_ENABLED
    help
      Reset controller of the SiFli SF32LB52 and SF32LB57 HPSYS RCC.
```

## drivers/reset/Kconfig.stm32h7
```kconfig
# SPDX-FileCopyrightText: 2026 Core Devices LLC
# SPDX-License-Identifier: Apache-2.0

config RESET_STM32H7
    bool "STM32H7 RCC"
    default y
    depends on DT_HAS_ST_STM32H743_RCC_ENABLED
    help
      Reset controller of the STM32H7 RCC.
```

## drivers/rng/Kconfig
```kconfig
# SPDX-FileCopyrightText: 2026 Core Devices LLC
# SPDX-License-Identifier: Apache-2.0

menuconfig RNG
    bool "Random number generator"
    help
      Random number generator class (pbl/drivers/rng.h) and its drivers.

if RNG

rsource "Kconfig.nrf5"
rsource "Kconfig.nrf_cracen"
rsource "Kconfig.sf32lb"
rsource "Kconfig.stm32"
rsource "Kconfig.qemu"
rsource "Kconfig.posix"

config RNG_SHELL
    bool "Shell commands"
    default DRIVER_SHELL
    depends on SHELL
    help
      The rng shell command, to print random words and check their bit
      statistics.

module = DRIVER_RNG
module-str = Random number generator
source "subsys/logging/Kconfig.template.log_level"

endif # RNG
```

## drivers/rng/Kconfig.nrf5
```kconfig
# SPDX-FileCopyrightText: 2026 Core Devices LLC
# SPDX-License-Identifier: Apache-2.0

config RNG_NRF5
    bool "Nordic nRF5"
    default y
    depends on SOC_NRF52
    help
      Support for the Nordic nRF5 RNG.

config RNG_NRF5_IRQ_PRIO
    int "Interrupt priority"
    default 1
    depends on RNG_NRF5
    help
      Priority of the RNG interrupt.
```

## drivers/rng/Kconfig.nrf_cracen
```kconfig
# SPDX-FileCopyrightText: 2026 Core Devices LLC
# SPDX-License-Identifier: Apache-2.0

config RNG_NRF_CRACEN
    bool "Nordic nRF54L CRACEN"
    default y
    depends on DT_HAS_NORDIC_NRF54L15_CRACEN_ENABLED || DT_HAS_NORDIC_NRF54LM20A_CRACEN_ENABLED
    select MFD
    select MFD_NRF_CRACEN
    help
      Support for the true random number generator of the Nordic nRF54L
      CRACEN.
```

## drivers/rng/Kconfig.posix
```kconfig
# SPDX-FileCopyrightText: 2026 Core Devices LLC
# SPDX-License-Identifier: Apache-2.0

config RNG_POSIX
    bool "POSIX"
    default y
    depends on SOC_POSIX
    help
      Host random number generator.
```

## drivers/rng/Kconfig.qemu
```kconfig
# SPDX-FileCopyrightText: 2026 Core Devices LLC
# SPDX-License-Identifier: Apache-2.0

config RNG_QEMU
    bool "QEMU"
    default y
    depends on SOC_QEMU_PEBBLE
    help
      QEMU RNG. QEMU emulates no RNG, so it returns a fixed value.
```

## drivers/rng/Kconfig.sf32lb
```kconfig
# SPDX-FileCopyrightText: 2026 Core Devices LLC
# SPDX-License-Identifier: Apache-2.0

config RNG_SF32LB
    bool "SiFli SF32LB"
    default y
    depends on DT_HAS_SIFLI_SF32LB52_TRNG_ENABLED
    select CLK
    help
      Support for the SiFli SF32LB RNG.
```

## drivers/rng/Kconfig.stm32
```kconfig
# SPDX-FileCopyrightText: 2026 Core Devices LLC
# SPDX-License-Identifier: Apache-2.0

config RNG_STM32
    bool "ST STM32"
    default y
    depends on DT_HAS_ST_STM32_RNG_ENABLED
    select CLK
    help
      Support for the ST STM32 RNG.
```

## drivers/rtc/Kconfig
```kconfig
# SPDX-FileCopyrightText: 2026 Core Devices LLC
# SPDX-License-Identifier: Apache-2.0

menuconfig RTC
    bool "RTC"
    help
      Real-time clock drivers: hardware that keeps the wall clock across
      resets.

if RTC

config RTC_SHELL
    bool "RTC shell commands"
    default DRIVER_SHELL
    depends on SHELL
    help
      The rtc shell command, to read and set the RTC directly.

rsource "Kconfig.retained"
rsource "Kconfig.sf32lb"
rsource "Kconfig.stm32"
rsource "Kconfig.qemu"
rsource "Kconfig.posix"

endif # RTC
```

## drivers/rtc/Kconfig.posix
```kconfig
# SPDX-FileCopyrightText: 2026 Core Devices LLC
# SPDX-License-Identifier: Apache-2.0

config RTC_POSIX
    bool "POSIX RTC"
    default y
    depends on SOC_POSIX
    help
      RTC following the host clock.
```

## drivers/rtc/Kconfig.qemu
```kconfig
# SPDX-FileCopyrightText: 2026 Core Devices LLC
# SPDX-License-Identifier: Apache-2.0

config RTC_QEMU
    bool "QEMU RTC"
    default y
    depends on SOC_QEMU_PEBBLE
    help
      QEMU RTC, following the host clock.
```

## drivers/rtc/Kconfig.retained
```kconfig
# SPDX-FileCopyrightText: 2026 Core Devices LLC
# SPDX-License-Identifier: Apache-2.0

config RTC_RETAINED
    bool "Retained RAM"
    default y
    depends on SOC_NRF52_RETAINED_RAM
    help
      The time last set, kept in retained RAM, for SoCs without a calendar
      RTC. It survives resets but not power loss, and does not count while
      the system is off.
```

## drivers/rtc/Kconfig.sf32lb
```kconfig
# SPDX-FileCopyrightText: 2026 Core Devices LLC
# SPDX-License-Identifier: Apache-2.0

config RTC_SF32LB
    bool "SiFli SF32LB"
    default y
    depends on DT_HAS_SIFLI_SF32LB52_RTC_ENABLED
    select CLK
    help
      SiFli SF32LB calendar RTC, counting clk_rtc at its calibrated rate.
```

## drivers/rtc/Kconfig.stm32
```kconfig
# SPDX-FileCopyrightText: 2026 Core Devices LLC
# SPDX-License-Identifier: Apache-2.0

config RTC_STM32
    bool "STM32 RTC"
    default y
    depends on DT_HAS_ST_STM32H7_RTC_ENABLED
    select CLK
    help
      STM32H7 calendar RTC in the backup domain, counting the LSE across
      resets and in Standby, with alarm A, which wakes the system from
      Standby.

config RTC_STM32_IRQ_PRIO
    int "Alarm interrupt priority"
    default 0
    depends on RTC_STM32
```

## drivers/sdhc/Kconfig
```kconfig
# SPDX-FileCopyrightText: 2026 Core Devices LLC
# SPDX-License-Identifier: Apache-2.0

menuconfig SDHC
    bool "SD host controllers"
    help
      SD host controller class (pbl/drivers/sdhc.h), selected by the SD
      card stack.

if SDHC

config SDHC_STM32_SDMMC
    bool "STM32 SDMMC"
    default y
    depends on DT_HAS_ARM_PL18X_ENABLED
    select CLK
    select PINCTRL
    select GPIO
    help
      The SDMMC of the STM32H7, an ARM PL18x variant, moving the data with
      its internal DMA, or through its FIFO by the CPU for the buffers the
      DMA does not take.

config SDHC_STM32_SDMMC_IRQ_PRIO
    int "Interrupt priority"
    default 12
    depends on SDHC_STM32_SDMMC

config SDHC_SF32LB_SDMMC
    bool "SiFli SF32LB57 SDMMC"
    default y
    depends on DT_HAS_SIFLI_SF32LB57_SDMMC_ENABLED
    select CLK
    select DMA
    select PINCTRL
    select GPIO
    help
      The SDMMC of the SF32LB57, its data moved through its FIFO of one
      block by a DMA channel when the devicetree gives one, many blocks in
      a command, or by the CPU, a block at a time, for the buffers the DMA
      does not take.

config SDHC_SF32LB_SDMMC_IRQ_PRIO
    int "Interrupt priority"
    default 6
    depends on SDHC_SF32LB_SDMMC

endif # SDHC
```

## drivers/sensor/Kconfig
```kconfig
# SPDX-FileCopyrightText: 2026 Core Devices LLC
# SPDX-License-Identifier: Apache-2.0

menu "Sensors"

config SENSOR
    bool "Sensor class"
    select KERNEL_SYS_WORKQ_HIGH
    help
      Sensor class (pbl/drivers/sensor.h): accelerometers, gyroscopes,
      magnetometers, temperature and pressure sensors. Selected by the
      sensor type menus below.

if SENSOR

config SENSOR_SHELL
    bool "Shell commands"
    default DRIVER_SHELL
    depends on SHELL
    help
      The sensor shell command, to list the sensors, read them and set
      their attributes.

module = DRIVER_SENSOR
module-str = Sensor
source "subsys/logging/Kconfig.template.log_level"

endif # SENSOR

menuconfig ACCEL
    bool "Accelerometers"
    select SENSOR
    help
      Accelerometer drivers. The board's accelerometer is the accel role,
      ACCEL.

if ACCEL

rsource "Kconfig.lis2dw12"
rsource "Kconfig.lsm6dso"
rsource "Kconfig.accel_sim"

endif # ACCEL

menuconfig TEMP
    bool "Temperature sensors"
    select SENSOR
    help
      Temperature sensor drivers. The board's die temperature sensor is
      the die_temp role, TEMP.

if TEMP

rsource "Kconfig.temp_nrf5"
rsource "Kconfig.temp_sf32lb"
rsource "Kconfig.temp_stm32h7_adc"
rsource "Kconfig.temp_sim"

endif # TEMP

menuconfig MAG
    bool "Magnetometers"
    select SENSOR
    help
      Magnetometer drivers. The board's magnetometer is the mag role,
      MAG.

if MAG

rsource "Kconfig.mmc5603nj"
rsource "Kconfig.mag_sim"

endif # MAG

menuconfig PRESSURE
    bool "Pressure sensors"
    select SENSOR
    help
      Barometric pressure sensor drivers. The board's pressure sensor is
      the pressure role, PRESSURE.

if PRESSURE

rsource "Kconfig.bmp390"

endif # PRESSURE

endmenu
```

## drivers/sensor/Kconfig.bmp390
```kconfig
# SPDX-FileCopyrightText: 2026 Core Devices LLC
# SPDX-License-Identifier: Apache-2.0

config PRESSURE_BMP390
    bool "Bosch BMP380 and BMP390"
    default y
    depends on DT_HAS_BOSCH_BMP380_ENABLED
    select I2C
    help
      Support for the Bosch BMP380 and BMP390 barometric pressure sensors
      (devicetree compatible bosch,bmp380).
```

## drivers/sensor/Kconfig.lis2dw12
```kconfig
# SPDX-FileCopyrightText: 2026 Core Devices LLC
# SPDX-License-Identifier: Apache-2.0

config ACCEL_LIS2DW12
    bool "ST LIS2DW12"
    default y
    depends on DT_HAS_ST_LIS2DW12_ENABLED
    select I2C
    select KERNEL_SYS_WORKQ_HIGH
    help
      Support for the ST LIS2DW12 accelerometer.

if ACCEL_LIS2DW12

config ACCEL_LIS2DW12_WK_DUR_DEFAULT
    int "Default wake duration"
    range 0 3
    default 0
    help
      Default wake duration applied at init.

config ACCEL_LIS2DW12_WK_THS_MIN
    int "Minimum wake threshold"
    range 0 63
    default 0
    help
      Minimum (highest sensitivity) wake-up threshold.

config ACCEL_LIS2DW12_WK_THS_MAX
    int "Maximum wake threshold"
    range 0 63
    default 63
    help
      Maximum (lowest sensitivity) wake-up threshold.

config ACCEL_LIS2DW12_WK_THS_DEFAULT
    int "Default wake threshold"
    range 0 63
    default 0
    help
      Default wake-up threshold applied at init.

config ACCEL_LIS2DW12_SCALE_MG
    int "Full-scale range (mg)"
    default 2000
    help
      Acceleration full-scale range in mg (2000, 4000, 8000 or 16000).

endif # ACCEL_LIS2DW12
```

## drivers/sensor/Kconfig.temp_sim
```kconfig
# SPDX-FileCopyrightText: 2026 Core Devices LLC
# SPDX-License-Identifier: Apache-2.0

config TEMP_SIM
    bool "Simulator"
    default y
    depends on SOC_QEMU_PEBBLE || SOC_POSIX
    help
      Simulated temperature sensor, reading a value set through its
      simulator API (pbl/drivers/sensor/sim.h).
```

## drivers/sensor/Kconfig.temp_stm32h7_adc
```kconfig
# SPDX-FileCopyrightText: 2026 Core Devices LLC
# SPDX-License-Identifier: Apache-2.0

config TEMP_STM32H7_ADC
    bool "STM32H7 temperature sensor"
    default y
    depends on DT_HAS_ST_STM32H7_ADC_ENABLED
    select ADC
    select NVMEM
    help
      The temperature sensor on ADC3 of the STM32H7, read against VREFINT
      with its factory calibration.
```
