## drivers/display/Kconfig.sf32lb57_lcdc
```kconfig
# SPDX-FileCopyrightText: 2026 Core Devices LLC
# SPDX-License-Identifier: Apache-2.0

config DISPLAY_SF32LB57_LCDC
    bool "SiFli SF32LB57 LCD controller"
    default y
    depends on DT_HAS_SIFLI_SF32LB57_LCDC_ENABLED
    select CLK
    select KERNEL_SYS_WORKQ
    select MIPI_DBI
    select PANEL
    select PINCTRL
    select RESET
    help
      Support for the SiFli SF32LB57 LCD controller, driving a panel with
      frame memory over quad SPI, or a JDI memory-in-pixel panel on the JDI
      parallel interface.

config DISPLAY_SF32LB57_LCDC_QSPI
    def_bool y
    depends on DISPLAY_SF32LB57_LCDC && PANEL_QSPI
    help
      Quad SPI, built with a driver of a panel on it.

config DISPLAY_SF32LB57_LCDC_JDI
    def_bool y
    depends on DISPLAY_SF32LB57_LCDC && PANEL_JDI_PARALLEL
    help
      The JDI parallel interface, built with a driver of a panel on it.

config DISPLAY_SF32LB57_LCDC_IRQ_PRIO
    int "Interrupt priority"
    default 0
    depends on DISPLAY_SF32LB57_LCDC
    help
      Priority of the controller interrupt.

choice DISPLAY_SF32LB57_LCDC_FORMAT
    prompt "Framebuffer format"
    default DISPLAY_SF32LB57_LCDC_FORMAT_ARGB2222
    depends on DISPLAY_SF32LB57_LCDC
    help
      Format of the framebuffers the display takes, whatever the one its
      panel is written in.

config DISPLAY_SF32LB57_LCDC_FORMAT_ARGB2222
    bool "ARGB2222"
    help
      8 bits per pixel, the Pebble color format.

config DISPLAY_SF32LB57_LCDC_FORMAT_RGB565
    bool "RGB565"
    help
      16 bits per pixel.

endchoice
```

## drivers/display/Kconfig.sf32lb_lcdc
```kconfig
# SPDX-FileCopyrightText: 2026 Core Devices LLC
# SPDX-License-Identifier: Apache-2.0

config DISPLAY_SF32LB_LCDC
    bool "SiFli SF32LB LCD controller"
    default y
    depends on DT_HAS_SIFLI_SF32LB52_LCDC_ENABLED
    select CLK
    select PANEL
    select PINCTRL
    select RESET
    help
      Support for the SiFli SF32LB LCD controller, driving a JDI
      memory-in-pixel panel.

config DISPLAY_SF32LB_LCDC_IRQ_PRIO
    int "Interrupt priority"
    default 0
    depends on DISPLAY_SF32LB_LCDC
    help
      Priority of the controller interrupt.
```

## drivers/display/Kconfig.sharp_memory
```kconfig
# SPDX-FileCopyrightText: 2026 Core Devices LLC
# SPDX-License-Identifier: Apache-2.0

config DISPLAY_SHARP_MEMORY
    bool "Sharp memory LCDs"
    default y
    depends on DT_HAS_SHARP_LS010B7DH04_ENABLED || \
               DT_HAS_SHARP_LS011B7DH03_ENABLED || \
               DT_HAS_SHARP_LS012B7DD01_ENABLED || \
               DT_HAS_SHARP_LS013B7DH01_ENABLED || \
               DT_HAS_SHARP_LS013B7DH03_ENABLED || \
               DT_HAS_SHARP_LS013B7DH05_ENABLED || \
               DT_HAS_SHARP_LS027B7DH01_ENABLED || \
               DT_HAS_SHARP_LS027B7DH01A_ENABLED || \
               DT_HAS_SHARP_LS044Q7DH01_ENABLED
    select GPIO
    select PWM
    select SPI
    help
      Support for the Sharp memory LCDs addressing their lines with 8 bits:
      LS010B7DH04, LS011B7DH03, LS012B7DD01, LS013B7DH01, LS013B7DH03,
      LS013B7DH05, LS027B7DH01, LS027B7DH01A and LS044Q7DH01.
```

## drivers/display/Kconfig.stm32_ltdc
```kconfig
# SPDX-FileCopyrightText: 2026 Core Devices LLC
# SPDX-License-Identifier: Apache-2.0

config DISPLAY_STM32_LTDC
    bool "ST STM32 LTDC"
    default y
    depends on DT_HAS_ST_STM32_LTDC_ENABLED
    select CLK
    select DISPLAY_BRIDGE
    select PANEL
    help
      Support for the STM32 LCD-TFT display controller, sending frames
      through a DSI host in adapted command mode to a panel with frame
      memory.
```

## drivers/display_bridge/Kconfig
```kconfig
# SPDX-FileCopyrightText: 2026 Core Devices LLC
# SPDX-License-Identifier: Apache-2.0

config DISPLAY_BRIDGE
    bool
    help
      Display bridge class (pbl/drivers/display_bridge.h), selected by
      the bridges display controllers send their pixels through, and by
      the controllers using them.
```

## drivers/dma/Kconfig
```kconfig
# SPDX-FileCopyrightText: 2026 Core Devices LLC
# SPDX-License-Identifier: Apache-2.0

menuconfig DMA
    bool "DMA controllers"
    help
      DMA controller class (pbl/drivers/dma.h), selected by the drivers
      that move data through DMA channels.

if DMA

rsource "Kconfig.sf32lb"
rsource "Kconfig.stm32h7"
rsource "Kconfig.stm32h7_bdma"

endif # DMA
```

## drivers/dma/Kconfig.stm32h7
```kconfig
# SPDX-FileCopyrightText: 2026 Core Devices LLC
# SPDX-License-Identifier: Apache-2.0

config DMA_STM32H7
    bool "ST STM32H7 DMA1, DMA2 and DMAMUX1"
    default y
    depends on DT_HAS_ST_STM32H7_DMAMUX_ENABLED && DT_HAS_ST_STM32_DMA_ENABLED
    select CLK
    help
      The STM32H7 DMA1 and DMA2 controllers, behind the DMAMUX1 request
      router.

config DMA_STM32H7_IRQ_PRIO
    int "Interrupt priority"
    default 0
    depends on DMA_STM32H7
    help
      Priority of the stream interrupts.
```

## drivers/dma/Kconfig.stm32h7_bdma
```kconfig
# SPDX-FileCopyrightText: 2026 Core Devices LLC
# SPDX-License-Identifier: Apache-2.0

config DMA_STM32H7_BDMA
    bool "ST STM32H7 BDMA and DMAMUX2"
    default y
    depends on DT_HAS_ST_STM32H7_DMAMUX_ENABLED && DT_HAS_ST_STM32H7_BDMA_ENABLED
    select CLK
    help
      The STM32H7 BDMA controller of the D3 domain, behind the DMAMUX2
      request router.

config DMA_STM32H7_BDMA_IRQ_PRIO
    int "Interrupt priority"
    default 0
    depends on DMA_STM32H7_BDMA
    help
      Priority of the channel interrupts.
```

## drivers/flash/Kconfig
```kconfig
# SPDX-FileCopyrightText: 2026 Core Devices LLC
# SPDX-License-Identifier: Apache-2.0

menuconfig FLASH
    bool "Flash"
    select KERNEL_SYS_WORKQ_HIGH
    help
      Flash class (pbl/drivers/flash.h) and its drivers: the flash that
      holds the file system, resources and firmware images.

if FLASH

config FLASH_IDLE_PM
    bool
    depends on CPU_IDLE
    help
      Selected by SoCs that do not execute from the flash, to power it
      down from an idle hook, see pbl_flash_pm_suspend().

config FLASH_CRC
    bool "CRC of a range"
    select CRC
    help
      pbl_flash_crc32() and pbl_flash_crc32_legacy().

rsource "Kconfig.otp"
rsource "Kconfig.spi_nor"
rsource "Kconfig.qemu"
rsource "Kconfig.nrf_rramc"
rsource "Kconfig.posix"

config FLASH_SHELL
    bool "Shell commands"
    default DRIVER_SHELL
    depends on SHELL
    help
      The flash shell command, to inspect, erase and test the flash.

config FLASH_SHELL_TEST
    bool "Test commands"
    depends on FLASH_SHELL
    help
      The flash read, fill and erased_sectors commands, to dump and verify
      the flash from a host.

module = DRIVER_FLASH
module-str = Flash
source "subsys/logging/Kconfig.template.log_level"

endif # FLASH
```

## drivers/flash/Kconfig.nrf_rramc
```kconfig
# SPDX-FileCopyrightText: 2026 Core Devices LLC
# SPDX-License-Identifier: Apache-2.0

config FLASH_NRF_RRAMC
    bool "nRF RRAM"
    default y
    depends on DT_HAS_NORDIC_NRF54L15_RRAMC_ENABLED
    help
      Support for the internal RRAM of the nRF54L, which needs no erase.
```

## drivers/flash/Kconfig.otp
```kconfig
# SPDX-FileCopyrightText: 2026 Core Devices LLC
# SPDX-License-Identifier: Apache-2.0

config FLASH_OTP
    bool
    help
      Selected by drivers with a user one-time programmable area, see
      pbl_flash_otp_*().
```

## drivers/flash/Kconfig.posix
```kconfig
# SPDX-FileCopyrightText: 2026 Core Devices LLC
# SPDX-License-Identifier: Apache-2.0

config FLASH_POSIX
    bool "POSIX external flash"
    default y
    depends on SOC_POSIX
    help
      External flash backed by a file on the host.
```

## drivers/flash/Kconfig.qemu
```kconfig
# SPDX-FileCopyrightText: 2026 Core Devices LLC
# SPDX-License-Identifier: Apache-2.0

config FLASH_QEMU
    bool "QEMU external flash"
    default y
    depends on DT_HAS_QEMU_PEBBLE_EXTFLASH_ENABLED
    help
      Support for the QEMU external flash peripheral.
```

## drivers/flash/Kconfig.spi_nor
```kconfig
# SPDX-FileCopyrightText: 2026 Core Devices LLC
# SPDX-License-Identifier: Apache-2.0

config FLASH_SPI_NOR
    bool "SPI NOR"
    default y
    depends on DT_HAS_JEDEC_SPI_NOR_ENABLED
    select SPI_MEM
    select FLASH_OTP
    select REGULATOR
    help
      Support for a JEDEC NOR flash on a SPI memory controller, described
      by its SFDP tables and the description of the part it is identified
      as by its JEDEC ID, among the parts enabled below. Boards enable the
      parts they can be fitted with.

if FLASH_SPI_NOR

config FLASH_SPI_NOR_GD25LQ255E
    bool "GigaDevice GD25LQ255E"

config FLASH_SPI_NOR_GD25Q256E
    bool "GigaDevice GD25Q256E"

config FLASH_SPI_NOR_MT25QL512A
    bool "Micron MT25QL512A"

config FLASH_SPI_NOR_MX25R6435F
    bool "Macronix MX25R6435F"

config FLASH_SPI_NOR_PY25Q128HA
    bool "Puya PY25Q128HA"

endif
```

## drivers/gpio/Kconfig
```kconfig
# SPDX-FileCopyrightText: 2026 Core Devices LLC
# SPDX-License-Identifier: Apache-2.0

menuconfig GPIO
    bool "GPIO"
    help
      GPIO controller class (pbl/drivers/gpio.h), selected by the
      drivers that drive or read pins.

if GPIO

rsource "Kconfig.nrf5"
rsource "Kconfig.nrf54l"
rsource "Kconfig.sf32lb"
rsource "Kconfig.stm32"
rsource "Kconfig.qemu"
rsource "Kconfig.npm1300"
rsource "Kconfig.tca6408"

config GPIO_SHELL
    bool "Shell commands"
    default DRIVER_SHELL
    depends on SHELL && DEVICE_NAMES
    help
      The gpio shell command, to list the ports and to read, drive,
      configure and watch pins.

endif # GPIO
```

## drivers/gpio/Kconfig.npm1300
```kconfig
# SPDX-FileCopyrightText: 2026 Core Devices LLC
# SPDX-License-Identifier: Apache-2.0

config GPIO_NPM1300
    bool "Nordic nPM1300 GPIO"
    default y
    depends on MFD_NPM1300
    help
      Support for the GPIOs of the Nordic nPM1300 PMIC.
```

## drivers/gpio/Kconfig.nrf5
```kconfig
# SPDX-FileCopyrightText: 2026 Core Devices LLC
# SPDX-License-Identifier: Apache-2.0

config GPIO_NRF5
    bool "Nordic nRF5"
    default y
    depends on DT_HAS_NORDIC_NRF52832_GPIO_ENABLED
    select INTC
    help
      Support for the Nordic nRF5 GPIO controller.

config GPIO_NRF5_IRQ_PRIO
    int "Interrupt priority"
    default 1
    depends on GPIO_NRF5
    help
      Priority of the GPIOTE interrupt.
```

## drivers/gpio/Kconfig.nrf54l
```kconfig
# SPDX-FileCopyrightText: 2026 Core Devices LLC
# SPDX-License-Identifier: Apache-2.0

config GPIO_NRF54L
    bool "Nordic nRF54L"
    default y
    depends on DT_HAS_NORDIC_NRF54L15_GPIO_ENABLED
    select INTC
    help
      Support for the Nordic nRF54L GPIO controller.

config GPIO_NRF54L_IRQ_PRIO
    int "Interrupt priority"
    default 1
    depends on GPIO_NRF54L
    help
      Priority of the GPIOTE interrupts.
```

## drivers/gpio/Kconfig.qemu
```kconfig
# SPDX-FileCopyrightText: 2026 Core Devices LLC
# SPDX-License-Identifier: Apache-2.0

config GPIO_QEMU
    bool "QEMU GPIO"
    default y
    depends on DT_HAS_QEMU_PEBBLE_GPIO_ENABLED
    select INTC
    help
      Support for the QEMU GPIO peripheral.

config GPIO_QEMU_IRQ_PRIO
    int "Interrupt priority"
    default 0
    depends on GPIO_QEMU
    help
      Priority of the port interrupt.
```

## drivers/gpio/Kconfig.sf32lb
```kconfig
# SPDX-FileCopyrightText: 2026 Core Devices LLC
# SPDX-License-Identifier: Apache-2.0

config GPIO_SF32LB
    bool "SiFli SF32LB"
    default y
    depends on DT_HAS_SIFLI_SF32LB52_GPIO_ENABLED || DT_HAS_SIFLI_SF32LB57_GPIO_ENABLED
    select CLK
    select INTC
    select PINCTRL
    select PINCTRL_SF32LB52_OUTPUT_LOW if PINCTRL_SF32LB52
    help
      Support for the SiFli SF32LB GPIO controller.

config GPIO_SF32LB_IRQ_PRIO
    int "Interrupt priority"
    default 0
    depends on GPIO_SF32LB
    help
      Priority of the port interrupt.
```

## drivers/gpio/Kconfig.stm32
```kconfig
# SPDX-FileCopyrightText: 2026 Core Devices LLC
# SPDX-License-Identifier: Apache-2.0

config GPIO_STM32
    bool "ST STM32"
    default y
    depends on DT_HAS_ST_STM32H743_PINCTRL_ENABLED
    select CLK
    select HWSPINLOCK
    select INTC
    help
      Support for the ST STM32 GPIO ports, and their interrupts through
      EXTI.

config GPIO_STM32_IRQ_PRIO
    int "Interrupt priority"
    default 0
    depends on GPIO_STM32
    help
      Priority of the EXTI interrupts.
```

## drivers/gpio/Kconfig.tca6408
```kconfig
# SPDX-FileCopyrightText: 2026 Core Devices LLC
# SPDX-License-Identifier: Apache-2.0

config GPIO_TCA6408
    bool "TI TCA6408"
    default y
    depends on DT_HAS_TI_TCA6408_ENABLED
    select I2C
    help
      Support for the TI TCA6408 I2C GPIO expander.
```

## drivers/gpu/Kconfig
```kconfig
# SPDX-FileCopyrightText: 2026 Core Devices LLC
# SPDX-License-Identifier: Apache-2.0

menuconfig GPU
    bool "GPU"
    help
      2D graphics accelerators: fills and blits into pixel buffers, with
      blending, rotation and scaling where the hardware can.

if GPU

rsource "Kconfig.sf32lb57_epic"

config GPU_STM32_DMA2D
    bool "ST STM32 DMA2D"
    default y
    depends on DT_HAS_ST_STM32_DMA2D_ENABLED
    select CLK
    help
      Support for the DMA2D (Chrom-ART) graphics accelerator of the STM32:
      fills and blits with format conversion and blending.

config GPU_STM32_DMA2D_IRQ_PRIO
    int "Interrupt priority"
    default 0
    depends on GPU_STM32_DMA2D
    help
      Priority of the accelerator interrupt.

endif # GPU
```

## drivers/gpu/Kconfig.sf32lb57_epic
```kconfig
# SPDX-FileCopyrightText: 2026 Core Devices LLC
# SPDX-License-Identifier: Apache-2.0

config GPU_SF32LB57_EPIC
    bool "SiFli SF32LB57 ePIC"
    default y
    depends on DT_HAS_SIFLI_SF32LB57_EPIC_ENABLED
    select CLK
    select RESET
    help
      Support for the ePIC graphics accelerator of the SiFli SF32LB57.

config GPU_SF32LB57_EPIC_IRQ_PRIO
    int "Interrupt priority"
    default 0
    depends on GPU_SF32LB57_EPIC
    help
      Priority of the accelerator interrupt.
```

## drivers/hrm/Kconfig
```kconfig
# SPDX-FileCopyrightText: 2026 Core Devices LLC
# SPDX-License-Identifier: Apache-2.0

menuconfig HRM
    bool "Heart rate monitor"
    help
      Heart rate monitor class (pbl/drivers/hrm.h) and its drivers.

if HRM

rsource "Kconfig.gh3x2x"

config HRM_HRV
    bool "HRV (RR interval) support"
    depends on HRM_GH3X2X
    help
      Expose heart-rate-variability (RR/inter-beat interval) data from the
      HRM sensor. Enables the Goodix HRV algorithm and links the nonfree
      HRV library. Off by default; HRV is only sampled while an app holds
      an HRV subscription.

rsource "Kconfig.qemu"

module = DRIVER_HRM
module-str = Heart rate monitor
source "subsys/logging/Kconfig.template.log_level"

endif # HRM
```
