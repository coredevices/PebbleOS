## drivers/als/Kconfig.sim
```kconfig
# SPDX-FileCopyrightText: 2026 Core Devices LLC
# SPDX-License-Identifier: Apache-2.0

config ALS_SIM
    bool "Simulator"
    default y
    depends on SOC_QEMU_PEBBLE || SOC_POSIX
    help
      Simulated ambient light sensor, reading a level set through its
      simulator API (pbl/drivers/als/sim.h).
```

## drivers/als/Kconfig.w1160
```kconfig
# SPDX-FileCopyrightText: 2026 Core Devices LLC
# SPDX-License-Identifier: Apache-2.0

config ALS_W1160
    bool "Sensortek W1160"
    default y
    depends on DT_HAS_SENSORTEK_W1160_ENABLED
    select I2C
    select REGULATOR
    help
      Support for the Sensortek W1160 ambient light sensor.
```

## drivers/audio/Kconfig
```kconfig
# SPDX-FileCopyrightText: 2026 Core Devices LLC
# SPDX-License-Identifier: Apache-2.0

config MIC
    bool "Microphone"
    select AUDIO
    help
      The board has a microphone, the MIC capture device.

config SPEAKER
    bool "Speaker"
    select AUDIO
    help
      The board has a speaker, the SPEAKER playback device.

menuconfig AUDIO
    bool "Audio"
    help
      Audio stream class (pbl/drivers/audio.h) and its drivers.

if AUDIO

rsource "Kconfig.amp_gpio"
rsource "Kconfig.sf32lb_audcodec"
rsource "Kconfig.sf32lb52_pdm"
rsource "Kconfig.stm32_sai"
rsource "Kconfig.qemu"
rsource "Kconfig.sim_mic"
rsource "Kconfig.nrf5_pdm"
rsource "Kconfig.nrf5_i2s"
rsource "Kconfig.dmic"
rsource "Kconfig.da7212"
rsource "Kconfig.wm8994"

config AUDIO_SHELL
    bool "Shell commands"
    default DRIVER_SHELL
    depends on SHELL && DEVICE_NAMES
    help
      The audio shell command, to list the devices, record and play tones.

module = DRIVER_AUDIO
module-str = Audio
source "subsys/logging/Kconfig.template.log_level"

endif # AUDIO
```

## drivers/audio/Kconfig.amp_gpio
```kconfig
# SPDX-FileCopyrightText: 2026 Core Devices LLC
# SPDX-License-Identifier: Apache-2.0

config AUDIO_AMP_GPIO
    bool "GPIO amplifier"
    default y
    depends on DT_HAS_AWINIC_AW8155_ENABLED || DT_HAS_SIMPLE_AUDIO_AMPLIFIER_ENABLED
    select GPIO
    select REGULATOR
    help
      Amplifier switched by an enable GPIO, with an optional supply and
      enable mode pulses.
```

## drivers/audio/Kconfig.da7212
```kconfig
# SPDX-FileCopyrightText: 2026 Core Devices LLC
# SPDX-License-Identifier: Apache-2.0

config AUDIO_DA7212
    bool "Dialog DA7212 codec"
    default y
    depends on DT_HAS_DLG_DA7212_ENABLED
    select I2C
    select REGULATOR
    help
      The Dialog DA7212 codec, playing to its line output.
```

## drivers/audio/Kconfig.dmic
```kconfig
# SPDX-FileCopyrightText: 2026 Core Devices LLC
# SPDX-License-Identifier: Apache-2.0

config AUDIO_DMIC
    bool "Digital microphones"
    default y
    depends on DT_HAS_DMIC_CODEC_ENABLED
    select REGULATOR
    help
      Digital microphones on a PDM interface, powered while recording.
```

## drivers/audio/Kconfig.nrf5_i2s
```kconfig
# SPDX-FileCopyrightText: 2026 Core Devices LLC
# SPDX-License-Identifier: Apache-2.0

config AUDIO_NRF5_I2S
    bool "Nordic nRF5 I2S"
    default y
    depends on DT_HAS_NORDIC_NRF52832_I2S_ENABLED
    select CLK
    help
      Playback and capture through the nRF5 I2S interface.

config AUDIO_NRF5_I2S_IRQ_PRIO
    int "I2S interrupt priority"
    default 1
    depends on AUDIO_NRF5_I2S
    help
      Priority of the I2S interrupt.

config AUDIO_NRF5_I2S_BLOCK_FRAMES
    int "Most frames in a DMA block"
    range 16 512
    default 512
    depends on AUDIO_NRF5_I2S
    help
      The DMA blocks are the first stream's periods, cut down to this. Each
      direction streaming takes two from the kernel heap while running, of
      4 bytes a frame: smaller blocks take less of it, at an interrupt per
      block.
```

## drivers/audio/Kconfig.nrf5_pdm
```kconfig
# SPDX-FileCopyrightText: 2026 Core Devices LLC
# SPDX-License-Identifier: Apache-2.0

config AUDIO_NRF5_PDM
    bool "Nordic nRF5 PDM"
    default y
    depends on DT_HAS_NORDIC_NRF52832_PDM_ENABLED
    select CLK
    help
      Capture from digital microphones on the nRF5 PDM interface.

config AUDIO_NRF5_PDM_IRQ_PRIO
    int "PDM interrupt priority"
    default 1
    depends on AUDIO_NRF5_PDM
    help
      Priority of the PDM interrupt.
```

## drivers/audio/Kconfig.qemu
```kconfig
# SPDX-FileCopyrightText: 2026 Core Devices LLC
# SPDX-License-Identifier: Apache-2.0

config AUDIO_QEMU
    bool "QEMU audio device"
    default y
    depends on DT_HAS_QEMU_PEBBLE_AUDIO_ENABLED
    help
      Playback through the QEMU audio device.

config AUDIO_QEMU_IRQ_PRIO
    int "Interrupt priority"
    default 0
    depends on AUDIO_QEMU
    help
      Priority of the device interrupt.
```

## drivers/audio/Kconfig.sf32lb52_pdm
```kconfig
# SPDX-FileCopyrightText: 2026 Core Devices LLC
# SPDX-License-Identifier: Apache-2.0

config AUDIO_SF32LB52_PDM
    bool "SiFli SF32LB52 and SF32LB57 PDM"
    default y
    depends on DT_HAS_SIFLI_SF32LB52_PDM_ENABLED || DT_HAS_SIFLI_SF32LB57_PDM_ENABLED
    select CLK
    select DMA
    select PINCTRL
    select RESET
    help
      Capture from digital microphones on the SF32LB52 and SF32LB57 PDM
      interface.

config AUDIO_SF32LB52_PDM_IRQ_PRIO
    int "Interrupt priority"
    default 0
    depends on AUDIO_SF32LB52_PDM
    help
      Priority of the PDM interrupt.
```

## drivers/audio/Kconfig.sf32lb_audcodec
```kconfig
# SPDX-FileCopyrightText: 2026 Core Devices LLC
# SPDX-License-Identifier: Apache-2.0

config AUDIO_SF32LB_AUDCODEC
    bool "SiFli SF32LB audio codec"
    default y
    depends on DT_HAS_SIFLI_SF32LB52_AUDCODEC_ENABLED || DT_HAS_SIFLI_SF32LB57_AUDCODEC_ENABLED
    select CLK
    select DMA
    select PINCTRL
    select RESET
    help
      Playback through the DAC of the SF32LB audio codec, and capture from
      analog microphones through its ADC.
```

## drivers/audio/Kconfig.sim_mic
```kconfig
# SPDX-FileCopyrightText: 2026 Core Devices LLC
# SPDX-License-Identifier: Apache-2.0

config AUDIO_SIM_MIC
    bool "Simulated microphone"
    default y if MIC
    depends on SOC_QEMU_PEBBLE || SOC_POSIX
    select KERNEL_SYS_WORKQ_HIGH
    help
      Simulated microphone, recording the audio written through its
      simulator API (pbl/drivers/audio/sim.h), and silence when none is.
```

## drivers/audio/Kconfig.stm32_sai
```kconfig
# SPDX-FileCopyrightText: 2026 Core Devices LLC
# SPDX-License-Identifier: Apache-2.0

config AUDIO_STM32_SAI
    bool "STM32 SAI"
    default y
    depends on DT_HAS_ST_STM32_SAI_SUB_A_ENABLED || DT_HAS_ST_STM32_SAI_SUB_B_ENABLED
    select CLK
    select DMA
    select PDM
    select PINCTRL
    help
      Playback through a sub-block of an STM32 serial audio interface,
      the master of an I2S link to a codec, and capture of PDM
      microphones on its PDM interface.
```

## drivers/audio/Kconfig.wm8994
```kconfig
# SPDX-FileCopyrightText: 2026 Core Devices LLC
# SPDX-License-Identifier: Apache-2.0

config AUDIO_WM8994
    bool "Cirrus Logic WM8994 codec"
    default y
    depends on DT_HAS_WLF_WM8994_ENABLED
    select I2C
    help
      The WM8994 codec, playing to its headphone output.
```

## drivers/backlight/Kconfig
```kconfig
# SPDX-FileCopyrightText: 2026 Core Devices LLC
# SPDX-License-Identifier: Apache-2.0

menuconfig BACKLIGHT
    bool "Backlight"
    help
      Backlight class (pbl/drivers/backlight.h) and its drivers: the
      brightness, and the color where the hardware mixes one.

if BACKLIGHT

config BACKLIGHT_SHELL
    bool "Shell commands"
    default DRIVER_SHELL
    depends on SHELL
    help
      The backlight shell command, to set the brightness and color.

config BACKLIGHT_HAS_COLOR
    bool
    help
      Backlight drivers that support color should select this Kconfig symbol.

rsource "Kconfig.aw9364e"
rsource "Kconfig.led"
rsource "Kconfig.pwm"
rsource "Kconfig.qemu"
rsource "Kconfig.posix"

module = DRIVER_BACKLIGHT
module-str = Backlight
source "subsys/logging/Kconfig.template.log_level"

endif # BACKLIGHT
```

## drivers/backlight/Kconfig.aw9364e
```kconfig
# SPDX-FileCopyrightText: 2026 Core Devices LLC
# SPDX-License-Identifier: Apache-2.0

config BACKLIGHT_AW9364E
    bool "AW9364E"
    default y
    depends on DT_HAS_AWINIC_AW9364E_ENABLED
    select GPIO
    help
      Support for the AW9364E LED controller.
```

## drivers/backlight/Kconfig.led
```kconfig
# SPDX-FileCopyrightText: 2026 Core Devices LLC
# SPDX-License-Identifier: Apache-2.0

config BACKLIGHT_LED
    bool "LED"
    default y
    depends on DT_HAS_LED_BACKLIGHT_ENABLED
    select LED
    select BACKLIGHT_HAS_COLOR if LED_HAS_COLOR
    help
      Backlight on an LED, its color mixed by multicolor LEDs.
```

## drivers/backlight/Kconfig.posix
```kconfig
# SPDX-FileCopyrightText: 2026 Core Devices LLC
# SPDX-License-Identifier: Apache-2.0

config BACKLIGHT_POSIX
    bool "POSIX"
    default y
    depends on SOC_POSIX
    help
      Backlight of a native build, which does nothing.
```

## drivers/backlight/Kconfig.pwm
```kconfig
# SPDX-FileCopyrightText: 2026 Core Devices LLC
# SPDX-License-Identifier: Apache-2.0

config BACKLIGHT_PWM
    bool "PWM"
    default y
    depends on DT_HAS_PWM_BACKLIGHT_ENABLED
    select GPIO
    select PWM
    help
      Support for a backlight driven by a PWM peripheral.
```

## drivers/backlight/Kconfig.qemu
```kconfig
# SPDX-FileCopyrightText: 2026 Core Devices LLC
# SPDX-License-Identifier: Apache-2.0

config BACKLIGHT_QEMU
    bool "QEMU"
    default y
    depends on DT_HAS_QEMU_PEBBLE_DISPLAY_ENABLED
    help
      Emulated backlight controller that writes to the QEMU
      pebble-display MMIO registers.

config BACKLIGHT_QEMU_COLOR
    bool "QEMU color"
    depends on BACKLIGHT_QEMU
    select BACKLIGHT_HAS_COLOR
    help
      RGB backlight colors in the QEMU backlight driver.
```

## drivers/base/Kconfig
```kconfig
# SPDX-FileCopyrightText: 2026 Core Devices LLC
# SPDX-License-Identifier: Apache-2.0

menu "Device model"

module = DEVICE
module-str = Device model
source "subsys/logging/Kconfig.template.log_level"

config DEVICE_NAMES
    bool "Device names"
    default y
    help
      Keep the name of each device, for logs, the driver shells and
      pbl_device_find(). Without them, each device takes 4 bytes less and
      their names are left out of the image.

config DEVICE_INIT_REVERSE
    bool "Initialize devices in reverse table order"
    help
      Debug option. Walk the device table backwards at boot, to check that
      no device relies on its place in the table to find what it needs
      ready.

endmenu
```

## drivers/battery/Kconfig
```kconfig
# SPDX-FileCopyrightText: 2026 Core Devices LLC
# SPDX-License-Identifier: Apache-2.0

config BATTERY_SIMPLE
    bool
    default y
    depends on DT_HAS_SIMPLE_BATTERY_ENABLED
    help
      The battery cell described in the devicetree, for chargers and fuel
      gauges to read.
```

## drivers/can/Kconfig
```kconfig
# SPDX-FileCopyrightText: 2026 Core Devices LLC
# SPDX-License-Identifier: Apache-2.0

menuconfig CAN
    bool "CAN"
    help
      CAN controller class (pbl/drivers/can.h) and its drivers.

if CAN

rsource "Kconfig.ipms_canfd"

config CAN_SHELL
    bool "Shell commands"
    default DRIVER_SHELL
    depends on SHELL && DEVICE_NAMES
    help
      The can shell command, to list the controllers, configure and start
      them, send frames and show the frames received.

endif # CAN
```

## drivers/can/Kconfig.ipms_canfd
```kconfig
# SPDX-FileCopyrightText: 2026 Core Devices LLC
# SPDX-License-Identifier: Apache-2.0

config CAN_IPMS_CANFD
    bool "IPMS CAN-CTRL controller"
    default y
    depends on DT_HAS_SIFLI_SF32LB57_CAN_ENABLED
    select CLK
    select PINCTRL
    select RESET
    help
      Support for the Fraunhofer IPMS CAN-CTRL controller, as the CAN
      controllers of the SiFli SF32LB57, for classic CAN.

config CAN_IPMS_CANFD_IRQ_PRIO
    int "Interrupt priority"
    default 1
    depends on CAN_IPMS_CANFD
    help
      Priority of the controller interrupt.
```

## drivers/charger/Kconfig
```kconfig
# SPDX-FileCopyrightText: 2026 Core Devices LLC
# SPDX-License-Identifier: Apache-2.0

menuconfig CHARGER
    bool "Charger"
    help
      Battery charger class (pbl/drivers/charger.h).

if CHARGER

config CHARGER_SHELL
    bool "Shell commands"
    default DRIVER_SHELL
    depends on SHELL
    help
      The charger shell command, to show whether external power is
      present, the charge status and the battery measurements.

config CHARGER_HIGH_LOAD
    bool
    help
      The charger driver limits the discharge current, and lifts the
      limit on pbl_charger_high_load_request().

rsource "Kconfig.npm1300"
rsource "Kconfig.sf32lb57"
rsource "Kconfig.sim"

module = DRIVER_CHARGER
module-str = Charger
source "subsys/logging/Kconfig.template.log_level"

endif # CHARGER
```
