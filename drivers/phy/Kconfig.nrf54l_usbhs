## drivers/phy/Kconfig.nrf54l_usbhs
```kconfig
# SPDX-FileCopyrightText: 2026 Core Devices LLC
# SPDX-License-Identifier: Apache-2.0

config PHY_NRF54L_USBHS
    bool "Nordic nRF54LM20A USBHS PHY"
    default y
    depends on DT_HAS_NORDIC_NRF54LM20A_USBHS_PHY_ENABLED
    select CLK
    select KERNEL_SYS_WORKQ_HIGH
    help
      The wrapper of the nRF54LM20A USBHS controller and its UTMI+ PHY,
      which powers and resets them, and VREGUSB, which senses VBUS.

config PHY_NRF54L_USBHS_IRQ_PRIO
    int "Interrupt priority"
    default 0
    depends on PHY_NRF54L_USBHS
    help
      Priority of the VREGUSB interrupt.
```

## drivers/phy/Kconfig.usb_nop
```kconfig
# SPDX-FileCopyrightText: 2026 Core Devices LLC
# SPDX-License-Identifier: Apache-2.0

config PHY_USB_NOP
    bool "USB transceiver with nothing to set up"
    default y
    depends on DT_HAS_USB_NOP_XCEIV_ENABLED
    select CLK
    help
      A USB PHY software does not set up, as a ULPI PHY, of which the
      driver only runs the clock.
```

## drivers/pinctrl/Kconfig
```kconfig
# SPDX-FileCopyrightText: 2026 Core Devices LLC
# SPDX-License-Identifier: Apache-2.0

menuconfig PINCTRL
    bool "Pin controllers"
    help
      Pin controller class (pbl/drivers/pinctrl.h), selected by the drivers
      that route peripheral signals to pins.

if PINCTRL

rsource "Kconfig.sf32lb52"
rsource "Kconfig.sf32lb57"
rsource "Kconfig.stm32"

config PINCTRL_SHELL
    bool "Pin controller shell commands"
    default DRIVER_SHELL
    depends on SHELL
    help
      The pinctrl shell command, to dump the pad registers of every pin
      controller.

endif # PINCTRL
```

## drivers/pinctrl/Kconfig.sf32lb52
```kconfig
# SPDX-FileCopyrightText: 2026 Core Devices LLC
# SPDX-License-Identifier: Apache-2.0

config PINCTRL_SF32LB52
    bool "SiFli SF32LB52 pin controller"
    default y
    depends on DT_HAS_SIFLI_SF32LB52_PINCTRL_ENABLED
    help
      Pin multiplexer and pad configuration of the SiFli SF32LB52 HPSYS
      pads.

config PINCTRL_SF32LB52_OUTPUT_LOW
    bool
    depends on PINCTRL_SF32LB52
    help
      Pins of a state can be driven low, through the GPIO driver.
```

## drivers/pinctrl/Kconfig.sf32lb57
```kconfig
# SPDX-FileCopyrightText: 2026 Core Devices LLC
# SPDX-License-Identifier: Apache-2.0

config PINCTRL_SF32LB57
    bool "SiFli SF32LB57 pin controller"
    default y
    depends on DT_HAS_SIFLI_SF32LB57_PINCTRL_ENABLED
    help
      Pin multiplexer and pad configuration of the SiFli SF32LB57 HPSYS
      pads.
```

## drivers/pinctrl/Kconfig.stm32
```kconfig
# SPDX-FileCopyrightText: 2026 Core Devices LLC
# SPDX-License-Identifier: Apache-2.0

config PINCTRL_STM32
    bool "ST STM32 pin controller"
    default y
    depends on DT_HAS_ST_STM32H743_PINCTRL_ENABLED
    select CLK
    select HWSPINLOCK
    help
      Pin multiplexer and pad configuration of the ST STM32 GPIO ports.
```

## drivers/power_domain/Kconfig
```kconfig
# SPDX-FileCopyrightText: 2026 Core Devices LLC
# SPDX-License-Identifier: Apache-2.0

config POWER_DOMAIN
    bool
    help
      Power domain class (pbl/drivers/power_domain.h), selected by the
      drivers that provide power domains.

config POWER_DOMAIN_SF32LB_PMUC
    bool "SiFli SF32LB PMUC power domains"
    default y
    depends on DT_HAS_SIFLI_SF32LB52_PMUC_ENABLED || DT_HAS_SIFLI_SF32LB57_PMUC_ENABLED
    select POWER_DOMAIN
    help
      The HPSYS power domain of the SiFli SF32LB52 and SF32LB57 PMUC,
      whose performance states are the voltage modes of the HPSYS, D0 to
      S1.
```

## drivers/pressure/Kconfig
```kconfig
# SPDX-FileCopyrightText: 2026 Core Devices LLC
# SPDX-License-Identifier: Apache-2.0

menuconfig PRESSURE
    bool "Pressure sensor"
    help
      Barometric pressure sensor drivers (pbl/drivers/pressure.h). The
      board instantiates the sensor it has and exports it as PRESSURE.

if PRESSURE

config PRESSURE_SHELL
    bool "Shell commands"
    default DRIVER_SHELL
    depends on SHELL
    help
      The pressure shell command, to run one conversion.

rsource "Kconfig.bmp390"

module = DRIVER_PRESSURE
module-str = Pressure sensor
source "subsys/logging/Kconfig.template.log_level"

endif # PRESSURE
```

## drivers/pwm/Kconfig
```kconfig
# SPDX-FileCopyrightText: 2026 Core Devices LLC
# SPDX-License-Identifier: Apache-2.0

menuconfig PWM
    bool "PWM"
    help
      PWM controller class (pbl/drivers/pwm.h), selected by the drivers
      of PWM-driven devices.

if PWM

rsource "Kconfig.nrf5"
rsource "Kconfig.nrf5_rtc"
rsource "Kconfig.sf32lb_lptim"
rsource "Kconfig.sf32lb_gptim"

config PWM_SHELL
    bool "Shell commands"
    default DRIVER_SHELL
    depends on SHELL && DEVICE_NAMES
    help
      The pwm shell command, to list the controllers and run or disable
      their channels.

endif # PWM
```

## drivers/pwm/Kconfig.nrf5
```kconfig
# SPDX-FileCopyrightText: 2026 Core Devices LLC
# SPDX-License-Identifier: Apache-2.0

config PWM_NRF5
    bool "Nordic nRF5"
    default y
    depends on DT_HAS_NORDIC_NRF52832_PWM_ENABLED
    help
      Support for the Nordic nRF5 PWM controller.
```

## drivers/pwm/Kconfig.nrf5_rtc
```kconfig
# SPDX-FileCopyrightText: 2026 Core Devices LLC
# SPDX-License-Identifier: Apache-2.0

config PWM_NRF5_RTC
    bool "Nordic nRF5 RTC PWM"
    default y
    depends on DT_HAS_NORDIC_NRF52832_RTC_PWM_ENABLED
    select CLK
    help
      Support for PWM outputs generated by an nRF5 RTC, through PPI and
      GPIOTE.
```

## drivers/pwm/Kconfig.sf32lb_gptim
```kconfig
# SPDX-FileCopyrightText: 2026 Core Devices LLC
# SPDX-License-Identifier: Apache-2.0

config PWM_SF32LB_GPTIM
    bool "SiFli SF32LB GPTIM"
    default y
    depends on DT_HAS_SIFLI_SF32LB52_GPTIM_PWM_ENABLED
    select CLK
    select PINCTRL
    help
      Support for PWM outputs of the SiFli SF32LB general-purpose timers.
```

## drivers/pwm/Kconfig.sf32lb_lptim
```kconfig
# SPDX-FileCopyrightText: 2026 Core Devices LLC
# SPDX-License-Identifier: Apache-2.0

config PWM_SF32LB_LPTIM
    bool "SiFli SF32LB LPTIM"
    default y
    depends on DT_HAS_SIFLI_SF32LB52_LPTIM_PWM_ENABLED
    select CLK
    select PINCTRL
    help
      Support for PWM outputs of the SiFli SF32LB low-power timers.
```

## drivers/ram/Kconfig
```kconfig
# SPDX-FileCopyrightText: 2026 Core Devices LLC
# SPDX-License-Identifier: Apache-2.0

menuconfig RAM
    bool "RAM"
    help
      Memory-mapped RAM outside the SoC's own, only powered while it
      has users (pbl/drivers/ram.h). The kernel scratch heap can use
      the one a board gives the EXTRAM role.

if RAM

config RAM_SHELL
    bool "Shell commands"
    default DRIVER_SHELL
    depends on SHELL && !SCRATCH_HEAP_SHARED
    help
      The ram shell command, to show the use and power state of the
      external RAM, and to check that it keeps what is written to it.

rsource "Kconfig.hyperram"
rsource "Kconfig.stm32_fmc"
rsource "Kconfig.qemu"

endif # RAM
```

## drivers/ram/Kconfig.hyperram
```kconfig
# SPDX-FileCopyrightText: 2026 Core Devices LLC
# SPDX-License-Identifier: Apache-2.0

config RAM_HYPERRAM
    bool "HyperRAM"
    default y
    depends on DT_HAS_CYPRESS_HYPERRAM_ENABLED
    select REGULATOR
    select HYPERBUS
    help
      Support for HyperRAM, PSRAM with a HyperBus interface, on a
      HyperBus controller.
```

## drivers/ram/Kconfig.qemu
```kconfig
# SPDX-FileCopyrightText: 2026 Core Devices LLC
# SPDX-License-Identifier: Apache-2.0

config RAM_QEMU
    bool "QEMU PSRAM"
    default y
    depends on DT_HAS_QEMU_PEBBLE_PSRAM_ENABLED
    help
      Support for the PSRAM of the QEMU Pebble machines.
```

## drivers/ram/Kconfig.stm32_fmc
```kconfig
# SPDX-FileCopyrightText: 2026 Core Devices LLC
# SPDX-License-Identifier: Apache-2.0

config RAM_STM32_FMC
    bool "ST STM32H7 FMC SDRAM"
    default y
    depends on DT_HAS_ST_STM32H7_FMC_ENABLED
    select CLK
    select PINCTRL
    help
      Support for an SDRAM on the STM32H7 flexible memory controller.
```

## drivers/regulator/Kconfig
```kconfig
# SPDX-FileCopyrightText: 2026 Core Devices LLC
# SPDX-License-Identifier: Apache-2.0

config REGULATOR
    bool
    help
      Power rail class (pbl/drivers/regulator.h), selected by the drivers
      that use regulators.

rsource "Kconfig.nrf54l"
rsource "Kconfig.sf32lb52_pmuc"
rsource "Kconfig.sf32lb57_pmuc"

if REGULATOR

rsource "Kconfig.npm1300"
rsource "Kconfig.stm32h7_pwr"
rsource "Kconfig.fixed"

module = DRIVER_REGULATOR
module-str = Regulator
source "subsys/logging/Kconfig.template.log_level"

endif # REGULATOR
```

## drivers/regulator/Kconfig.fixed
```kconfig
# SPDX-FileCopyrightText: 2026 Core Devices LLC
# SPDX-License-Identifier: Apache-2.0

config REGULATOR_FIXED
    bool "Fixed regulators"
    default y
    depends on DT_HAS_REGULATOR_FIXED_ENABLED
    select GPIO
    help
      Support for rails switched by a GPIO.
```

## drivers/regulator/Kconfig.npm1300
```kconfig
# SPDX-FileCopyrightText: 2026 Core Devices LLC
# SPDX-License-Identifier: Apache-2.0

config REGULATOR_NPM1300
    bool "Nordic nPM1300 regulators"
    default y
    depends on DT_HAS_NORDIC_NPM1300_ENABLED
    select MFD
    select MFD_NPM1300
    help
      Support for the BUCK and LDSW rails of the Nordic nPM1300 PMIC.
```

## drivers/regulator/Kconfig.nrf54l
```kconfig
# SPDX-FileCopyrightText: 2026 Core Devices LLC
# SPDX-License-Identifier: Apache-2.0

# Not only for its consumers: it also applies the mode of VREGMAIN
config REGULATOR_NRF54L
    bool "Nordic nRF54L VREGMAIN"
    default y
    depends on DT_HAS_NORDIC_NRF54L15_OSCILLATORS_ENABLED
    select REGULATOR
    help
      Support for VREGMAIN, the main supply of the nRF54L, which runs from
      its LDO or, with an inductor fitted, from its DC/DC converter, as
      regulator-initial-mode says.
```

## drivers/regulator/Kconfig.sf32lb57_pmuc
```kconfig
# SPDX-FileCopyrightText: 2026 Core Devices LLC
# SPDX-License-Identifier: Apache-2.0

config REGULATOR_SF32LB57_PMUC
    bool "SiFli SF32LB57 PMUC regulators"
    default y
    depends on DT_HAS_SIFLI_SF32LB57_PMUC_ENABLED
    select REGULATOR
    help
      Support for LDO18, the supply of the package memory in the
      SF32LB57 PMUC.
```

## drivers/regulator/Kconfig.stm32h7_pwr
```kconfig
# SPDX-FileCopyrightText: 2026 Core Devices LLC
# SPDX-License-Identifier: Apache-2.0

config REGULATOR_STM32H7_PWR
    bool "STM32H7 PWR regulators"
    default y
    depends on DT_HAS_ST_STM32H747_PWR_ENABLED
    help
      Support for USB33, the supply of the USB transceivers, which the
      voltage detector of the STM32H7 PWR lets through.
```

## drivers/remoteproc/Kconfig
```kconfig
# SPDX-FileCopyrightText: 2026 Core Devices LLC
# SPDX-License-Identifier: Apache-2.0

menuconfig REMOTEPROC
    bool "Remote processors"
    help
      Remote processor class (pbl/drivers/remoteproc.h), selected by the
      code that boots firmware on other cores.

if REMOTEPROC

rsource "Kconfig.nrf_vpr"
rsource "Kconfig.sf32lb"
rsource "Kconfig.stm32h7_cm4"

config REMOTEPROC_SHELL
    bool "Remote processor shell commands"
    default DRIVER_SHELL
    depends on SHELL && DEVICE_NAMES
    help
      The rproc shell command, to list the remote processors and boot or
      shut them down.

endif # REMOTEPROC
```
