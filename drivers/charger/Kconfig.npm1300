## drivers/charger/Kconfig.npm1300
```kconfig
# SPDX-FileCopyrightText: 2026 Core Devices LLC
# SPDX-License-Identifier: Apache-2.0

config CHARGER_NPM1300
    bool "Nordic nPM1300"
    default y
    depends on DT_HAS_NORDIC_NPM1300_ENABLED
    select CHARGER_HIGH_LOAD
    select GPIO
    select KERNEL_SYS_WORKQ
    select KERNEL_SYS_WORKQ_HIGH
    select MFD
    select MFD_NPM1300
    help
      Support for the charger of the Nordic nPM1300 PMIC.
```

## drivers/charger/Kconfig.sf32lb57
```kconfig
# SPDX-FileCopyrightText: 2026 Core Devices LLC
# SPDX-License-Identifier: Apache-2.0

config CHARGER_SF32LB57
    bool "SiFli SF32LB57"
    default y
    depends on DT_HAS_SIFLI_SF32LB57_PMUC_ENABLED
    select KERNEL_SYS_WORKQ_HIGH
    help
      Support for the charger of the SiFli SF32LB57 PMU: whether power is
      present on its VBUS input, and the charge status.

config CHARGER_SF32LB57_IRQ_PRIO
    int "SiFli SF32LB57 interrupt priority"
    default 0
    depends on CHARGER_SF32LB57
```

## drivers/charger/Kconfig.sim
```kconfig
# SPDX-FileCopyrightText: 2026 Core Devices LLC
# SPDX-License-Identifier: Apache-2.0

config CHARGER_SIM
    bool "Simulator"
    default y
    depends on SOC_QEMU_PEBBLE || SOC_POSIX
    help
      Simulated charger, set through its simulator API
      (pbl/drivers/charger/sim.h).
```

## drivers/clk/Kconfig
```kconfig
# SPDX-FileCopyrightText: 2026 Core Devices LLC
# SPDX-License-Identifier: Apache-2.0

menuconfig CLK
    bool "Clock controllers"
    help
      Clock controller class (pbl/drivers/clk.h), selected by the drivers
      that take clocks.

if CLK

config CLK_SHELL
    bool "Clock shell commands"
    default DRIVER_SHELL
    depends on SHELL && DEVICE_NAMES
    help
      The clk shell command: list clocks and rates, and sample, hold and
      inspect calibrated clocks.

module = DRIVER_CLK
module-str = Clock controllers
source "subsys/logging/Kconfig.template.log_level"

rsource "Kconfig.fixed"
rsource "Kconfig.sf32lb"
rsource "Kconfig.stm32h7"
rsource "Kconfig.nrf52"
rsource "Kconfig.nrf54l"
rsource "Kconfig.cal"
rsource "Kconfig.sf32lb52_pmuc"
rsource "Kconfig.sf32lb52_hxt"
rsource "Kconfig.sf32lb57_pmuc"
rsource "Kconfig.sf32lb_lpsys_rcc"
rsource "Kconfig.sf32lb52_rtc"

endif # CLK
```

## drivers/clk/Kconfig.cal
```kconfig
# SPDX-FileCopyrightText: 2026 Core Devices LLC
# SPDX-License-Identifier: Apache-2.0

config CLK_CAL
    bool
    help
      Calibrated clocks (pbl/drivers/clk/cal.h), selected by the drivers
      of oscillators whose rate is measured against a reference.
```

## drivers/clk/Kconfig.fixed
```kconfig
# SPDX-FileCopyrightText: 2026 Core Devices LLC
# SPDX-License-Identifier: Apache-2.0

config CLK_FIXED
    bool "Fixed-rate clocks"
    default y
    depends on DT_HAS_FIXED_CLOCK_ENABLED
    help
      Clocks that always run at the same rate, as crystals.
```

## drivers/clk/Kconfig.nrf52
```kconfig
# SPDX-FileCopyrightText: 2026 Core Devices LLC
# SPDX-License-Identifier: Apache-2.0

config CLK_NRF52
    bool "Nordic nRF52 clock control"
    default y
    depends on DT_HAS_NORDIC_NRF52832_CLOCK_ENABLED
    help
      HFCLK and LFCLK of the Nordic nRF52, from their crystal oscillators.
```

## drivers/clk/Kconfig.nrf54l
```kconfig
# SPDX-FileCopyrightText: 2026 Core Devices LLC
# SPDX-License-Identifier: Apache-2.0

config CLK_NRF54L
    bool "Nordic nRF54L clock control"
    default y
    depends on DT_HAS_NORDIC_NRF54L15_CLOCK_ENABLED
    help
      HFCLK and LFCLK of the Nordic nRF54L, from their crystal oscillators.
```

## drivers/clk/Kconfig.sf32lb
```kconfig
# SPDX-FileCopyrightText: 2026 Core Devices LLC
# SPDX-License-Identifier: Apache-2.0

config CLK_SF32LB
    bool "SiFli SF32LB RCC"
    default y
    depends on DT_HAS_SIFLI_SF32LB52_HPSYS_RCC_ENABLED || DT_HAS_SIFLI_SF32LB57_HPSYS_RCC_ENABLED
    select POWER_DOMAIN
    help
      Clock controller of the SiFli SF32LB52 and SF32LB57 HPSYS RCC.
```

## drivers/clk/Kconfig.sf32lb52_hxt
```kconfig
# SPDX-FileCopyrightText: 2026 Core Devices LLC
# SPDX-License-Identifier: Apache-2.0

config CLK_SF32LB52_HXT
    bool "SiFli SF32LB52 crystal trim"
    default y
    depends on DT_HAS_SIFLI_SF32LB52_PMUC_ENABLED && CLK_SF32LB && FLASH_OTP
    help
      Apply the 48 MHz crystal load capacitance trim from the SoC factory
      configuration in the flash OTP area, once the flash is up.
```

## drivers/clk/Kconfig.sf32lb52_pmuc
```kconfig
# SPDX-FileCopyrightText: 2026 Core Devices LLC
# SPDX-License-Identifier: Apache-2.0

config CLK_SF32LB52_PMUC
    bool "SiFli SF32LB52 PMUC"
    default y
    depends on DT_HAS_SIFLI_SF32LB52_PMUC_ENABLED
    select CLK_CAL
    help
      Oscillators of the SiFli SF32LB52 PMUC: the LRC10 low-power RC
      oscillator, whose rate is calibrated against the 48 MHz crystal, the
      LRC32 and HRC48 RC oscillators, the crystal oscillators and clk_wdt.

if CLK_SF32LB52_PMUC

config CLK_SF32LB52_PMUC_LRC10_CAL_GATE_CYCLES
    int "LRC10 calibration gate (LRC10 cycles)"
    range 200 65535
    default 2000
    help
      Length of each LRC10 measurement against the 48 MHz crystal. The
      LRC10 frequency noise averages down as the square root of the gate
      time; the crystal and the low-power domain stay on for the gate.

config CLK_SF32LB52_PMUC_LRC10_CAL_PERIOD_S
    int "LRC10 calibration period (seconds)"
    range 10 3600
    default 60
    help
      Time between LRC10 measurements, which follow its drift with
      temperature.

endif # CLK_SF32LB52_PMUC
```

## drivers/clk/Kconfig.sf32lb52_rtc
```kconfig
# SPDX-FileCopyrightText: 2026 Core Devices LLC
# SPDX-License-Identifier: Apache-2.0

config CLK_SF32LB52_RTC
    bool "SiFli SF32LB52 RTC clock"
    default y
    depends on DT_HAS_SIFLI_SF32LB52_RTC_ENABLED
    help
      clk_rtc of the SiFli SF32LB52 RTC, LRC10 or LXT32, which the RTC and
      the low-power timers count.
```

## drivers/clk/Kconfig.sf32lb57_pmuc
```kconfig
# SPDX-FileCopyrightText: 2026 Core Devices LLC
# SPDX-License-Identifier: Apache-2.0

config CLK_SF32LB57_PMUC
    bool "SiFli SF32LB57 PMUC"
    default y
    depends on DT_HAS_SIFLI_SF32LB57_PMUC_ENABLED
    select CLK_CAL
    help
      Oscillators of the SiFli SF32LB57 PMUC: the LRC10 low-power RC
      oscillator, whose rate is calibrated against the 48 MHz crystal, the
      LRC32 and HRC48 RC oscillators at their nominal rates, the crystal
      oscillators, clk_wdt and clk_rtc.

if CLK_SF32LB57_PMUC

config CLK_SF32LB57_PMUC_LRC10_CAL_GATE_CYCLES
    int "LRC10 calibration gate (LRC10 cycles)"
    range 200 65535
    default 2000
    help
      Length of each LRC10 measurement against the 48 MHz crystal, by the
      RC10CAL counter of the HPSYS RCC. Deep WFI is held off for the gate.

config CLK_SF32LB57_PMUC_LRC10_CAL_PERIOD_S
    int "LRC10 calibration period (seconds)"
    range 10 3600
    default 60
    help
      Time between LRC10 measurements, which follow its drift with
      temperature.

endif # CLK_SF32LB57_PMUC
```

## drivers/clk/Kconfig.sf32lb_lpsys_rcc
```kconfig
# SPDX-FileCopyrightText: 2026 Core Devices LLC
# SPDX-License-Identifier: Apache-2.0

config CLK_SF32LB_LPSYS_RCC
    bool "SiFli SF32LB LPSYS RCC"
    default y
    depends on DT_HAS_SIFLI_SF32LB52_LPSYS_RCC_ENABLED
    help
      Clocks of the SiFli SF32LB52 and SF32LB57 LPSYS, which the LCPU runs
      from.
```

## drivers/clk/Kconfig.stm32h7
```kconfig
# SPDX-FileCopyrightText: 2026 Core Devices LLC
# SPDX-License-Identifier: Apache-2.0

config CLK_STM32H7
    bool "ST STM32H7 RCC"
    default y
    depends on DT_HAS_ST_STM32H743_RCC_ENABLED
    help
      Clock controller of the ST STM32H7 RCC.
```

## drivers/crc/Kconfig
```kconfig
# SPDX-FileCopyrightText: 2026 Core Devices LLC
# SPDX-License-Identifier: Apache-2.0

menuconfig CRC_HW
    bool "Hardware CRC units"
    depends on CRC
    help
      Drivers of hardware CRC units (pbl/drivers/crc.h), which the CRC
      subsystem uses instead of computing in software.

if CRC_HW

rsource "Kconfig.sf32lb"
rsource "Kconfig.stm32"

config CRC_SHELL
    bool "Shell commands"
    default DRIVER_SHELL
    depends on SHELL && CRC_HW_ACCEL
    help
      The crc shell command, to check the CRC unit against the software
      implementation and time both.

endif # CRC_HW
```

## drivers/crc/Kconfig.sf32lb
```kconfig
# SPDX-FileCopyrightText: 2026 Core Devices LLC
# SPDX-License-Identifier: Apache-2.0

config CRC_SF32LB
    bool "SiFli SF32LB CRC unit"
    default y
    depends on DT_HAS_SIFLI_SF32LB52_CRC_ENABLED
    select CLK
    select CRC_HW_ACCEL
    help
      Computes CRC-32 and the legacy checksum on the SF32LB CRC unit.

if CRC_SF32LB || CRC_STM32

module = DRIVER_CRC
module-str = CRC
source "subsys/logging/Kconfig.template.log_level"

endif
```

## drivers/crc/Kconfig.stm32
```kconfig
# SPDX-FileCopyrightText: 2026 Core Devices LLC
# SPDX-License-Identifier: Apache-2.0

config CRC_STM32
    bool "STM32 CRC unit"
    default y
    depends on DT_HAS_ST_STM32F7_CRC_ENABLED
    select CLK
    select CRC_HW_ACCEL
    help
      Computes CRC-32 and the legacy checksum on the STM32 CRC unit.
```

## drivers/crypto/Kconfig
```kconfig
# SPDX-FileCopyrightText: 2026 Core Devices LLC
# SPDX-License-Identifier: Apache-2.0

menuconfig CRYPTO_HW
    bool "Hardware crypto accelerators"
    depends on CRYPTO
    help
      Drivers of hardware hash and cipher engines (pbl/drivers/crypto.h),
      which the crypto subsystem uses instead of computing in software.

if CRYPTO_HW

rsource "Kconfig.nrf_cracen"
rsource "Kconfig.sf32lb"

endif # CRYPTO_HW
```

## drivers/crypto/Kconfig.nrf_cracen
```kconfig
# SPDX-FileCopyrightText: 2026 Core Devices LLC
# SPDX-License-Identifier: Apache-2.0

config CRYPTO_NRF_CRACEN
    bool "Nordic nRF54L CRACEN"
    default y
    depends on DT_HAS_NORDIC_NRF54L15_CRACEN_ENABLED || DT_HAS_NORDIC_NRF54LM20A_CRACEN_ENABLED
    select MFD
    select MFD_NRF_CRACEN
    select CRYPTO_SHA256_HW_ACCEL
    select CRYPTO_AES_HW_ACCEL
    help
      Computes SHA-256 and AES in ECB mode on the cipher and hash engine
      of the Nordic nRF54L CRACEN.
```

## drivers/crypto/Kconfig.sf32lb
```kconfig
# SPDX-FileCopyrightText: 2026 Core Devices LLC
# SPDX-License-Identifier: Apache-2.0

config CRYPTO_SF32LB
    bool "SiFli SF32LB AES and hash accelerator"
    default y
    depends on DT_HAS_SIFLI_SF32LB52_AES_ENABLED
    select CLK
    select CRYPTO_SHA256_HW_ACCEL
    select CRYPTO_AES_HW_ACCEL
    help
      Computes SHA-256 and AES in ECB mode on the SF32LB crypto engine.
```

## drivers/disk/Kconfig
```kconfig
# SPDX-FileCopyrightText: 2026 Core Devices LLC
# SPDX-License-Identifier: Apache-2.0

menuconfig DISK
    bool "Disks"
    help
      Disk class (pbl/drivers/disk.h): block storage read and written by
      whole sectors, enabled by the application.

if DISK

config DISK_RAM
    bool "RAM disk"
    help
      A disk in RAM, pbl_disk_ram (pbl/drivers/disk/ram.h), in 512-byte
      sectors, zeroed at boot: its contents are lost at every reset.

config DISK_RAM_SIZE
    int "RAM disk size in KiB"
    default 64
    depends on DISK_RAM
    help
      Size of the RAM disk, taken from the RAM of the application.

endif # DISK
```

## drivers/display/Kconfig
```kconfig
# SPDX-FileCopyrightText: 2026 Core Devices LLC
# SPDX-License-Identifier: Apache-2.0

menuconfig DISPLAY
    bool "Display"
    help
      Display class (pbl/drivers/display.h) and its drivers: the
      controllers that take the framebuffer to the panel.

if DISPLAY

config DISPLAY_UPDATE_TIMEOUT_MS
    int "Update timeout, in milliseconds"
    default 200
    help
      Time an update has to complete, for the displays whose driver can
      abort one: past it, the update is stopped and ends with -ETIMEDOUT.

config DISPLAY_MAX_UPDATE_ROWS
    int "Most rows per update of a staging display"
    range 0 65535
    default 0
    help
      Most rows taken per update by the displays that stage updates in a
      transfer buffer, such as the Sharp memory LCDs, which sizes that
      buffer. Callers send more rows in bands of this many. 0 takes the
      whole panel at once.

rsource "Kconfig.sf32lb_lcdc"
rsource "Kconfig.sf32lb57_lcdc"
rsource "Kconfig.stm32_ltdc"
rsource "Kconfig.sharp_memory"
rsource "Kconfig.qemu"
rsource "Kconfig.sdl"

config DISPLAY_SHELL
    bool "Shell commands"
    default DRIVER_SHELL
    depends on SHELL
    help
      The display shell command, to show the display and turn its panel on
      or off.

module = DRIVER_DISPLAY
module-str = Display
source "subsys/logging/Kconfig.template.log_level"

endif # DISPLAY
```

## drivers/display/Kconfig.qemu
```kconfig
# SPDX-FileCopyrightText: 2026 Core Devices LLC
# SPDX-License-Identifier: Apache-2.0

config DISPLAY_QEMU
    bool "QEMU framebuffer display"
    default y
    depends on DT_HAS_QEMU_PEBBLE_DISPLAY_ENABLED
    help
      Support for the QEMU framebuffer display peripheral.
```

## drivers/display/Kconfig.sdl
```kconfig
# SPDX-FileCopyrightText: 2026 Core Devices LLC
# SPDX-License-Identifier: Apache-2.0

config DISPLAY_SDL
    bool "SDL window"
    default y
    depends on SOC_POSIX
    select SDL
    help
      Display shown in an SDL window on the host of a native build.

if DISPLAY_SDL

config DISPLAY_SDL_WIDTH
    int "SDL display width"
    help
      Width of the SDL display, in pixels.

config DISPLAY_SDL_HEIGHT
    int "SDL display height"
    help
      Height of the SDL display, in pixels.

config DISPLAY_SDL_MONO
    bool "SDL display is monochrome"
    help
      The SDL display takes a 1-bit framebuffer, 8-bit color otherwise.

config DISPLAY_SDL_ROUND
    bool "SDL display is round"
    help
      The SDL display hides the pixels outside the circle of the
      LS013B7DD02 panel.

endif # DISPLAY_SDL
```
