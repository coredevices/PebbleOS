## drivers/audio/Kconfig
```kconfig
# SPDX-FileCopyrightText: 2026 Core Devices LLC
# SPDX-License-Identifier: Apache-2.0

config MIC
    bool "Microphone"
    select AUDIO
    help
      The board has a microphone, the MIC capture device.

config SPEAKER
    bool "Speaker"
    select AUDIO
    help
      The board has a speaker, the SPEAKER playback device.

menuconfig AUDIO
    bool "Audio"
    help
      Audio stream class (pbl/drivers/audio.h) and its drivers.

if AUDIO

config AUDIO_AMP_GPIO
    bool "GPIO amplifier"
    default DT_HAS_AWINIC_AW8155_ENABLED
    select GPIO
    select REGULATOR
    help
      Amplifier switched by an enable GPIO, with an optional supply and
      enable mode pulses.

config AUDIO_SF32LB52_AUDCODEC
    bool "SiFli SF32LB52 audio codec"
    default DT_HAS_SIFLI_SF32LB52_AUDCODEC_ENABLED
    depends on SOC_SF32LB52
    select CLK
    select DMA
    select PINCTRL
    select RESET
    help
      Playback through the DAC of the SF32LB52 audio codec.

config AUDIO_SF32LB52_PDM
    bool "SiFli SF32LB52 PDM"
    default DT_HAS_SIFLI_SF32LB52_PDM_ENABLED
    depends on SOC_SF32LB52
    select CLK
    select DMA
    select PINCTRL
    select RESET
    help
      Capture from digital microphones on the SF32LB52 PDM interface.

config AUDIO_SF32LB52_PDM_IRQ_PRIO
    int "Interrupt priority"
    default 5
    depends on AUDIO_SF32LB52_PDM
    help
      Priority of the PDM interrupt.

config AUDIO_QEMU
    bool "QEMU audio device"
    default DT_HAS_QEMU_PEBBLE_AUDIO_ENABLED
    depends on SOC_QEMU_PEBBLE
    help
      Playback through the QEMU audio device.

config AUDIO_QEMU_IRQ_PRIO
    int "Interrupt priority"
    default 5
    depends on AUDIO_QEMU
    help
      Priority of the device interrupt.

config AUDIO_SIM_MIC
    bool "Simulated microphone"
    default y if MIC && (SOC_QEMU_PEBBLE || SOC_POSIX)
    help
      Simulated microphone, recording the audio written through its
      simulator API (pbl/drivers/audio/sim.h), and silence when none is.

config AUDIO_NRF5_PDM
    bool "Nordic nRF5 PDM"
    default DT_HAS_NORDIC_NRF52832_PDM_ENABLED
    depends on SOC_NRF52
    select CLK
    help
      Capture from digital microphones on the nRF5 PDM interface.

config AUDIO_NRF5_I2S
    bool "Nordic nRF5 I2S"
    default DT_HAS_NORDIC_NRF52832_I2S_ENABLED
    depends on SOC_NRF52
    select CLK
    help
      Playback through the nRF5 I2S interface.

config AUDIO_NRF5_PDM_IRQ_PRIO
    int "PDM interrupt priority"
    default 7
    depends on AUDIO_NRF5_PDM
    help
      Priority of the PDM interrupt.

config AUDIO_NRF5_I2S_IRQ_PRIO
    int "I2S interrupt priority"
    default 5
    depends on AUDIO_NRF5_I2S
    help
      Priority of the I2S interrupt.

config AUDIO_DMIC
    bool "Digital microphones"
    default DT_HAS_DMIC_CODEC_ENABLED
    select REGULATOR
    help
      Digital microphones on a PDM interface, powered while recording.

config AUDIO_DA7212
    bool "Dialog DA7212 codec"
    default DT_HAS_DLG_DA7212_ENABLED
    select I2C
    select REGULATOR
    help
      The Dialog DA7212 codec, playing to its line output.

config AUDIO_SHELL
    bool "Shell commands"
    default DRIVER_SHELL
    depends on SHELL
    help
      The audio shell command, to list the devices, record and play tones.

module = DRIVER_AUDIO
module-str = Audio
source "subsys/logging/Kconfig.template.log_level"

endif # AUDIO
```

## drivers/backlight/Kconfig
```kconfig
# SPDX-FileCopyrightText: 2026 Core Devices LLC
# SPDX-License-Identifier: Apache-2.0

menuconfig BACKLIGHT
    bool "Backlight"
    help
      Backlight Drivers

if BACKLIGHT

config BACKLIGHT_SHELL
    bool "Shell commands"
    default DRIVER_SHELL
    depends on SHELL
    help
      The backlight shell command, to set the brightness and color.

config BACKLIGHT_HAS_COLOR
    bool
    help
      Backlight drivers that support color should select this Kconfig symbol.

config BACKLIGHT_AW9364E
    bool "AW9364E"
    default DT_HAS_AWINIC_AW9364E_ENABLED
    select GPIO
    help
      Support for the AW9364E LED controller.

config BACKLIGHT_LED
    bool "LED"
    default DT_HAS_LED_BACKLIGHT_ENABLED
    select LED
    select BACKLIGHT_HAS_COLOR if LED_HAS_COLOR
    help
      Backlight on an LED, its color mixed by multicolor LEDs.

config BACKLIGHT_PWM
    bool "PWM"
    default DT_HAS_PWM_BACKLIGHT_ENABLED
    select PWM
    help
      Support for a backlight driven by a PWM peripheral.

config BACKLIGHT_QEMU
    bool "QEMU"
    default DT_HAS_QEMU_PEBBLE_DISPLAY_ENABLED
    depends on SOC_QEMU_PEBBLE
    help
      Emulated backlight controller that writes to the QEMU
      pebble-display MMIO registers.

config BACKLIGHT_POSIX
    bool "POSIX"
    default y if SOC_POSIX
    help
      Backlight of a native build, which does nothing.

config BACKLIGHT_QEMU_COLOR
    bool "QEMU Color"
    depends on BACKLIGHT_QEMU
    select BACKLIGHT_HAS_COLOR
    help
      Enable support for RGB backlight colors in the QEMU backlight driver.
  
module = DRIVER_BACKLIGHT
module-str = Backlight
source "subsys/logging/Kconfig.template.log_level"

endif # BACKLIGHT
```

## drivers/base/Kconfig
```kconfig
# SPDX-FileCopyrightText: 2026 Core Devices LLC
# SPDX-License-Identifier: Apache-2.0

menu "Device model"

module = DEVICE
module-str = Device model
source "subsys/logging/Kconfig.template.log_level"

config DEVICE_INIT_REVERSE
    bool "Initialize devices in reverse table order"
    help
      Debug option. Walk the device table backwards at boot, to check that
      no device relies on its place in the table to find what it needs
      ready.

endmenu
```

## drivers/battery/Kconfig
```kconfig
# SPDX-FileCopyrightText: 2026 Core Devices LLC
# SPDX-License-Identifier: Apache-2.0

config BATTERY_HIGH_LOAD
    bool
    help
      The battery driver implements battery_high_load_request() and
      battery_high_load_release().

config BATTERY_SIMPLE
    bool
    default DT_HAS_SIMPLE_BATTERY_ENABLED
    help
      The battery cell described in the devicetree, for chargers and fuel
      gauges to read.

menuconfig BATTERY
    bool "Battery"
    help
      Battery Drivers

if BATTERY

config BATTERY_SIM
    bool "Simulator"
    default y if SOC_QEMU_PEBBLE || SOC_POSIX
    help
      Simulated battery, set through its simulator API
      (pbl/drivers/battery/sim.h).

endif # BATTERY
```

## drivers/button/Kconfig
```kconfig
# SPDX-FileCopyrightText: 2026 Core Devices LLC
# SPDX-License-Identifier: Apache-2.0

menu "Button"

config BUTTON_NRF5
    bool "Nordic nRF5"
    default y if SOC_NRF52
    select HAL_NORDIC
    select INPUT
    help
      Support for buttons on Nordic nRF5 GPIOs.

config BUTTON_SF32LB
    bool "SiFli SF32LB"
    default y if SOC_SF32LB52
    select HAL_SIFLI
    select INPUT
    help
      Support for buttons on SiFli SF32LB GPIOs.

config BUTTON_QEMU
    bool "QEMU"
    default y if SOC_QEMU
    select INPUT
    help
      Support for the QEMU buttons.

config BUTTON_SDL
    bool "SDL keyboard"
    default y if SOC_POSIX
    select SDL
    select INPUT
    help
      Buttons driven by the keyboard, through SDL, in a native build.

endmenu
```

## drivers/clk/Kconfig
```kconfig
# SPDX-FileCopyrightText: 2026 Core Devices LLC
# SPDX-License-Identifier: Apache-2.0

config CLK
    bool
    help
      Clock controller class (pbl/drivers/clk.h), selected by the drivers
      that provide clocks.

config CLK_SHELL
    bool "Clock shell commands"
    default DRIVER_SHELL
    depends on SHELL && CLK
    help
      The clk shell command: list clocks and rates, and sample, hold and
      inspect calibrated clocks.

config CLK_FIXED
    bool "Fixed-rate clocks"
    default DT_HAS_FIXED_CLOCK_ENABLED
    select CLK
    help
      Clocks that always run at the same rate, as crystals.

config CLK_SF32LB
    bool "SiFli SF32LB RCC"
    default DT_HAS_SIFLI_SF32LB52_HPSYS_RCC_ENABLED
    select CLK
    help
      Clock controller of the SiFli SF32LB52 HPSYS RCC.

config CLK_CAL
    bool
    select CLK
    help
      Calibrated clocks (pbl/drivers/clk/cal.h), selected by the drivers
      of oscillators whose rate is measured against a reference.

if CLK_CAL

module = CLK_CAL
module-str = Calibrated clocks
source "subsys/logging/Kconfig.template.log_level"

endif # CLK_CAL

config CLK_SF32LB52_PMUC
    bool "SiFli SF32LB52 PMUC"
    default DT_HAS_SIFLI_SF32LB52_PMUC_ENABLED
    select CLK_CAL
    help
      Oscillators of the SiFli SF32LB52 PMUC: the LRC10 low-power RC
      oscillator, whose rate is calibrated against the 48 MHz crystal, the
      LRC32 and HRC48 RC oscillators, the crystal oscillators and clk_wdt.

if CLK_SF32LB52_PMUC

config CLK_SF32LB52_PMUC_LRC10_CAL_GATE_CYCLES
    int "LRC10 calibration gate (LRC10 cycles)"
    range 200 65535
    default 2000
    help
      Length of each LRC10 measurement against the 48 MHz crystal. The
      LRC10 frequency noise averages down as the square root of the gate
      time; the crystal and the low-power domain stay on for the gate.

config CLK_SF32LB52_PMUC_LRC10_CAL_PERIOD_S
    int "LRC10 calibration period (seconds)"
    range 10 3600
    default 60

module = CLK_SF32LB52_PMUC
module-str = SF32LB52 PMUC clocks
source "subsys/logging/Kconfig.template.log_level"

endif # CLK_SF32LB52_PMUC
```

## drivers/crc/Kconfig
```kconfig
# SPDX-FileCopyrightText: 2026 Core Devices LLC
# SPDX-License-Identifier: Apache-2.0

menuconfig CRC_HW
    bool "Hardware CRC units"
    depends on CRC
    help
      Drivers of hardware CRC units (pbl/drivers/crc.h), which the CRC
      subsystem uses instead of computing in software.

if CRC_HW

config CRC_SF32LB
    bool "SiFli SF32LB CRC unit"
    default DT_HAS_SIFLI_SF32LB52_CRC_ENABLED
    depends on SOC_SF32LB52
    select CLK
    select CRC_HW_ACCEL
    help
      Computes CRC-32 and the legacy checksum on the SF32LB CRC unit.

config CRC_SHELL
    bool "Shell commands"
    default DRIVER_SHELL
    depends on SHELL && CRC_HW_ACCEL
    help
      The crc shell command, to check the CRC unit against the software
      implementation and time both.

if CRC_SF32LB

module = DRIVER_CRC
module-str = CRC
source "subsys/logging/Kconfig.template.log_level"

endif

endif # CRC_HW
```

## drivers/crypto/Kconfig
```kconfig
# SPDX-FileCopyrightText: 2026 Core Devices LLC
# SPDX-License-Identifier: Apache-2.0

menuconfig CRYPTO_HW
    bool "Hardware crypto accelerators"
    depends on CRYPTO
    help
      Drivers of hardware hash and cipher engines (pbl/drivers/crypto.h),
      which the crypto subsystem uses instead of computing in software.

if CRYPTO_HW

config CRYPTO_SF32LB
    bool "SiFli SF32LB AES and hash accelerator"
    default DT_HAS_SIFLI_SF32LB52_AES_ENABLED
    depends on SOC_SF32LB52
    select CLK
    select CRYPTO_SHA256_HW_ACCEL
    select CRYPTO_AES_HW_ACCEL
    help
      Computes SHA-256 and AES in ECB mode on the SF32LB crypto engine.

endif # CRYPTO_HW
```

## drivers/display/Kconfig
```kconfig
# SPDX-FileCopyrightText: 2026 Core Devices LLC
# SPDX-License-Identifier: Apache-2.0

menuconfig DISPLAY
    bool "Display"
    help
      Display Drivers

if DISPLAY

config DISPLAY_SF32LB_LCDC
    bool "SiFli SF32LB LCD controller"
    default y if SOC_SF32LB52
    depends on PINCTRL
    select PANEL
    select HAL_SIFLI
    select HAL_SIFLI_LCD
    help
      Support for the SiFli SF32LB LCD controller, driving a JDI
      memory-in-pixel panel.

config DISPLAY_SHARP_LS013B7DH01
    bool "Sharp LS013B7DH01"
    default y if SOC_NRF52
    depends on PWM && SPI
    help
      Support for the Sharp LS013B7DH01 memory LCD.

config DISPLAY_QEMU
    bool "QEMU Framebuffer Display"
    default y if SOC_QEMU
    help
      Support for the QEMU framebuffer display peripheral.

config DISPLAY_SDL
    bool "SDL window"
    default y if SOC_POSIX
    select SDL
    help
      Display shown in an SDL window on the host of a native build.

config DISPLAY_SHELL
    bool "Shell commands"
    default y
    depends on SHELL
    help
      The display shell command, to show the display and turn its panel on
      or off.

module = DRIVER_DISPLAY
module-str = Display
source "subsys/logging/Kconfig.template.log_level"

endif # DISPLAY
```

## drivers/dma/Kconfig
```kconfig
# SPDX-FileCopyrightText: 2026 Core Devices LLC
# SPDX-License-Identifier: Apache-2.0

menuconfig DMA
    bool "DMA controllers"
    help
      DMA controller class (pbl/drivers/dma.h), selected by the drivers
      that move data through DMA channels.

if DMA

config DMA_SF32LB52
    bool "SiFli SF32LB52 DMA controller"
    default DT_HAS_SIFLI_SF32LB52_DMAC_ENABLED || DT_HAS_SIFLI_SF32LB57_GPDMA_ENABLED
    select CLK
    help
      The SF32LB52 HPSYS DMA controller (DMAC1), and the SF32LB57 HPSYS
      GPDMA1 used as one.

config DMA_SF32LB52_IRQ_PRIO
    int "Interrupt priority"
    default 5
    depends on DMA_SF32LB52
    help
      Priority of the channel interrupts.

endif # DMA
```

## drivers/exti/Kconfig
```kconfig
# SPDX-FileCopyrightText: 2026 Core Devices LLC
# SPDX-License-Identifier: Apache-2.0

menuconfig EXTI
    bool "External Interrupt"
    help
      External Interrupt Drivers

if EXTI

config EXTI_NRF5
    bool "Nordic nRF5"
    default y if SOC_NRF52
    select HAL_NORDIC
    help
      Support for the Nordic nRF5 external interrupt controller.

config EXTI_SF32LB
    bool "SiFli SF32LB"
    default y if SOC_SF32LB52
    depends on GPIO_SF32LB
    help
      Support for the SiFli SF32LB external interrupt controller, on top
      of the interrupt controller of the GPIO port.

module = DRIVER_EXTI
module-str = External Interrupt
source "subsys/logging/Kconfig.template.log_level"

endif # EXTI
```

## drivers/flash/Kconfig
```kconfig
# SPDX-FileCopyrightText: 2026 Core Devices LLC
# SPDX-License-Identifier: Apache-2.0

menuconfig FLASH
    bool "Flash"
    select CRC
    select TASK_WDT
    help
      Flash Drivers

if FLASH

config FLASH_OTP
    bool
    help
      Selected by drivers with a user one-time programmable area, see
      pbl_flash_otp_*().

config FLASH_SPI_NOR
    bool "SPI NOR"
    default DT_HAS_JEDEC_SPI_NOR_ENABLED
    select SPI_MEM
    select FLASH_OTP
    help
      Support for a JEDEC NOR flash on a SPI memory controller, found by
      its JEDEC ID among the supported parts and described by its SFDP
      tables and the part description.

config FLASH_QEMU
    bool "QEMU External Flash"
    default DT_HAS_QEMU_PEBBLE_EXTFLASH_ENABLED
    depends on SOC_QEMU_PEBBLE
    help
      Support for the QEMU external flash peripheral.

config FLASH_POSIX
    bool "POSIX External Flash"
    default y if SOC_POSIX
    help
      External flash backed by a file on the host.

config FLASH_SHELL
    bool "Shell commands"
    default DRIVER_SHELL
    depends on SHELL
    help
      The flash shell command, to inspect, erase and test the flash.

config FLASH_SHELL_TEST
    bool "Test commands"
    depends on FLASH_SHELL
    help
      The flash read, fill, validate and erased_sectors commands, to dump
      and verify the flash from a host.

config FLASH_SHELL_STRESS
    bool "Stress and benchmark commands"
    default y
    depends on FLASH_SHELL
    help
      The flash stress and benchmark commands. The stress test writes the
      firmware update area.

module = DRIVER_FLASH
module-str = Flash
source "subsys/logging/Kconfig.template.log_level"

endif # FLASH
```
