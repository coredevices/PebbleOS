## drivers/gpio/Kconfig
```kconfig
# SPDX-FileCopyrightText: 2026 Core Devices LLC
# SPDX-License-Identifier: Apache-2.0

menuconfig GPIO
    bool "GPIO"
    help
      GPIO Drivers

if GPIO

config GPIO_NRF5
    bool "Nordic nRF5"
    default DT_HAS_NORDIC_NRF52832_GPIO_ENABLED
    depends on SOC_NRF52
    select INTC
    help
      Support for the Nordic nRF5 GPIO controller.

config GPIO_SF32LB
    bool "SiFli SF32LB"
    default y if SOC_SF32LB52
    depends on SOC_SF32LB52
    select CLK
    select INTC
    select PINCTRL
    select PINCTRL_SF32LB52_OUTPUT_LOW
    help
      Support for the SiFli SF32LB GPIO controller.

config GPIO_SF32LB_IRQ_PRIO
    int "Interrupt priority"
    default 5
    depends on GPIO_SF32LB
    help
      Priority of the port interrupt.

config GPIO_QEMU
    bool "QEMU GPIO"
    default DT_HAS_QEMU_PEBBLE_GPIO_ENABLED
    depends on SOC_QEMU_PEBBLE
    select INTC
    help
      Support for the QEMU GPIO peripheral.

config GPIO_QEMU_IRQ_PRIO
    int "Interrupt priority"
    default 6
    depends on GPIO_QEMU
    help
      Priority of the port interrupt.

config GPIO_NPM1300
    bool "Nordic nPM1300 GPIO"
    default y
    depends on MFD_NPM1300
    help
      Support for the GPIOs of the Nordic nPM1300 PMIC.

config GPIO_SHELL
    bool "Shell commands"
    default DRIVER_SHELL
    depends on SHELL
    help
      The gpio shell command, to list the ports and to read, drive,
      configure and watch pins.

endif # GPIO
```

## drivers/hyperbus/Kconfig
```kconfig
# SPDX-FileCopyrightText: 2026 Core Devices LLC
# SPDX-License-Identifier: Apache-2.0

config HYPERBUS
    bool
    help
      HyperBus controller class (pbl/drivers/hyperbus.h), selected by
      the drivers of HyperBus memories.

if HYPERBUS

config HYPERBUS_SF32LB52_MPI
    bool "SiFli SF32LB52 MPI"
    default DT_HAS_SIFLI_SF32LB52_MPI_ENABLED
    depends on SOC_SF32LB52
    select MEMC_SF32LB52_MPI
    help
      Support for a HyperBus memory on the SiFli SF32LB52 MPI
      controller.

endif # HYPERBUS
```

## drivers/i2c/Kconfig
```kconfig
# SPDX-FileCopyrightText: 2026 Core Devices LLC
# SPDX-License-Identifier: Apache-2.0

menuconfig I2C
    bool "I2C"
    help
      I2C Drivers

if I2C

config I2C_NRF5
    bool "Nordic nRF5 I2C Controller"
    default DT_HAS_NORDIC_NRF52832_TWIM_ENABLED
    depends on SOC_NRF52
    select HAL_NORDIC
    help
      Support for the Nordic nRF5 I2C controller.

config I2C_NRF5_IRQ_PRIO
    int "Interrupt priority"
    default 7
    depends on I2C_NRF5
    help
      Priority of the controller interrupts.

config I2C_SF32LB
    bool "SiFli SF32LB I2C Controller"
    default DT_HAS_SIFLI_SF32LB52_I2C_ENABLED
    depends on SOC_SF32LB52
    select CLK
    select DMA
    select PINCTRL
    help
      Support for the SiFli SF32LB I2C controller.

config I2C_SF32LB_IRQ_PRIO
    int "Interrupt priority"
    default 5
    depends on I2C_SF32LB
    help
      Priority of the controller interrupts.

config I2C_SHELL
    bool "Shell commands"
    default DRIVER_SHELL
    depends on SHELL
    help
      The i2c shell command, to list the buses, scan them and read or
      write device registers.

module = DRIVER_I2C
module-str = I2C
source "subsys/logging/Kconfig.template.log_level"

endif # I2C
```

## drivers/input/Kconfig
```kconfig
# SPDX-FileCopyrightText: 2026 Core Devices LLC
# SPDX-License-Identifier: Apache-2.0

menu "Input"

config INPUT_ADC_KEYS
    bool "ADC keys"
    default DT_HAS_ADC_KEYS_IRQ_ENABLED
    depends on INPUT
    select ADC
    select GPIO
    help
      Keys on a resistor ladder read through an ADC channel on an
      interrupt that a press or release raises.

config INPUT_GPIO_KEYS
    bool "GPIO keys"
    default DT_HAS_GPIO_KEYS_ENABLED
    depends on INPUT
    select GPIO
    help
      Keys on GPIOs with interrupts, debounced in software.

config INPUT_SDL
    bool "SDL keyboard"
    default y if SOC_POSIX
    depends on INPUT
    select SDL
    help
      Watch buttons driven by the keyboard, through SDL, in a native build.

endmenu
```

## drivers/intc/Kconfig
```kconfig
# SPDX-FileCopyrightText: 2026 Core Devices LLC
# SPDX-License-Identifier: Apache-2.0

config INTC
    bool
    help
      Secondary interrupt controller class (pbl/drivers/intc.h), selected
      by the drivers that provide interrupt lines, such as GPIO ports.
```

## drivers/led/Kconfig
```kconfig
# SPDX-FileCopyrightText: 2026 Core Devices LLC
# SPDX-License-Identifier: Apache-2.0

menuconfig LED
    bool "LED"
    help
      LED Drivers

if LED

config LED_HAS_COLOR
    bool
    help
      Selected by the drivers of multicolor LEDs.

config LED_AW2016
    bool "Awinic AW2016"
    default DT_HAS_AWINIC_AW2016_ENABLED
    select I2C
    select LED_HAS_COLOR
    help
      Support for the Awinic AW2016 RGB LED controller.

module = DRIVER_LED
module-str = LED
source "subsys/logging/Kconfig.template.log_level"

endif # LED
```

## drivers/mbox/Kconfig
```kconfig
# SPDX-FileCopyrightText: 2026 Core Devices LLC
# SPDX-License-Identifier: Apache-2.0

menuconfig MBOX
    bool "Mailbox controllers"
    help
      Mailbox controller class (pbl/drivers/mbox.h), selected by the
      drivers that ring mailbox channels.

if MBOX

config MBOX_SF32LB52
    bool "SiFli SF32LB52 mailbox"
    default DT_HAS_SIFLI_SF32LB52_MAILBOX_ENABLED
    select CLK
    help
      SF32LB52 mailbox blocks (MAILBOX1, MAILBOX2), channel 1 doorbells.

config MBOX_SF32LB52_IRQ_PRIO
    int "Interrupt priority"
    default 5
    depends on MBOX_SF32LB52
    help
      Priority of the interrupt of the blocks rung by the remote.

config MBOX_SHELL
    bool "Mailbox shell commands"
    default DRIVER_SHELL
    depends on SHELL
    help
      The mbox shell command, to list the controllers with their channel
      counters and ring a channel.

endif # MBOX
```

## drivers/mcu/Kconfig
```kconfig
# SPDX-FileCopyrightText: 2026 Core Devices LLC
# SPDX-License-Identifier: Apache-2.0

menuconfig MCU
    bool "MCU information"
    help
      MCU information (pbl/drivers/mcu.h), such as the unique ID.

if MCU

config MCU_NRF5
    bool "Nordic nRF5"
    default y if SOC_NRF52
    select HAL_NORDIC
    help
      Support for Nordic nRF5 MCU information.

config MCU_SF32LB
    bool "SiFli SF32LB"
    default y if SOC_SF32LB52
    depends on SOC_SF32LB52
    select NVMEM
    help
      Support for SiFli SF32LB MCU information.

config MCU_QEMU
    bool "QEMU"
    default y if SOC_QEMU_PEBBLE
    help
      QEMU MCU information. QEMU emulates no unique ID, so it reports a
      fixed serial.

config MCU_POSIX
    bool "POSIX"
    default y if SOC_POSIX
    help
      MCU information for a native build.

endif # MCU
```

## drivers/memc/Kconfig
```kconfig
# SPDX-FileCopyrightText: 2026 Core Devices LLC
# SPDX-License-Identifier: Apache-2.0

config MEMC
    bool
    help
      Cores of the memory controllers that drive memories of more than
      one kind, each kind with a driver in its own subsystem. Selected
      by those drivers.

config MEMC_SF32LB52_MPI
    bool
    select MEMC
    select CLK
    select PINCTRL
    help
      Core of the SiFli SF32LB52 MPI controller: what its SPI memory
      and HyperBus drivers share.
```

## drivers/mfd/Kconfig
```kconfig
# SPDX-FileCopyrightText: 2026 Core Devices LLC
# SPDX-License-Identifier: Apache-2.0

menuconfig MFD
    bool "Multi-function devices"
    help
      Drivers for the core of chips that bundle several functions, each
      handled by a child device in its own subsystem.

if MFD

config MFD_NPM1300
    bool "Nordic nPM1300"
    help
      Support for the core of the Nordic nPM1300 PMIC: register access
      and its charger, GPIO and regulator cells.

endif # MFD
```

## drivers/mic/Kconfig
```kconfig
# SPDX-FileCopyrightText: 2026 Core Devices LLC
# SPDX-License-Identifier: Apache-2.0

menuconfig MIC
    bool "Microphone"
    help
      Microphone Drivers

if MIC

config MIC_NRF5
    bool "Nordic nRF5 PDM"
    default y if SOC_NRF52
    select HAL_NORDIC
    help
      Support for the Nordic nRF5 PDM microphone interface.

config MIC_NRF5_GAIN
    int "PDM gain"
    depends on MIC_NRF5
    range 0 80
    default 40
    help
      PDM gain in 0.5 dB steps, where 0 is -20 dB, 40 is 0 dB and 80 is
      +20 dB.

config MIC_SF32LB
    bool "SiFli SF32LB PDM"
    default y if SOC_SF32LB52
    select HAL_SIFLI
    select HAL_SIFLI_AUDCODEC
    select HAL_SIFLI_PDM
    select MIC_POLLING
    help
      Support for the SiFli SF32LB PDM microphone interface.

config MIC_QEMU
    bool "QEMU stub"
    default y if SOC_QEMU || SOC_POSIX
    help
      Software-only microphone for QEMU and native builds. Delivers audio the
      host sends over the QEMU channel (`pebble emu-mic`) at MIC_SAMPLE_RATE,
      and silence when there is none.

config MIC_POLLING
    bool
    help
      The driver implements mic_start_polling(), mic_poll() and
      mic_get_frame_time().

module = DRIVER_MIC
module-str = Microphone
source "subsys/logging/Kconfig.template.log_level"

endif # MIC
```

## drivers/nvmem/Kconfig
```kconfig
# SPDX-FileCopyrightText: 2026 Core Devices LLC
# SPDX-License-Identifier: Apache-2.0

menuconfig NVMEM
    bool "Non-volatile memories"
    help
      Non-volatile memory class (pbl/drivers/nvmem.h), selected by the
      code that reads cells.

if NVMEM

config NVMEM_SF32LB52
    bool "SiFli SF32LB52 eFuse"
    default DT_HAS_SIFLI_SF32LB52_EFUSE_ENABLED
    depends on SOC_SF32LB52
    select CLK
    help
      Read access to the SF32LB52 eFuse, which holds the unique ID and the
      factory calibration.

config NVMEM_SF32LB57
    bool "SiFli SF32LB57 eFuse"
    default DT_HAS_SIFLI_SF32LB57_EFUSE_ENABLED
    depends on SOC_SF32LB57
    select CLK
    help
      Read access to the SF32LB57 eFuse, which holds the unique ID and the
      factory calibration.

config NVMEM_SHELL
    bool "Non-volatile memory shell commands"
    default DRIVER_SHELL
    depends on SHELL
    help
      The nvmem shell command, to list the memories and read from them.

endif # NVMEM
```

## drivers/otp/Kconfig
```kconfig
# SPDX-FileCopyrightText: 2026 Core Devices LLC
# SPDX-License-Identifier: Apache-2.0

menuconfig OTP
    bool "OTP Storage"
    help
      One-Time Programmable storage for serial numbers, HW revision, etc.

if OTP

config OTP_FLASH
    bool "Flash security registers"
    depends on FLASH_OTP
    help
      OTP slots in the cells the board lays out in the flash OTP area
      (security registers on SPI NOR parts). Driver: otp_flash.c.

config OTP_QEMU
    bool "QEMU"
    default y if SOC_QEMU
    help
      QEMU OTP. QEMU emulates none, so all slots read as locked and empty.

config OTP_POSIX
    bool "POSIX"
    default y if SOC_POSIX
    help
      No OTP on the host: all slots read as locked and empty.

endif # OTP
```
