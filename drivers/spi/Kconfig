## drivers/spi/Kconfig
```kconfig
# SPDX-FileCopyrightText: 2026 Core Devices LLC
# SPDX-License-Identifier: Apache-2.0

menuconfig SPI
    bool "SPI"
    help
      SPI bus class (pbl/drivers/spi.h), selected by the drivers of the
      devices on a SPI bus.

if SPI

rsource "Kconfig.nrf5"
rsource "Kconfig.nrf54l"
rsource "Kconfig.sf32lb57"

config SPI_SHELL
    bool "Shell commands"
    default DRIVER_SHELL
    depends on SHELL && DEVICE_NAMES
    help
      The spi shell command, to list the buses and run transfers.

module = DRIVER_SPI
module-str = SPI
source "subsys/logging/Kconfig.template.log_level"

endif # SPI
```

## drivers/spi/Kconfig.nrf5
```kconfig
# SPDX-FileCopyrightText: 2026 Core Devices LLC
# SPDX-License-Identifier: Apache-2.0

config SPI_NRF5
    bool "Nordic nRF5 SPI controller"
    default y
    depends on DT_HAS_NORDIC_NRF52832_SPIM_ENABLED
    help
      Support for the Nordic nRF5 SPIM controller.

config SPI_NRF5_IRQ_PRIO
    int "Interrupt priority"
    default 1
    depends on SPI_NRF5
    help
      Priority of the controller interrupts.
```

## drivers/spi/Kconfig.nrf54l
```kconfig
# SPDX-FileCopyrightText: 2026 Core Devices LLC
# SPDX-License-Identifier: Apache-2.0

config SPI_NRF54L
    bool "Nordic nRF54L SPI controller"
    default y
    depends on DT_HAS_NORDIC_NRF54L15_SPIM_ENABLED
    select GPIO
    help
      Support for the Nordic nRF54L SPIM controller.

config SPI_NRF54L_IRQ_PRIO
    int "Interrupt priority"
    default 1
    depends on SPI_NRF54L
    help
      Priority of the controller interrupts.
```

## drivers/spi/Kconfig.sf32lb57
```kconfig
# SPDX-FileCopyrightText: 2026 Core Devices LLC
# SPDX-License-Identifier: Apache-2.0

config SPI_SF32LB57
    bool "SiFli SF32LB57 SPI Controller"
    default y
    depends on DT_HAS_SIFLI_SF32LB57_SPI_ENABLED
    select CLK
    select DMA
    select GPIO
    select PINCTRL
    help
      Support for the SiFli SF32LB57 SPI controller.

config SPI_SF32LB57_IRQ_PRIO
    int "Interrupt priority"
    default 1
    depends on SPI_SF32LB57
    help
      Priority of the controller interrupts.
```

## drivers/spi_mem/Kconfig
```kconfig
# SPDX-FileCopyrightText: 2026 Core Devices LLC
# SPDX-License-Identifier: Apache-2.0

menuconfig SPI_MEM
    bool "SPI memory controllers"
    help
      Controllers running command, address, dummy and data operations
      against SPI memories.

if SPI_MEM

config SPI_MEM_NRF5_QSPI
    bool "Nordic nRF5 QSPI"
    default y
    depends on DT_HAS_NORDIC_NRF52840_QSPI_ENABLED
    help
      Support for the Nordic nRF5 QSPI peripheral.

config SPI_MEM_NRF5_QSPI_IRQ_PRIO
    int "Interrupt priority"
    default 5
    depends on SPI_MEM_NRF5_QSPI
    help
      Priority of the controller interrupt.

config SPI_MEM_SF32LB_MPI
    bool "SiFli SF32LB MPI"
    default y
    depends on DT_HAS_SIFLI_SF32LB52_MPI_ENABLED || DT_HAS_SIFLI_SF32LB57_MPI_ENABLED
    select MEMC_SF32LB_MPI
    help
      Support for a SPI NOR flash on the SiFli SF32LB52 and SF32LB57 MPI
      controllers.

module = DRIVER_SPI_MEM
module-str = SPI memory
source "subsys/logging/Kconfig.template.log_level"

endif # SPI_MEM
```

## drivers/spi_mem/Kconfig.nrf5_qspi
```kconfig
# SPDX-FileCopyrightText: 2026 Core Devices LLC
# SPDX-License-Identifier: Apache-2.0

config SPI_MEM_NRF5_QSPI
    bool "Nordic nRF5 QSPI"
    default y
    depends on DT_HAS_NORDIC_NRF52840_QSPI_ENABLED
    help
      Support for the Nordic nRF5 QSPI peripheral.

config SPI_MEM_NRF5_QSPI_IRQ_PRIO
    int "Interrupt priority"
    default 1
    depends on SPI_MEM_NRF5_QSPI
    help
      Priority of the controller interrupt.
```

## drivers/spi_mem/Kconfig.spi
```kconfig
# SPDX-FileCopyrightText: 2026 Core Devices LLC
# SPDX-License-Identifier: Apache-2.0

config SPI_MEM_SPI
    bool "Memories on a SPI bus"
    default y
    depends on DT_HAS_JEDEC_SPI_NOR_ENABLED
    depends on DT_HAS_NORDIC_NRF54L15_SPIM_ENABLED
    select SPI
    help
      Run single-line memory operations as transfers on a SPI controller
      with no memory operations of its own, for a memory that is a child
      of the controller in the devicetree.
```

## drivers/spi_mem/Kconfig.stm32_qspi
```kconfig
# SPDX-FileCopyrightText: 2026 Core Devices LLC
# SPDX-License-Identifier: Apache-2.0

config SPI_MEM_STM32_QSPI
    bool "ST STM32 QUADSPI"
    default y
    depends on DT_HAS_ST_STM32F469_QSPI_ENABLED
    select CLK
    select PINCTRL
    help
      Support for the ST STM32 QUADSPI controller.
```

## drivers/temp/Kconfig
```kconfig
# SPDX-FileCopyrightText: 2026 Core Devices LLC
# SPDX-License-Identifier: Apache-2.0

menuconfig TEMP
    bool "Temperature sensor"
    help
      Temperature sensor class (pbl/drivers/temp.h) and its drivers.

if TEMP

config TEMP_SHELL
    bool "Shell commands"
    default DRIVER_SHELL
    depends on SHELL
    help
      The temp shell command, to read the die temperature.

rsource "Kconfig.nrf5"
rsource "Kconfig.sf32lb"
rsource "Kconfig.stm32h7_adc"
rsource "Kconfig.sim"

endif # TEMP
```

## drivers/temp/Kconfig.nrf5
```kconfig
# SPDX-FileCopyrightText: 2026 Core Devices LLC
# SPDX-License-Identifier: Apache-2.0

config TEMP_NRF5
    bool "Nordic nRF5"
    default y
    depends on DT_HAS_NORDIC_NRF52832_TEMP_ENABLED
    help
      Support for the Nordic nRF5 die temperature sensor.
```

## drivers/temp/Kconfig.sf32lb
```kconfig
# SPDX-FileCopyrightText: 2026 Core Devices LLC
# SPDX-License-Identifier: Apache-2.0

config TEMP_SF32LB
    bool "SiFli SF32LB"
    default y
    depends on DT_HAS_SIFLI_SF32LB52_TSEN_ENABLED
    select CLK
    help
      Support for the SiFli SF32LB temperature sensor.
```

## drivers/timer/Kconfig
```kconfig
# SPDX-FileCopyrightText: 2026 Core Devices LLC
# SPDX-License-Identifier: Apache-2.0

menu "System timer"

rsource "Kconfig.arm_systick"
rsource "Kconfig.qemu"
rsource "Kconfig.nrf5_rtc"
rsource "Kconfig.nrf_grtc"
rsource "Kconfig.sf32lb_lptim"
rsource "Kconfig.stm32_lptim"
rsource "Kconfig.posix"

endmenu
```

## drivers/timer/Kconfig.arm_systick
```kconfig
# SPDX-FileCopyrightText: 2026 Core Devices LLC
# SPDX-License-Identifier: Apache-2.0

config TIMER_ARM_SYSTICK
    bool "Arm SysTick"
    depends on CPU_CORTEX_M
    help
      Clock event device on the Arm SysTick timer, counting CPU cycles. It
      stops in deep sleep.

config TIMER_ARM_SYSTICK_IRQ_PRIO
    int "Interrupt priority"
    default 0
    depends on TIMER_ARM_SYSTICK
    help
      Priority of the SysTick exception.
```

## drivers/timer/Kconfig.nrf5_rtc
```kconfig
# SPDX-FileCopyrightText: 2026 Core Devices LLC
# SPDX-License-Identifier: Apache-2.0

config TIMER_NRF5_RTC
    bool
    select CLK
    help
      Clock source and clock event device on RTC1, counting the 32.768 kHz
      low-frequency clock. It keeps running in every sleep mode. Selected
      by the SoC.

config TIMER_NRF5_RTC_IRQ_PRIO
    int "Interrupt priority"
    default 1
    depends on TIMER_NRF5_RTC
    help
      Priority of the RTC1 interrupt.
```

## drivers/timer/Kconfig.nrf_grtc
```kconfig
# SPDX-FileCopyrightText: 2026 Core Devices LLC
# SPDX-License-Identifier: Apache-2.0

config TIMER_NRF_GRTC
    bool
    select CLK
    help
      Clock source and clock event device on the GRTC, counting
      microseconds. It keeps the time from the 32.768 kHz low-frequency
      clock in every sleep mode. Selected by the SoC.

config TIMER_NRF_GRTC_IRQ_PRIO
    int "Interrupt priority"
    default 1
    depends on TIMER_NRF_GRTC
    help
      Priority of the GRTC interrupt.
```

## drivers/timer/Kconfig.posix
```kconfig
# SPDX-FileCopyrightText: 2026 Core Devices LLC
# SPDX-License-Identifier: Apache-2.0

config TIMER_POSIX
    bool
    help
      Clock source and clock event device on the host monotonic clock.
      Selected by the SoC.
```

## drivers/timer/Kconfig.qemu
```kconfig
# SPDX-FileCopyrightText: 2026 Core Devices LLC
# SPDX-License-Identifier: Apache-2.0

config TIMER_QEMU
    bool
    help
      Clock source on the 1 kHz counter of the QEMU RTC. Selected by the
      SoC.
```

## drivers/timer/Kconfig.sf32lb_lptim
```kconfig
# SPDX-FileCopyrightText: 2026 Core Devices LLC
# SPDX-License-Identifier: Apache-2.0

config TIMER_SF32LB_LPTIM
    bool
    select CLK
    help
      Clock source and clock event device on LPTIM1, counting clk_rtc, the
      calibrated LRC10 or the 32 kHz crystal. It keeps running and wakes the
      CPU up in deep sleep. Selected by the SoC.

config TIMER_SF32LB_LPTIM_IRQ_PRIO
    int "Interrupt priority"
    default 0
    depends on TIMER_SF32LB_LPTIM
    help
      Priority of the LPTIM1 interrupt.
```

## drivers/timer/Kconfig.stm32_lptim
```kconfig
# SPDX-FileCopyrightText: 2026 Core Devices LLC
# SPDX-License-Identifier: Apache-2.0

config TIMER_STM32_LPTIM
    bool
    select CLK
    select RESET
    help
      Clock source and clock event device on the LPTIM of the STM32H7 the
      board enables its timer function on, counting its kernel clock,
      the 32.768 kHz crystal on boards that have one. It keeps running and
      wakes the CPU up in Stop mode. Selected by the SoC.

config TIMER_STM32_LPTIM_IRQ_PRIO
    int "Interrupt priority"
    default 0
    depends on TIMER_STM32_LPTIM
    help
      Priority of the LPTIM interrupt.
```

## drivers/touch/Kconfig
```kconfig
# SPDX-FileCopyrightText: 2026 Core Devices LLC
# SPDX-License-Identifier: Apache-2.0

menuconfig TOUCH
    bool "Touchscreen"
    select INPUT
    help
      Touchscreen class (pbl/drivers/touch.h) and its drivers, which
      report touches as input events.

if TOUCH

config TOUCH_SHELL
    bool "Shell commands"
    default DRIVER_SHELL
    depends on SHELL
    help
      The touch shell command, to inspect the touchscreen and hold it
      powered up.

rsource "Kconfig.cst816"
rsource "Kconfig.ft6236"
rsource "Kconfig.qemu"
rsource "Kconfig.sdl"

module = DRIVER_TOUCH
module-str = Touchscreen
source "subsys/logging/Kconfig.template.log_level"

endif # TOUCH
```

## drivers/touch/Kconfig.cst816
```kconfig
# SPDX-FileCopyrightText: 2026 Core Devices LLC
# SPDX-License-Identifier: Apache-2.0

config TOUCH_CST816
    bool "Hynitron CST816"
    default y
    depends on DT_HAS_HYNITRON_CST816S_ENABLED
    select I2C
    select CST816_FW
    select KERNEL_SYS_WORKQ
    select PINCTRL
    help
      Support for the Hynitron CST816 touch controller.
```

## drivers/touch/Kconfig.ft6236
```kconfig
# SPDX-FileCopyrightText: 2026 Core Devices LLC
# SPDX-License-Identifier: Apache-2.0

config TOUCH_FT6236
    bool "FocalTech FT6x36"
    default y
    depends on DT_HAS_FOCALTECH_FT6236_ENABLED
    select I2C
    select KERNEL_SYS_WORKQ
    select PINCTRL
    help
      Support for the FocalTech FT6x36 touch controllers, such as the
      FT6236 and the FT6146.
```

## drivers/touch/Kconfig.qemu
```kconfig
# SPDX-FileCopyrightText: 2026 Core Devices LLC
# SPDX-License-Identifier: Apache-2.0

config TOUCH_QEMU
    bool "QEMU touchscreen"
    default y
    depends on DT_HAS_QEMU_PEBBLE_TOUCH_ENABLED
    select KERNEL_SYS_WORKQ
    help
      Support for the QEMU touchscreen peripheral.

config TOUCH_QEMU_IRQ_PRIO
    int "Interrupt priority"
    default 0
    depends on TOUCH_QEMU
    help
      Priority of the touchscreen interrupt.
```

## drivers/touch/Kconfig.sdl
```kconfig
# SPDX-FileCopyrightText: 2026 Core Devices LLC
# SPDX-License-Identifier: Apache-2.0

config TOUCH_SDL
    bool "SDL mouse"
    default y
    depends on DISPLAY_SDL
    select KERNEL_SYS_WORKQ
    select SDL
    help
      Touchscreen driven by the mouse, through SDL, in a native build.

if TOUCH_SDL

config TOUCH_SDL_SIZE_X
    int "SDL touchscreen X coordinates"
    default DISPLAY_SDL_WIDTH
    help
      Number of X coordinates the SDL touchscreen reports.

config TOUCH_SDL_SIZE_Y
    int "SDL touchscreen Y coordinates"
    default DISPLAY_SDL_HEIGHT
    help
      Number of Y coordinates the SDL touchscreen reports.

endif # TOUCH_SDL
```

## drivers/uart/Kconfig
```kconfig
# SPDX-FileCopyrightText: 2026 Core Devices LLC
# SPDX-License-Identifier: Apache-2.0

menuconfig UART
    bool "UART"
    help
      UART class (pbl/drivers/uart.h) and its drivers.

if UART

rsource "Kconfig.nrf5"
rsource "Kconfig.nrf54l"
rsource "Kconfig.sf32lb"
rsource "Kconfig.stm32"
rsource "Kconfig.qemu"
rsource "Kconfig.posix"

config UART_SHELL
    bool "Shell commands"
    default DRIVER_SHELL
    depends on SHELL && DEVICE_NAMES
    help
      The uart shell command, to list the ports, change their line
      settings and send text.

module = DRIVER_UART
module-str = UART
source "subsys/logging/Kconfig.template.log_level"

endif # UART
```
