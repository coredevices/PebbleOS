## drivers/mbox/Kconfig.stm32_hsem
```kconfig
# SPDX-FileCopyrightText: 2026 Core Devices LLC
# SPDX-License-Identifier: Apache-2.0

config MBOX_STM32_HSEM
    bool "STM32H7 hardware semaphore doorbells"
    default y
    depends on DT_HAS_ST_STM32_HWSPINLOCK_ENABLED
    select CLK
    help
      Doorbells between the cores of a dual-core STM32H7, rung by
      releasing a hardware semaphore.

config MBOX_STM32_HSEM_IRQ_PRIO
    int "Interrupt priority"
    default 0
    depends on MBOX_STM32_HSEM
```

## drivers/mcu/Kconfig
```kconfig
# SPDX-FileCopyrightText: 2026 Core Devices LLC
# SPDX-License-Identifier: Apache-2.0

menuconfig MCU
    bool "MCU information"
    help
      MCU information (pbl/drivers/mcu.h), such as the unique ID.

if MCU

rsource "Kconfig.nrf5"
rsource "Kconfig.nrf54l"
rsource "Kconfig.sf32lb"
rsource "Kconfig.stm32"
rsource "Kconfig.qemu"
rsource "Kconfig.posix"

endif # MCU
```

## drivers/mcu/Kconfig.nrf5
```kconfig
# SPDX-FileCopyrightText: 2026 Core Devices LLC
# SPDX-License-Identifier: Apache-2.0

config MCU_NRF5
    bool "Nordic nRF5"
    default y
    depends on SOC_NRF52
    select NVMEM
    help
      Support for Nordic nRF5 MCU information.
```

## drivers/mcu/Kconfig.nrf54l
```kconfig
# SPDX-FileCopyrightText: 2026 Core Devices LLC
# SPDX-License-Identifier: Apache-2.0

config MCU_NRF54L
    bool "Nordic nRF54L"
    default y
    depends on SOC_NRF54L
    select NVMEM
    help
      Support for Nordic nRF54L MCU information.
```

## drivers/mcu/Kconfig.posix
```kconfig
# SPDX-FileCopyrightText: 2026 Core Devices LLC
# SPDX-License-Identifier: Apache-2.0

config MCU_POSIX
    bool "POSIX"
    default y
    depends on SOC_POSIX
    help
      MCU information for a native build.
```

## drivers/mcu/Kconfig.qemu
```kconfig
# SPDX-FileCopyrightText: 2026 Core Devices LLC
# SPDX-License-Identifier: Apache-2.0

config MCU_QEMU
    bool "QEMU"
    default y
    depends on SOC_QEMU_PEBBLE
    help
      QEMU MCU information. QEMU emulates no unique ID, so it reports a
      fixed serial.
```

## drivers/mcu/Kconfig.sf32lb
```kconfig
# SPDX-FileCopyrightText: 2026 Core Devices LLC
# SPDX-License-Identifier: Apache-2.0

config MCU_SF32LB
    bool "SiFli SF32LB"
    default y
    depends on SOC_SF32LB52 || SOC_SF32LB57
    select NVMEM
    help
      Support for SiFli SF32LB MCU information.
```

## drivers/mcu/Kconfig.stm32
```kconfig
# SPDX-FileCopyrightText: 2026 Core Devices LLC
# SPDX-License-Identifier: Apache-2.0

config MCU_STM32
    bool "ST STM32"
    default y
    depends on SOC_STM32H7
    select NVMEM
    help
      Support for ST STM32 MCU information.
```

## drivers/memc/Kconfig
```kconfig
# SPDX-FileCopyrightText: 2026 Core Devices LLC
# SPDX-License-Identifier: Apache-2.0

config MEMC
    bool
    help
      Cores of the memory controllers that drive memories of more than
      one kind, each kind with a driver in its own subsystem. Selected
      by those drivers.

rsource "Kconfig.sf32lb_mpi"
```

## drivers/memc/Kconfig.sf32lb_mpi
```kconfig
# SPDX-FileCopyrightText: 2026 Core Devices LLC
# SPDX-License-Identifier: Apache-2.0

config MEMC_SF32LB_MPI
    bool
    select MEMC
    select CLK
    select PINCTRL
    help
      Core of the SiFli SF32LB52 and SF32LB57 MPI controllers: what
      their SPI memory and HyperBus drivers share.
```

## drivers/mfd/Kconfig
```kconfig
# SPDX-FileCopyrightText: 2026 Core Devices LLC
# SPDX-License-Identifier: Apache-2.0

menuconfig MFD
    bool "Multi-function devices"
    help
      Drivers for the core of chips that bundle several functions, each
      handled by a child device in its own subsystem.

if MFD

rsource "Kconfig.npm1300"
rsource "Kconfig.nrf_cracen"

endif # MFD
```

## drivers/mfd/Kconfig.nrf_cracen
```kconfig
# SPDX-FileCopyrightText: 2026 Core Devices LLC
# SPDX-License-Identifier: Apache-2.0

config MFD_NRF_CRACEN
    bool
    help
      Core of the Nordic nRF54L CRACEN crypto accelerator, which turns
      its random number generator and its engines on and off for their
      drivers.
```

## drivers/mipi_dbi/Kconfig
```kconfig
# SPDX-FileCopyrightText: 2026 Core Devices LLC
# SPDX-License-Identifier: Apache-2.0

config MIPI_DBI
    bool
    help
      MIPI DBI host class (pbl/drivers/mipi_dbi.h), selected by the
      controllers that send commands to a panel and by the panel drivers
      using them.
```

## drivers/mipi_dsi/Kconfig
```kconfig
# SPDX-FileCopyrightText: 2026 Core Devices LLC
# SPDX-License-Identifier: Apache-2.0

config MIPI_DSI
    bool
    help
      MIPI DSI host class (pbl/drivers/mipi_dsi.h), selected by the
      controllers that drive panels over MIPI DSI and by the panel
      drivers using them.

if MIPI_DSI

rsource "Kconfig.stm32"

endif # MIPI_DSI
```

## drivers/nvmem/Kconfig
```kconfig
# SPDX-FileCopyrightText: 2026 Core Devices LLC
# SPDX-License-Identifier: Apache-2.0

menuconfig NVMEM
    bool "Non-volatile memories"
    help
      Non-volatile memory class (pbl/drivers/nvmem.h), selected by the
      code that reads cells.

if NVMEM

rsource "Kconfig.sf32lb"
rsource "Kconfig.nrf_ficr"
rsource "Kconfig.stm32_romem"

config NVMEM_SHELL
    bool "Non-volatile memory shell commands"
    default DRIVER_SHELL
    depends on SHELL && DEVICE_NAMES
    help
      The nvmem shell command, to list the memories and read from them.

endif # NVMEM
```

## drivers/nvmem/Kconfig.nrf_ficr
```kconfig
# SPDX-FileCopyrightText: 2026 Core Devices LLC
# SPDX-License-Identifier: Apache-2.0

config NVMEM_NRF_FICR
    bool "Nordic nRF FICR"
    default y
    depends on DT_HAS_NORDIC_NRF52832_FICR_ENABLED || DT_HAS_NORDIC_NRF54L15_FICR_ENABLED
    help
      Read access to the factory information of the Nordic nRF SoCs, as
      their device ID and the trims of their crystal oscillators.
```

## drivers/nvmem/Kconfig.stm32_romem
```kconfig
# SPDX-FileCopyrightText: 2026 Core Devices LLC
# SPDX-License-Identifier: Apache-2.0

config NVMEM_STM32_ROMEM
    bool "STM32 factory-programmed data"
    default y
    depends on DT_HAS_ST_STM32F4_OTP_ENABLED
    help
      Read access to the read-only memory an STM32 holds its factory data
      in, as the unique ID and the calibration of the analog blocks of the
      STM32H7.
```

## drivers/otp/Kconfig
```kconfig
# SPDX-FileCopyrightText: 2026 Core Devices LLC
# SPDX-License-Identifier: Apache-2.0

menuconfig OTP
    bool "OTP storage"
    help
      One-time programmable storage class (pbl/drivers/otp.h), for serial
      numbers, the hardware revision and other factory data.

if OTP

rsource "Kconfig.flash"
rsource "Kconfig.qemu"
rsource "Kconfig.posix"

endif # OTP
```

## drivers/otp/Kconfig.flash
```kconfig
# SPDX-FileCopyrightText: 2026 Core Devices LLC
# SPDX-License-Identifier: Apache-2.0

config OTP_FLASH
    bool "Flash security registers"
    default y
    depends on FLASH_OTP
    help
      OTP slots in the cells the board lays out in the flash OTP area
      (security registers on SPI NOR parts). Driver: otp_flash.c.
```

## drivers/otp/Kconfig.posix
```kconfig
# SPDX-FileCopyrightText: 2026 Core Devices LLC
# SPDX-License-Identifier: Apache-2.0

config OTP_POSIX
    bool "POSIX"
    default y
    depends on SOC_POSIX
    help
      No OTP on the host: all slots read as locked and empty.
```

## drivers/otp/Kconfig.qemu
```kconfig
# SPDX-FileCopyrightText: 2026 Core Devices LLC
# SPDX-License-Identifier: Apache-2.0

config OTP_QEMU
    bool "QEMU"
    default y
    depends on SOC_QEMU_PEBBLE
    help
      QEMU OTP. QEMU emulates none, so all slots read as locked and empty.
```

## drivers/panel/Kconfig
```kconfig
# SPDX-FileCopyrightText: 2026 Core Devices LLC
# SPDX-License-Identifier: Apache-2.0

config PANEL
    bool
    help
      Panel class, selected by the display controllers driving a panel.

config PANEL_QSPI
    bool
    help
      Panels on quad SPI, selected by their drivers, for the display
      controllers to build that interface.

config PANEL_JDI_PARALLEL
    bool
    help
      Panels on the JDI parallel interface, selected by their drivers, for
      the display controllers to build that interface.

rsource "Kconfig.jdi_mip"
rsource "Kconfig.co5300"
rsource "Kconfig.otm8009a"

if PANEL

module = DRIVER_PANEL
module-str = Panel
source "subsys/logging/Kconfig.template.log_level"

endif # PANEL
```

## drivers/panel/Kconfig.co5300
```kconfig
# SPDX-FileCopyrightText: 2026 Core Devices LLC
# SPDX-License-Identifier: Apache-2.0

config PANEL_CO5300
    bool "ChipOne CO5300 AMOLED panels"
    default y
    depends on DT_HAS_CHIPONE_CO5300_ENABLED
    depends on PANEL
    select BACKLIGHT
    select GPIO
    select MIPI_DBI
    select PANEL_QSPI
    help
      Support for AMOLED panels on the ChipOne CO5300 driver IC, over quad
      SPI, with their brightness as a backlight.
```

## drivers/panel/Kconfig.otm8009a
```kconfig
# SPDX-FileCopyrightText: 2026 Core Devices LLC
# SPDX-License-Identifier: Apache-2.0

config PANEL_OTM8009A
    bool "Orise Tech OTM8009A"
    default y
    depends on DT_HAS_ORISETECH_OTM8009A_ENABLED
    depends on PANEL
    select BACKLIGHT
    select GPIO
    select MIPI_DSI
    help
      Support for 480x800 panels on the Orise Tech OTM8009A driver IC,
      over MIPI DSI.
```

## drivers/phy/Kconfig
```kconfig
# SPDX-FileCopyrightText: 2026 Core Devices LLC
# SPDX-License-Identifier: Apache-2.0

menuconfig PHY
    bool "PHYs"
    help
      PHY class (pbl/drivers/phy.h), selected by the controllers that take
      a PHY.

if PHY

endif # PHY
```
