## drivers/hrm/Kconfig.gh3x2x
```kconfig
# SPDX-FileCopyrightText: 2026 Core Devices LLC
# SPDX-License-Identifier: Apache-2.0

config HRM_GH3X2X
    bool "Goodix GH3X2X"
    select KERNEL_SYS_WORKQ
    help
      Support for the Goodix GH3X2X heart rate sensor.

config HRM_GH3X2X_FACTORY_TEST
    bool "GH3X2X factory tests"
    depends on GH3X2X_ALGO
    help
      The GH3X2X CTR, light leakage and noise factory tests, sampling heart
      rate and SpO2 together.
```

## drivers/hrm/Kconfig.qemu
```kconfig
# SPDX-FileCopyrightText: 2026 Core Devices LLC
# SPDX-License-Identifier: Apache-2.0

config HRM_QEMU
    bool "QEMU"
    default y
    depends on SOC_QEMU_PEBBLE
    help
      QEMU heart rate monitor. QEMU emulates none, so it can be enabled
      but never delivers samples.
```

## drivers/hwspinlock/Kconfig
```kconfig
# SPDX-FileCopyrightText: 2026 Core Devices LLC
# SPDX-License-Identifier: Apache-2.0

menuconfig HWSPINLOCK
    bool "Hardware spinlocks"
    help
      Hardware spinlock class (pbl/drivers/hwspinlock.h), selected by the
      drivers that share registers with other processors.

if HWSPINLOCK

config HWSPINLOCK_TIMEOUT_US
    int "Timeout, in microseconds"
    default 1000
    help
      How long a processor waits for a lock another one holds before giving
      up, which only happens when the holder stopped with it.

config HWSPINLOCK_STM32_HSEM
    bool "STM32H7 hardware semaphores"
    default y
    depends on DT_HAS_ST_STM32_HWSPINLOCK_ENABLED
    select CLK
    help
      Hardware spinlocks between the cores of a dual-core STM32H7, taken
      with the hardware semaphores.

endif # HWSPINLOCK
```

## drivers/hwspinlock/Kconfig.stm32_hsem
```kconfig
# SPDX-FileCopyrightText: 2026 Core Devices LLC
# SPDX-License-Identifier: Apache-2.0

config HWSPINLOCK_STM32_HSEM
    bool "STM32H7 hardware semaphores"
    default y
    depends on DT_HAS_ST_STM32_HWSPINLOCK_ENABLED
    select CLK
    help
      Hardware spinlocks between the cores of a dual-core STM32H7, taken
      with the hardware semaphores.
```

## drivers/hyperbus/Kconfig
```kconfig
# SPDX-FileCopyrightText: 2026 Core Devices LLC
# SPDX-License-Identifier: Apache-2.0

config HYPERBUS
    bool
    help
      HyperBus controller class (pbl/drivers/hyperbus.h), selected by
      the drivers of HyperBus memories.

if HYPERBUS

config HYPERBUS_SF32LB_MPI
    bool "SiFli SF32LB MPI"
    default y
    depends on DT_HAS_SIFLI_SF32LB52_MPI_ENABLED || DT_HAS_SIFLI_SF32LB57_MPI_ENABLED
    select MEMC_SF32LB_MPI
    help
      Support for a HyperBus memory on the SiFli SF32LB52 and SF32LB57
      MPI controllers.

endif # HYPERBUS
```

## drivers/i2c/Kconfig
```kconfig
# SPDX-FileCopyrightText: 2026 Core Devices LLC
# SPDX-License-Identifier: Apache-2.0

menuconfig I2C
    bool "I2C"
    help
      I2C bus class (pbl/drivers/i2c.h), selected by the drivers of the
      devices on an I2C bus.

if I2C

rsource "Kconfig.nrf5"
rsource "Kconfig.sf32lb"
rsource "Kconfig.stm32"

config I2C_SHELL
    bool "Shell commands"
    default DRIVER_SHELL
    depends on SHELL && DEVICE_NAMES
    help
      The i2c shell command, to list the buses, scan them and read or
      write device registers.

module = DRIVER_I2C
module-str = I2C
source "subsys/logging/Kconfig.template.log_level"

endif # I2C
```

## drivers/i2c/Kconfig.nrf5
```kconfig
# SPDX-FileCopyrightText: 2026 Core Devices LLC
# SPDX-License-Identifier: Apache-2.0

config I2C_NRF5
    bool "Nordic nRF5 I2C controller"
    default y
    depends on DT_HAS_NORDIC_NRF52832_TWIM_ENABLED
    help
      Support for the Nordic nRF5 I2C controller.

config I2C_NRF5_IRQ_PRIO
    int "Interrupt priority"
    default 1
    depends on I2C_NRF5
    help
      Priority of the controller interrupts.
```

## drivers/i2c/Kconfig.sf32lb
```kconfig
# SPDX-FileCopyrightText: 2026 Core Devices LLC
# SPDX-License-Identifier: Apache-2.0

config I2C_SF32LB
    bool "SiFli SF32LB I2C controller"
    default y
    depends on DT_HAS_SIFLI_SF32LB52_I2C_ENABLED
    select CLK
    select DMA
    select PINCTRL
    help
      Support for the SiFli SF32LB I2C controller.

config I2C_SF32LB_IRQ_PRIO
    int "Interrupt priority"
    default 0
    depends on I2C_SF32LB
    help
      Priority of the controller interrupts.
```

## drivers/i2c/Kconfig.stm32
```kconfig
# SPDX-FileCopyrightText: 2026 Core Devices LLC
# SPDX-License-Identifier: Apache-2.0

config I2C_STM32
    bool "ST STM32 I2C Controller"
    default y
    depends on DT_HAS_ST_STM32F7_I2C_ENABLED
    select CLK
    select PINCTRL
    help
      Support for the I2C controllers of the STM32H7, in master mode.

config I2C_STM32_IRQ_PRIO
    int "Interrupt priority"
    default 0
    depends on I2C_STM32
    help
      Priority of the controller interrupts.
```

## drivers/imu/Kconfig
```kconfig
# SPDX-FileCopyrightText: 2026 Core Devices LLC
# SPDX-License-Identifier: Apache-2.0

menu "IMU"

config IMU_SHELL
    bool "Shell commands"
    default DRIVER_SHELL
    depends on SHELL
    help
      The imu shell command, to read the accelerometer driver directly.

menuconfig ACCEL
    bool "Accelerometer"
    help
      Accelerometer drivers (pbl/drivers/accel.h). The board instantiates
      the accelerometer it has and exports it as ACCEL.

if ACCEL

rsource "Kconfig.lis2dw12"
rsource "Kconfig.lsm6dso"
rsource "Kconfig.accel_sim"

endif # ACCEL

module = DRIVER_IMU
module-str = IMU
source "subsys/logging/Kconfig.template.log_level"

endmenu
```

## drivers/imu/Kconfig.accel_sim
```kconfig
# SPDX-FileCopyrightText: 2026 Core Devices LLC
# SPDX-License-Identifier: Apache-2.0

config ACCEL_SIM
    bool "Simulator"
    default y
    depends on SOC_QEMU_PEBBLE || SOC_POSIX
    select KERNEL_SYS_WORKQ_HIGH
    help
      Simulated accelerometer, replaying samples and events fed through
      its simulator API (pbl/drivers/imu/sim.h).
```

## drivers/imu/Kconfig.lsm6dso
```kconfig
# SPDX-FileCopyrightText: 2026 Core Devices LLC
# SPDX-License-Identifier: Apache-2.0

config ACCEL_LSM6DSO
    bool "ST LSM6DSO"
    default y
    depends on DT_HAS_ST_LSM6DSO_ENABLED
    select GPIO
    select I2C
    select KERNEL_SYS_WORKQ_HIGH
    help
      Support for the ST LSM6DSO accelerometer/gyroscope.

if ACCEL_LSM6DSO

config ACCEL_LSM6DSO_WK_DUR_DEFAULT
    int "Default wake duration"
    range 0 3
    default 0
    help
      Default wake duration applied at init.

config ACCEL_LSM6DSO_WK_THS_MIN
    int "Minimum wake threshold"
    range 0 63
    default 0
    help
      Minimum (highest sensitivity) wake-up threshold.

config ACCEL_LSM6DSO_WK_THS_MAX
    int "Maximum wake threshold"
    range 0 63
    default 63
    help
      Maximum (lowest sensitivity) wake-up threshold.

config ACCEL_LSM6DSO_WK_THS_DEFAULT
    int "Default wake threshold"
    range 0 63
    default 0
    help
      Default wake-up threshold applied at init.

config ACCEL_LSM6DSO_SCALE_MG
    int "Full-scale range (mg)"
    default 2000
    help
      Acceleration full-scale range in mg (2000, 4000, 8000 or 16000).

endif # ACCEL_LSM6DSO
```

## drivers/imu/Kconfig.mag_sim
```kconfig
# SPDX-FileCopyrightText: 2026 Core Devices LLC
# SPDX-License-Identifier: Apache-2.0

config MAG_SIM
    bool "Simulator"
    depends on SOC_QEMU_PEBBLE || SOC_POSIX
    select KERNEL_SYS_WORKQ_HIGH
    help
      Simulated magnetometer, measuring a field set through its
      simulator API (pbl/drivers/imu/sim.h).
```

## drivers/imu/Kconfig.mmc5603nj
```kconfig
# SPDX-FileCopyrightText: 2026 Core Devices LLC
# SPDX-License-Identifier: Apache-2.0

config MAG_MMC5603NJ
    bool "MEMSIC MMC5603NJ"
    default y
    depends on DT_HAS_MEMSIC_MMC5603_ENABLED
    select I2C
    select KERNEL_SYS_WORKQ_HIGH
    help
      Support for the MEMSIC MMC5603NJ magnetometer.
```

## drivers/input/Kconfig
```kconfig
# SPDX-FileCopyrightText: 2026 Core Devices LLC
# SPDX-License-Identifier: Apache-2.0

menu "Input"

rsource "Kconfig.adc_keys"
rsource "Kconfig.gpio_keys"
rsource "Kconfig.rotary_encoder"
rsource "Kconfig.sdl"

endmenu
```

## drivers/input/Kconfig.adc_keys
```kconfig
# SPDX-FileCopyrightText: 2026 Core Devices LLC
# SPDX-License-Identifier: Apache-2.0

config INPUT_ADC_KEYS
    bool "ADC keys"
    default y
    depends on DT_HAS_ADC_KEYS_IRQ_ENABLED
    depends on INPUT
    select ADC
    select GPIO
    select KERNEL_SYS_WORKQ
    help
      Keys on a resistor ladder read through an ADC channel on an
      interrupt that a press or release raises.
```

## drivers/input/Kconfig.gpio_keys
```kconfig
# SPDX-FileCopyrightText: 2026 Core Devices LLC
# SPDX-License-Identifier: Apache-2.0

config INPUT_GPIO_KEYS
    bool "GPIO keys"
    default y
    depends on DT_HAS_GPIO_KEYS_ENABLED
    depends on INPUT
    select GPIO
    help
      Keys on GPIOs with interrupts, debounced in software.
```

## drivers/input/Kconfig.rotary_encoder
```kconfig
# SPDX-FileCopyrightText: 2026 Core Devices LLC
# SPDX-License-Identifier: Apache-2.0

config INPUT_ROTARY_ENCODER
    bool "Rotary encoder"
    default y
    depends on DT_HAS_ROTARY_ENCODER_ENABLED
    depends on INPUT
    select GPIO
    help
      Gray-coded quadrature encoder on two GPIOs with interrupts,
      reporting relative axis steps.
```

## drivers/input/Kconfig.sdl
```kconfig
# SPDX-FileCopyrightText: 2026 Core Devices LLC
# SPDX-License-Identifier: Apache-2.0

config INPUT_SDL
    bool "SDL keyboard"
    default y
    depends on SOC_POSIX
    depends on INPUT
    select SDL
    help
      Watch buttons driven by the keyboard, through SDL, in a native build.
```

## drivers/led/Kconfig
```kconfig
# SPDX-FileCopyrightText: 2026 Core Devices LLC
# SPDX-License-Identifier: Apache-2.0

menuconfig LED
    bool "LED"
    help
      LED class (pbl/drivers/led.h), selected by the drivers that light
      LEDs, such as the LED backlight.

if LED

config LED_HAS_COLOR
    bool
    help
      Selected by the drivers of multicolor LEDs.

rsource "Kconfig.aw2016"
rsource "Kconfig.ws2812b"
rsource "Kconfig.gpio"

module = DRIVER_LED
module-str = LED
source "subsys/logging/Kconfig.template.log_level"

endif # LED
```

## drivers/led/Kconfig.aw2016
```kconfig
# SPDX-FileCopyrightText: 2026 Core Devices LLC
# SPDX-License-Identifier: Apache-2.0

config LED_AW2016
    bool "Awinic AW2016"
    default y
    depends on DT_HAS_AWINIC_AW2016_ENABLED
    select I2C
    select LED_HAS_COLOR
    help
      Support for the Awinic AW2016 RGB LED controller.
```

## drivers/led/Kconfig.gpio
```kconfig
# SPDX-FileCopyrightText: 2026 Core Devices LLC
# SPDX-License-Identifier: Apache-2.0

config LED_GPIO
    bool "GPIO LEDs"
    default y
    depends on DT_HAS_GPIO_LEDS_ENABLED
    select GPIO
    help
      Support for LEDs switched by GPIOs.
```

## drivers/led/Kconfig.ws2812b
```kconfig
# SPDX-FileCopyrightText: 2026 Core Devices LLC
# SPDX-License-Identifier: Apache-2.0

config LED_WS2812B
    bool "Worldsemi WS2812B"
    default y
    depends on DT_HAS_WORLDSEMI_WS2812B_ENABLED
    select SPI
    select LED_HAS_COLOR
    help
      Support for a Worldsemi WS2812B RGB LED on a SPI MOSI line.
```

## drivers/mbox/Kconfig
```kconfig
# SPDX-FileCopyrightText: 2026 Core Devices LLC
# SPDX-License-Identifier: Apache-2.0

menuconfig MBOX
    bool "Mailbox controllers"
    help
      Mailbox controller class (pbl/drivers/mbox.h), selected by the
      drivers that ring mailbox channels.

if MBOX

rsource "Kconfig.sf32lb"
rsource "Kconfig.stm32_hsem"

config MBOX_SHELL
    bool "Mailbox shell commands"
    default DRIVER_SHELL
    depends on SHELL && DEVICE_NAMES
    help
      The mbox shell command, to list the controllers with their channel
      counters and ring a channel.

endif # MBOX
```

## drivers/mbox/Kconfig.sf32lb
```kconfig
# SPDX-FileCopyrightText: 2026 Core Devices LLC
# SPDX-License-Identifier: Apache-2.0

config MBOX_SF32LB
    bool "SiFli SF32LB mailbox"
    default y
    depends on DT_HAS_SIFLI_SF32LB52_MAILBOX_ENABLED
    select CLK
    help
      SF32LB52 and SF32LB57 mailbox blocks (MAILBOX1, MAILBOX2), channel 1
      doorbells.

config MBOX_SF32LB_IRQ_PRIO
    int "Interrupt priority"
    default 0
    depends on MBOX_SF32LB
    help
      Priority of the interrupt of the blocks rung by the remote.
```
