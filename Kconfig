## Kconfig.platform
```kconfig
# SPDX-FileCopyrightText: 2026 Core Devices LLC
# SPDX-License-Identifier: Apache-2.0

# SDK platforms and the properties apps are built against. Self-contained,
# so tools can evaluate it without a board.

choice
    prompt "SDK platform"
config PLATFORM_EMERY
    bool "Emery"
    select PLATFORM_COLOR
config PLATFORM_FLINT
    bool "Flint"
config PLATFORM_GABBRO
    bool "Gabbro"
    select PLATFORM_COLOR
    select PLATFORM_ROUND
endchoice

# Display properties apps are built against. The display hardware may differ;
# its own properties belong to its driver.

config PLATFORM_COLOR
    bool
    help
      8-bit color display, black and white otherwise.

config PLATFORM_ROUND
    bool
    help
      Round display, rectangular otherwise.

config PLATFORM_DISPLAY_WIDTH
    int
    default 200 if PLATFORM_EMERY
    default 144 if PLATFORM_FLINT
    default 260 if PLATFORM_GABBRO

config PLATFORM_DISPLAY_HEIGHT
    int
    default 228 if PLATFORM_EMERY
    default 168 if PLATFORM_FLINT
    default 260 if PLATFORM_GABBRO

# Display size given to apps of each legacy SDK execution environment.

config PLATFORM_LEGACY_2X_DISPLAY_WIDTH
    int
    default 180 if PLATFORM_GABBRO
    default 144

config PLATFORM_LEGACY_2X_DISPLAY_HEIGHT
    int
    default 180 if PLATFORM_GABBRO
    default 168

config PLATFORM_LEGACY_3X_DISPLAY_WIDTH
    int
    default 180 if PLATFORM_GABBRO
    default 144

config PLATFORM_LEGACY_3X_DISPLAY_HEIGHT
    int
    default 180 if PLATFORM_GABBRO
    default 168

# Animation timing apps see.

config PLATFORM_ANIMATION_FRAME_INTERVAL_MS
    int
    default 28 if PLATFORM_GABBRO
    default 33
    help
      Design frame interval animation durations derive from. Gabbro's is
      quicker, as its ~21 Hz display shows fewer, larger motion steps that
      read as sluggish at design speed.

config PLATFORM_ANIMATION_RENDER_INTERVAL_MS
    int
    default 48 if PLATFORM_GABBRO
    default PLATFORM_ANIMATION_FRAME_INTERVAL_MS
    help
      Interval at which animation frames are rendered. Gabbro's display shows
      a full frame in about 47 ms: rendering faster coalesces frames into
      uneven motion steps.
```

## boards/asterix/defconfig
```kconfig
# asterix board configuration

CONFIG_SOC_NRF52840=y

CONFIG_PLATFORM_FLINT=y

CONFIG_UART=y
```

## boards/getafix/Kconfig.defconfig
```kconfig
# SPDX-FileCopyrightText: 2026 Core Devices LLC
# SPDX-License-Identifier: Apache-2.0

if FUEL_GAUGE_THEVENIN

config FUEL_GAUGE_THEVENIN_RC_MILLIOHM
    default 1857

config FUEL_GAUGE_THEVENIN_RC_TAU_MS
    default 64900

endif
```

## boards/getafix/defconfig
```kconfig
# getafix board configuration

CONFIG_SOC_SF32LB52J=y


CONFIG_PLATFORM_GABBRO=y

CONFIG_PBLBOOT=y

CONFIG_UART=y
```

## boards/native_emery/Kconfig.defconfig
```kconfig
# SPDX-FileCopyrightText: 2026 Core Devices LLC
# SPDX-License-Identifier: Apache-2.0

config RESOURCES_BOARD
    default "qemu_emery"

config DISPLAY_SDL_WIDTH
    default 200

config DISPLAY_SDL_HEIGHT
    default 228
```

## boards/native_emery/defconfig
```kconfig
# native_emery board configuration

CONFIG_SOC_POSIX=y

CONFIG_PLATFORM_EMERY=y

CONFIG_LIBC_HOST=y

CONFIG_UART=y

CONFIG_DISPLAY=y
CONFIG_DISPLAY_SDL_WIDTH=200
CONFIG_DISPLAY_SDL_HEIGHT=228

CONFIG_FLASH=y

CONFIG_OTP=y

CONFIG_BATTERY=y

CONFIG_VIBE=y

CONFIG_TOUCH=y

CONFIG_AMBIENT_LIGHT=y

CONFIG_BACKLIGHT=y

CONFIG_RTC=y

CONFIG_RNG=y

CONFIG_TEMPERATURE=y

CONFIG_LOG_HASHED=n

CONFIG_ACCEL=y
CONFIG_ACCEL_POSIX=y

CONFIG_MIC=y
```

## boards/native_flint/Kconfig.defconfig
```kconfig
# SPDX-FileCopyrightText: 2026 Core Devices LLC
# SPDX-License-Identifier: Apache-2.0

config RESOURCES_BOARD
    default "qemu_flint"

config DISPLAY_SDL_WIDTH
    default 144

config DISPLAY_SDL_HEIGHT
    default 168

config DISPLAY_SDL_MONO
    default y
```

## boards/native_gabbro/Kconfig.defconfig
```kconfig
# SPDX-FileCopyrightText: 2026 Core Devices LLC
# SPDX-License-Identifier: Apache-2.0

config RESOURCES_BOARD
    default "qemu_gabbro"

config DISPLAY_SDL_WIDTH
    default 260

config DISPLAY_SDL_HEIGHT
    default 260

config DISPLAY_SDL_ROUND
    default y
```

## boards/native_gabbro/defconfig
```kconfig
# native_gabbro board configuration

CONFIG_SOC_POSIX=y

CONFIG_PLATFORM_GABBRO=y

CONFIG_LIBC_HOST=y

CONFIG_UART=y

CONFIG_LOG_HASHED=n
```

## boards/obelix/defconfig
```kconfig
# obelix board configuration

CONFIG_SOC_SF32LB52J=y


CONFIG_PLATFORM_EMERY=y

CONFIG_PBLBOOT=y

CONFIG_UART=y
```

## boards/qemu_emery/defconfig
```kconfig
# qemu_emery board configuration

CONFIG_SOC_QEMU_PEBBLE_CORTEX_M33=y

CONFIG_PLATFORM_EMERY=y

CONFIG_UART=y
```

## boards/qemu_flint/defconfig
```kconfig
# qemu_flint board configuration

CONFIG_SOC_QEMU_PEBBLE_CORTEX_M4=y

CONFIG_PLATFORM_FLINT=y

CONFIG_UART=y
```

## boards/qemu_gabbro/defconfig
```kconfig
# qemu_gabbro board configuration

CONFIG_SOC_QEMU_PEBBLE_CORTEX_M33=y

CONFIG_PLATFORM_GABBRO=y

CONFIG_UART=y
```

## boards/sf32lb57_dpi_hdk/Kconfig
```kconfig
# SPDX-FileCopyrightText: 2026 Core Devices LLC
# SPDX-License-Identifier: Apache-2.0

config BOARD_SF32LB57_DPI_HDK
    bool
    default y
```

## docs/development/build_system/kconfig.md
~~~~kconfig
# Kconfig

Everything that can be left out of the firmware is a Kconfig symbol: SoCs,
drivers, subsystems, services, debug aids and their parameters. The
configuration is resolved with [Kconfiglib](https://github.com/ulfalizer/Kconfiglib)
when the build directory is configured, and the result drives both the C
sources and the CMake build.

## Configuration tree

The root of the tree is the application's `Kconfig`, `pebble/Kconfig` for the
firmware, or the top-level `Kconfig` for an application without one. Both
source `Kconfig.pebbleos`, which sources the rest of the tree:

- `soc/*/Kconfig.defconfig` and `subsys/bluetooth/Kconfig.defconfig`
  first, so their defaults win over the ones given with the definitions;
- `soc/Kconfig`, with the SoC and CPU symbols;
- the board's files, only for the selected board and revision:
  `boards/<board>/Kconfig`, `Kconfig.<revision>`, `Kconfig.defconfig` and
  `Kconfig.defconfig.<revision>`;
- `lib/c`, `kernel`, `subsys`, `drivers` and `third_party`, each with
  a `Kconfig` that sources its own subdirectories.

A symbol is defined next to the code it enables: a driver class's
`Kconfig` lives in `drivers/<class>/`, a subsystem's in `subsys/<name>/`.
{doc}`../../reference/kconfig` lists every option, with its dependencies,
defaults and location.

## Configuration fragments

A build's configuration is resolved from these fragments, in this order:

| Fragment | Purpose |
| --- | --- |
| `boards/<board>/defconfig` | What the board is: SoC, platform, boot chain and console |
| `boards/<board>/defconfig.<revision>` | What a revision changes |
| `boards/<board>/defconfig.<board variant>` | What a board variant (`native_emery/wasm`) changes |
| `pebble/prj.conf` | Driver classes, subsystems, services and features every firmware enables |
| `pebble/prj_<variant>.conf` | What the `normal` or `prf` variant adds or removes |
| `pebble/boards/<board>.conf` | What the firmware enables or tunes on one board |
| `pebble/boards/<board>_<variant>.conf` | The same, for one variant only |
| `<build>/menuconfig.conf` | Changes made with {doc}`../../pbl/menuconfig` |
| `-DCONFIG_<SYMBOL>=<value>` | Overrides given when configuring |

The `pebble/` fragments are the firmware's. Another application brings the same
files from its own directory instead, see {doc}`applications`.

Overrides are passed to {doc}`../../pbl/configure` or to CMake:

```shell
pbl configure --board obelix@pvt -DCONFIG_RELEASE=y
```

The variant is selected with `--variant` (`-DVARIANT=`), not by setting
`CONFIG_RECOVERY_FW` directly; `prj_prf.conf` sets it, and the build stops
if the two disagree.

The fragments add to each other: a symbol can be assigned in only one of
them, and a later fragment cannot change what an earlier one set. To change
a value for one build, override it with `-D`.

Configuration warnings are errors. The build stops when:

- a fragment or an override names a symbol that does not exist;
- a fragment assigns a symbol an earlier fragment already assigned;
- a value cannot be applied because of the symbol's dependencies; the
  error names the unsatisfied ones.

## Using the configuration

Every symbol reaches all three consumers:

- **C sources**: `autoconf.h` is force-included into every compilation,
  so symbols are plain macros. An enabled `bool` symbol is defined to `1`
  and a disabled one is not defined at all, so test it with
  `#ifdef CONFIG_TOUCH`.
- **CMake**: `config.cmake` sets one variable per enabled symbol, used by
  the `_ifdef` helpers; see [CMake](cmake.md).
- **Linker script**: preprocessed with `autoconf.h`, so memory layout and
  sections can depend on the configuration.

`.config` in the build directory holds the resolved configuration.

## Writing Kconfig

Driver classes
: A class is a `menuconfig` symbol, with one symbol per driver inside its
  `if` block. The application enables the classes it uses; the board's
  defconfig does not. A driver whose devices come from the board's
  {doc}`devicetree` defaults to the tree having one
  (`default DT_HAS_NORDIC_NRF52832_TWIM_ENABLED`). Otherwise, a driver that
  only exists on one SoC defaults to `y` there (`default y if SOC_QEMU`).

What drivers use
: A driver `select`s the classes it uses, such as the bus it sits on
  (`select I2C`) or the supplies it takes (`select REGULATOR`), so an
  application asks for an accelerometer without knowing how the board
  wires it. This is safe because only drivers inside a class the
  application enables select, and the selected classes have no
  dependencies of their own. A driver that is not inside such a class,
  such as a regulator or a GPIO key, does not select: it sits inside the
  class its users select, or the one the application enables.

Capabilities
: What hardware or drivers provide is a hidden symbol (no prompt) that the
  providers `select`, such as `BACKLIGHT_HAS_COLOR` or `CPU_HAS_FPU`. Code
  and other symbols depend on the capability, not on a list of providers.

Optional libraries
: A library that is not always needed is gated behind a symbol, and its
  consumers `select` (or `imply`) it: `BT` selects `MBEDTLS`, and
  `SERVICE_VOICE` selects `SPEEX`.

Board and SoC defaults
: A default that depends on the board or SoC goes in its
  `Kconfig.defconfig`, which is read before the definitions:

  ```kconfig
  config FW_FLASH_SIZE
      default 0xf8000
  ```

Log levels
: A module's log level comes from a template:

  ```kconfig
  module = TASK_WDT
  module-str = Task watchdog
  source "subsys/logging/Kconfig.template.log_level"
  ```

  It defines `CONFIG_TASK_WDT_LOG_LEVEL` and its choice; see
  {doc}`../../subsystems/logging`.
~~~~

## drivers/Kconfig
```kconfig
# SPDX-FileCopyrightText: 2026 Core Devices LLC
# SPDX-License-Identifier: Apache-2.0

menu "Drivers"

rsource "base/Kconfig"
rsource "ambient/Kconfig"
rsource "backlight/Kconfig"
rsource "battery/Kconfig"
rsource "clk/Kconfig"
rsource "crc/Kconfig"
rsource "display/Kconfig"
rsource "dma/Kconfig"
rsource "flash/Kconfig"
rsource "gpio/Kconfig"
rsource "hrm/Kconfig"
rsource "i2c/Kconfig"
rsource "imu/Kconfig"
rsource "input/Kconfig"
rsource "intc/Kconfig"
rsource "mcu/Kconfig"
rsource "mfd/Kconfig"
rsource "mic/Kconfig"
rsource "otp/Kconfig"
rsource "panel/Kconfig"
rsource "pinctrl/Kconfig"
rsource "pmic/Kconfig"
rsource "pwm/Kconfig"
rsource "regulator/Kconfig"
rsource "reset/Kconfig"
rsource "rng/Kconfig"
rsource "rtc/Kconfig"
rsource "sf32lb52/Kconfig"
rsource "speaker/Kconfig"
rsource "spi/Kconfig"
rsource "spi_mem/Kconfig"
rsource "temperature/Kconfig"
rsource "touch/Kconfig"
rsource "uart/Kconfig"
rsource "vibe/Kconfig"
rsource "watchdog/Kconfig"

endmenu
```

## drivers/adc/Kconfig
```kconfig
# SPDX-FileCopyrightText: 2026 Core Devices LLC
# SPDX-License-Identifier: Apache-2.0

menuconfig ADC
    bool "ADCs"
    help
      Analog-to-digital converter class (pbl/drivers/adc.h), selected by the
      drivers that read analog inputs.

if ADC

config ADC_SHELL
    bool "Shell commands"
    default DRIVER_SHELL
    depends on SHELL
    help
      The adc shell command, to list the ADCs and convert a channel.

config ADC_SF32LB57_GPADC
    bool "SiFli SF32LB57 GPADC"
    default DT_HAS_SIFLI_SF32LB57_GPADC_ENABLED
    select CLK
    select NVMEM
    help
      General purpose ADC of the SiFli SF32LB57, read one channel at a
      time, with the factory calibration in its eFuse.

module = ADC
module-str = ADC
source "subsys/logging/Kconfig.template.log_level"

endif # ADC
```

## drivers/als/Kconfig
```kconfig
# SPDX-FileCopyrightText: 2026 Core Devices LLC
# SPDX-License-Identifier: Apache-2.0

menuconfig ALS
    bool "Ambient Light Sensor"
    help
      Ambient light sensor drivers (pbl/drivers/als.h). The board
      instantiates the sensor it has and exports it as ALS.

if ALS

config ALS_OPT3001
    bool "TI OPT3001"
    default DT_HAS_TI_OPT3001_ENABLED
    select I2C
    help
      Support for the TI OPT3001 ambient light sensor.

config ALS_OPT3001_ALWAYS_ON
    bool "Convert continuously"
    depends on ALS_OPT3001
    help
      Keep converting instead of converting once per read, for faster reads
      at the cost of power.

config ALS_W1160
    bool "Sensortek W1160"
    default DT_HAS_SENSORTEK_W1160_ENABLED
    select I2C
    select REGULATOR
    help
      Support for the Sensortek W1160 ambient light sensor.

config ALS_SIM
    bool "Simulator"
    default y if SOC_QEMU_PEBBLE || SOC_POSIX
    help
      Simulated ambient light sensor, reading a level set through its
      simulator API (pbl/drivers/als/sim.h).

config ALS_BITS
    int "Ambient light sensor resolution (bits)"
    default 12 if ALS_OPT3001
    default 16 if ALS_W1160
    default 12 if ALS_SIM
    help
      Number of bits in the ambient light sensor reading. Used to derive
      PBL_ALS_LEVEL_MAX, which bounds the dark/backlight thresholds
      exposed to the shell and settings UI.

module = DRIVER_ALS
module-str = Ambient Light Sensor
source "subsys/logging/Kconfig.template.log_level"

endif # ALS
```

## drivers/ambient/Kconfig
```kconfig
# SPDX-FileCopyrightText: 2026 Core Devices LLC
# SPDX-License-Identifier: Apache-2.0

menuconfig AMBIENT_LIGHT
    bool "Ambient Light Sensor"
    help
      Ambient Light Sensor Drivers

if AMBIENT_LIGHT

config AMBIENT_LIGHT_OPT3001
    bool "TI OPT3001"
    help
      Support for the TI OPT3001 ambient light sensor.

config AMBIENT_LIGHT_W1160
    bool "W1160"
    help
      Support for the W1160 ambient light sensor.

config AMBIENT_LIGHT_QEMU
    bool "QEMU"
    default y if SOC_QEMU
    help
      QEMU ambient light sensor. QEMU emulates none, so it always reads
      complete darkness.

config AMBIENT_LIGHT_POSIX
    bool "POSIX"
    default y if SOC_POSIX
    help
      Ambient light driver for a native build (always dark).

config AMBIENT_LIGHT_BITS
    int "Ambient light sensor resolution (bits)"
    default 12 if AMBIENT_LIGHT_OPT3001
    default 16 if AMBIENT_LIGHT_W1160
    default 12 if AMBIENT_LIGHT_QEMU
    default 12 if AMBIENT_LIGHT_POSIX
    help
      Number of bits in the ambient light sensor reading. Used to derive
      AMBIENT_LIGHT_LEVEL_MAX, which bounds the dark/backlight thresholds
      exposed to the shell and settings UI.

module = DRIVER_AMBIENT
module-str = Ambient Light Sensor
source "subsys/logging/Kconfig.template.log_level"

endif # AMBIENT_LIGHT
```
