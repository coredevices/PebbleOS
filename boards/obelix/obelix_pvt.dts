// SPDX-FileCopyrightText: 2026 Core Devices LLC
// SPDX-License-Identifier: (GPL-2.0-only OR BSD-2-Clause)

/dts-v1/;

#include "obelix.dtsi"

/ {
	compatible = "coredevices,obelix-pvt", "coredevices,obelix", "sifli,sf32lb52j";
};

&i2c2 {
	/* Unused, but powered: its INT1 shares the LSM6DSO INT1 pad */
	lis2dw12: accelerometer@19 {
		compatible = "st,lis2dw12";
		reg = <0x19>;
	};
};
