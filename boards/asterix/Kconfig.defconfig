## boards/asterix/Kconfig.defconfig
```kconfig
# SPDX-FileCopyrightText: 2026 Core Devices LLC
# SPDX-License-Identifier: Apache-2.0

if FLASH_SPI_NOR

config FLASH_SPI_NOR_GD25LQ255E
    default y

endif
```

## boards/getafix/Kconfig.defconfig
```kconfig
# SPDX-FileCopyrightText: 2026 Core Devices LLC
# SPDX-License-Identifier: Apache-2.0

if FUEL_GAUGE_THEVENIN

config FUEL_GAUGE_THEVENIN_RC_MILLIOHM
    default 1857

config FUEL_GAUGE_THEVENIN_RC_TAU_MS
    default 64900

endif

if FLASH_SPI_NOR

config FLASH_SPI_NOR_GD25Q256E
    default y

endif
```

## boards/nrf54l15dk/Kconfig
```kconfig
# SPDX-FileCopyrightText: 2026 Core Devices LLC
# SPDX-License-Identifier: Apache-2.0

config BOARD_NRF54L15DK
    bool
    default y
```

## boards/nrf54l15dk/Kconfig.defconfig
```kconfig
# SPDX-FileCopyrightText: 2026 Core Devices LLC
# SPDX-License-Identifier: Apache-2.0

if FLASH_SPI_NOR

config FLASH_SPI_NOR_MX25R6435F
    default y

endif
```

## boards/nrf54lm20dk/defconfig
```kconfig
# nrf54lm20dk board configuration

CONFIG_SOC_NRF54LM20A_CPUAPP=y

CONFIG_UART=y
```

## boards/obelix/Kconfig.defconfig
```kconfig
# SPDX-FileCopyrightText: 2026 Core Devices LLC
# SPDX-License-Identifier: Apache-2.0

if FLASH_SPI_NOR

config FLASH_SPI_NOR_GD25Q256E
    default y

endif
```

## boards/qemu_emery/defconfig
```kconfig
# qemu_emery board configuration

CONFIG_SOC_QEMU_PEBBLE_CORTEX_M33=y

CONFIG_UART=y
```

## boards/qemu_flint/defconfig
```kconfig
# qemu_flint board configuration

CONFIG_SOC_QEMU_PEBBLE_CORTEX_M4=y

CONFIG_UART=y
```

## boards/stm32h747i_disco/Kconfig
```kconfig
# SPDX-FileCopyrightText: 2026 Core Devices LLC
# SPDX-License-Identifier: Apache-2.0

config BOARD_STM32H747I_DISCO
    bool
    default y
```

## drivers/adc/Kconfig
```kconfig
# SPDX-FileCopyrightText: 2026 Core Devices LLC
# SPDX-License-Identifier: Apache-2.0

menuconfig ADC
    bool "ADCs"
    help
      Analog-to-digital converter class (pbl/drivers/adc.h), selected by the
      drivers that read analog inputs.

if ADC

config ADC_SHELL
    bool "Shell commands"
    default DRIVER_SHELL
    depends on SHELL && DEVICE_NAMES
    help
      The adc shell command, to list the ADCs and convert a channel.

rsource "Kconfig.nrf5_saadc"
rsource "Kconfig.sf32lb57_gpadc"
rsource "Kconfig.stm32h7"

module = DRIVER_ADC
module-str = ADC
source "subsys/logging/Kconfig.template.log_level"

endif # ADC
```

## drivers/adc/Kconfig.nrf5_saadc
```kconfig
# SPDX-FileCopyrightText: 2026 Core Devices LLC
# SPDX-License-Identifier: Apache-2.0

config ADC_NRF5_SAADC
    bool "Nordic nRF5 SAADC"
    default y
    depends on DT_HAS_NORDIC_NRF52832_SAADC_ENABLED
    help
      Successive approximation ADC of the Nordic nRF52 series, one input
      converted at a time, in 12 bits over 3.6 V.
```

## drivers/adc/Kconfig.sf32lb57_gpadc
```kconfig
# SPDX-FileCopyrightText: 2026 Core Devices LLC
# SPDX-License-Identifier: Apache-2.0

config ADC_SF32LB57_GPADC
    bool "SiFli SF32LB57 GPADC"
    default y
    depends on DT_HAS_SIFLI_SF32LB57_GPADC_ENABLED
    select CLK
    select NVMEM
    help
      General purpose ADC of the SiFli SF32LB57, read one channel at a
      time, with the factory calibration in its eFuse.
```

## drivers/adc/Kconfig.stm32h7
```kconfig
# SPDX-FileCopyrightText: 2026 Core Devices LLC
# SPDX-License-Identifier: Apache-2.0

config ADC_STM32H7
    bool "STM32H7 ADC"
    default y
    depends on DT_HAS_ST_STM32H7_ADC_ENABLED
    select CLK
    help
      ADCs of the STM32H7, converting one channel at a time at 16 bits,
      clocked from the bus in synchronous mode.
```

## drivers/als/Kconfig
```kconfig
# SPDX-FileCopyrightText: 2026 Core Devices LLC
# SPDX-License-Identifier: Apache-2.0

menuconfig ALS
    bool "Ambient light sensor"
    help
      Ambient light sensor drivers (pbl/drivers/als.h). The board
      instantiates the sensor it has and exports it as ALS.

if ALS

rsource "Kconfig.opt3001"
rsource "Kconfig.w1160"
rsource "Kconfig.sim"

config ALS_BITS
    int
    default 12 if ALS_OPT3001
    default 16 if ALS_W1160
    default 12 if ALS_SIM
    help
      Number of bits in the ambient light sensor reading, given by the
      driver. Used to derive PBL_ALS_LEVEL_MAX, which bounds the
      dark/backlight thresholds exposed to the shell and settings UI.

module = DRIVER_ALS
module-str = Ambient light sensor
source "subsys/logging/Kconfig.template.log_level"

endif # ALS
```

## drivers/als/Kconfig.opt3001
```kconfig
# SPDX-FileCopyrightText: 2026 Core Devices LLC
# SPDX-License-Identifier: Apache-2.0

config ALS_OPT3001
    bool "TI OPT3001"
    default y
    depends on DT_HAS_TI_OPT3001_ENABLED
    select I2C
    select REGULATOR
    help
      Support for the TI OPT3001 ambient light sensor.

config ALS_OPT3001_ALWAYS_ON
    bool "Convert continuously"
    depends on ALS_OPT3001
    help
      Keep converting instead of converting once per read, for faster reads
      at the cost of power.
```
