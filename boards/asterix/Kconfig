## boards/asterix/Kconfig
```kconfig
# SPDX-FileCopyrightText: 2026 Core Devices LLC
# SPDX-License-Identifier: Apache-2.0

config BOARD_ASTERIX
    bool
    default y
    select BOARD_FAMILY_ASTERIX
```

## boards/getafix_dvt/defconfig
```kconfig
# getafix_dvt board configuration

CONFIG_LED_CONTROLLER=y
CONFIG_LED_CONTROLLER_AW9364E=y
```

## boards/getafix_evt/Kconfig
```kconfig
# SPDX-FileCopyrightText: 2026 Core Devices LLC
# SPDX-License-Identifier: Apache-2.0

config BOARD_GETAFIX_EVT
    bool
    default y
    select BOARD_FAMILY_GETAFIX
```

## boards/getafix_evt/defconfig
```kconfig
# getafix_evt board configuration

CONFIG_I2C=y
CONFIG_I2C_SF32LB=y

CONFIG_UART=y
CONFIG_UART_SF32LB=y

CONFIG_LED_CONTROLLER=y
CONFIG_LED_CONTROLLER_AW9364E=y
CONFIG_VIBE=y
CONFIG_VIBE_AW8623X=y
```

## boards/obelix/Kconfig
```kconfig
# SPDX-FileCopyrightText: 2026 Core Devices LLC
# SPDX-License-Identifier: Apache-2.0

config BOARD_OBELIX
    bool
    default y
    select BOARD_FAMILY_OBELIX
```

## boards/obelix/Kconfig.bb2
```kconfig
# SPDX-FileCopyrightText: 2026 Core Devices LLC
# SPDX-License-Identifier: Apache-2.0

config BOARD_OBELIX_BB2
    bool
    default y
```

## boards/obelix_bb2/defconfig
```kconfig
# obelix_bb2 board configuration

CONFIG_I2C=y
CONFIG_I2C_SF32LB=y

CONFIG_UART=y
CONFIG_UART_SF32LB=y

CONFIG_LED_CONTROLLER=y
CONFIG_LED_CONTROLLER_AW2016=y
CONFIG_VIBE=y
CONFIG_VIBE_AW86225=y

CONFIG_PMIC=y
CONFIG_PMIC_NPM1300=y

CONFIG_AMBIENT_LIGHT=y
CONFIG_AMBIENT_LIGHT_W1160=y
```

## boards/obelix_dvt/defconfig
```kconfig
# obelix_dvt board configuration

CONFIG_I2C=y
CONFIG_I2C_SF32LB=y

CONFIG_LED_CONTROLLER=y
CONFIG_LED_CONTROLLER_AW2016=y
```

## boards/obelix_pvt/Kconfig
```kconfig
# SPDX-FileCopyrightText: 2026 Core Devices LLC
# SPDX-License-Identifier: Apache-2.0

config BOARD_OBELIX_PVT
    bool "Obelix PVT"
    select BOARD_FAMILY_OBELIX
```

## boards/obelix_pvt/defconfig
```kconfig
# obelix_pvt board configuration

CONFIG_I2C=y
CONFIG_I2C_SF32LB=y

CONFIG_UART=y
CONFIG_UART_SF32LB=y

CONFIG_LED_CONTROLLER=y
CONFIG_LED_CONTROLLER_AW2016=y
CONFIG_VIBE=y
CONFIG_VIBE_AW86225=y

CONFIG_PMIC=y
CONFIG_PMIC_NPM1300=y

CONFIG_AMBIENT_LIGHT=y
CONFIG_AMBIENT_LIGHT_W1160=y

CONFIG_MIC=y
CONFIG_MIC_SF32LB=y

CONFIG_TEMPERATURE=y
CONFIG_TEMPERATURE_SF32LB=y

CONFIG_DISPLAY=y
CONFIG_DISPLAY_JDI_SF32LB=y

CONFIG_FLASH=y
CONFIG_FLASH_GD25Q256E=y

CONFIG_BATTERY=y
CONFIG_BATTERY_PMIC=y

CONFIG_TOUCH=y
CONFIG_TOUCH_CST816=y

CONFIG_HRM=y
CONFIG_HRM_GH3X2X=y

CONFIG_ACCEL_LIS2DW12=y
CONFIG_MAG_MMC5603NJ=y
```

## boards/qemu_emery/Kconfig
```kconfig
# SPDX-FileCopyrightText: 2026 Core Devices LLC
# SPDX-License-Identifier: Apache-2.0

config BOARD_QEMU_EMERY
    bool
    default y

choice
    prompt "Emulated watch color"
    help
      Watch color reported by manufacturing info on the emulator.

config QEMU_WATCH_COLOR_PT2_BLACK_GREY
    bool "Black/Grey"

config QEMU_WATCH_COLOR_PT2_BLACK_RED
    bool "Black/Red"

config QEMU_WATCH_COLOR_PT2_SILVER_BLUE
    bool "Silver/Blue"

config QEMU_WATCH_COLOR_PT2_SILVER_GREY
    bool "Silver/Grey"

endchoice
```

## boards/qemu_flint/Kconfig
```kconfig
# SPDX-FileCopyrightText: 2026 Core Devices LLC
# SPDX-License-Identifier: Apache-2.0

config BOARD_QEMU_FLINT
    bool
    default y

choice
    prompt "Emulated watch color"
    help
      Watch color reported by manufacturing info on the emulator.

config QEMU_WATCH_COLOR_P2D_BLACK
    bool "Black"

config QEMU_WATCH_COLOR_P2D_WHITE
    bool "White"

endchoice
```

## boards/qemu_gabbro/Kconfig
```kconfig
# SPDX-FileCopyrightText: 2026 Core Devices LLC
# SPDX-License-Identifier: Apache-2.0

config BOARD_QEMU_GABBRO
    bool
    default y

choice
    prompt "Emulated watch color"
    help
      Watch color reported by manufacturing info on the emulator.

config QEMU_WATCH_COLOR_PR2_BLACK_20
    bool "Black (20mm)"

config QEMU_WATCH_COLOR_PR2_SILVER_14
    bool "Silver (14mm)"

config QEMU_WATCH_COLOR_PR2_SILVER_20
    bool "Silver (20mm)"

config QEMU_WATCH_COLOR_PR2_GOLD_14
    bool "Gold (14mm)"

endchoice
```

## boards/qemu_gabbro/Kconfig.defconfig
```kconfig
# SPDX-FileCopyrightText: 2026 Core Devices LLC
# SPDX-License-Identifier: Apache-2.0

config BOARD_FAMILY_NAME
    default "qemu_gabbro"

config QEMU_MACHINE
    default "pebble-gabbro"
```

## boards/silk/defconfig
```kconfig
# silk board configuration

CONFIG_I2C=y
CONFIG_I2C_STM32F4=y

CONFIG_UART=y
CONFIG_UART_STM32F4=y
CONFIG_VIBE=y
CONFIG_VIBE_PWM=y

CONFIG_PMIC=y
CONFIG_PMIC_AS3701B=y

CONFIG_AMBIENT_LIGHT=y
CONFIG_AMBIENT_LIGHT_STM32F4=y

CONFIG_MIC=y
CONFIG_MIC_STM32F4_DFSDM=y

CONFIG_TEMPERATURE=y
CONFIG_TEMPERATURE_STM32F4=y
```

## boards/silk_bb2/defconfig
```kconfig
# silk_bb2 board configuration

CONFIG_I2C=y
CONFIG_I2C_STM32F4=y

CONFIG_UART=y
CONFIG_UART_STM32F4=y
CONFIG_VIBE=y
CONFIG_VIBE_PWM=y

CONFIG_PMIC=y
CONFIG_PMIC_AS3701B=y

CONFIG_AMBIENT_LIGHT=y
CONFIG_AMBIENT_LIGHT_STM32F4=y

CONFIG_MIC=y
CONFIG_MIC_STM32F4_DFSDM=y

CONFIG_TEMPERATURE=y
CONFIG_TEMPERATURE_STM32F4=y

CONFIG_DISPLAY=y
CONFIG_DISPLAY_SHARP_LS013B7DH01=y

CONFIG_FLASH=y
CONFIG_FLASH_MX25U=y
```

## boards/snowy_bb2/defconfig
```kconfig
# snowy_bb2 board configuration

CONFIG_I2C=y
CONFIG_I2C_STM32F4=y

CONFIG_UART=y
CONFIG_UART_STM32F4=y
CONFIG_VIBE=y
CONFIG_VIBE_PWM=y

CONFIG_PMIC=y
CONFIG_PMIC_MAX14690=y

CONFIG_AMBIENT_LIGHT=y
CONFIG_AMBIENT_LIGHT_STM32F4=y

CONFIG_MIC=y
CONFIG_MIC_STM32F4_PDM=y

CONFIG_TEMPERATURE=y
CONFIG_TEMPERATURE_STM32F4=y

CONFIG_DISPLAY=y
CONFIG_DISPLAY_ICE40LP=y

CONFIG_FLASH=y
CONFIG_FLASH_SPANSION_S29VS=y
```

## boards/snowy_dvt/defconfig
```kconfig
# snowy_dvt board configuration

CONFIG_I2C=y
CONFIG_I2C_STM32F4=y

CONFIG_UART=y
CONFIG_UART_STM32F4=y
CONFIG_VIBE=y
CONFIG_VIBE_PWM=y

CONFIG_PMIC=y
CONFIG_PMIC_MAX14690=y

CONFIG_AMBIENT_LIGHT=y
CONFIG_AMBIENT_LIGHT_STM32F4=y
```

## boards/spalding_gabbro/defconfig
```kconfig
# spalding_gabbro board configuration

CONFIG_I2C=y
CONFIG_I2C_STM32F4=y

CONFIG_UART=y
CONFIG_UART_STM32F4=y
CONFIG_VIBE=y
CONFIG_VIBE_PWM=y

CONFIG_PMIC=y
CONFIG_PMIC_MAX14690=y

CONFIG_AMBIENT_LIGHT=y
CONFIG_AMBIENT_LIGHT_STM32F4=y

CONFIG_MIC=y
CONFIG_MIC_STM32F4_PDM=y

CONFIG_TEMPERATURE=y
CONFIG_TEMPERATURE_STM32F4=y
```

## fw/apps/demo/action_menu/Kconfig
```kconfig
# SPDX-Copyright-Text: 2026 Core Devices LLC
# SPDX-License-Identifier: Apache-2.0

config DEMO_APP_ACTION_MENU
    bool "Action Menu"
```

## fw/apps/demo/double_tap_test/Kconfig
```kconfig
# SPDX-Copyright-Text: 2026 Core Devices LLC
# SPDX-License-Identifier: Apache-2.0

config DEMO_APP_DOUBLE_TAP_TEST
    bool "Double Tap Test"
```
